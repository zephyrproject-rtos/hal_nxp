## mcux/mcux-sdk-ng/arch/arm/configuration/Kconfig
```kconfig
# Copyright 2024 NXP
#
# SPDX-License-Identifier: BSD-3-Clause

config MCUX_PRJSEG_config.arm.shared
    bool
    imply MCUX_COMPONENT_utilities.misc_utilities

config MCUX_PRJSEG_config.kinetis.shared
    bool
    default y if MCUX_HW_SOC_SERIES_KINETIS || MCUX_HW_SOC_SERIES_RT || MCUX_HW_SOC_SERIES_LPC || MCUX_HW_SOC_SERIES_MCX || MCUX_HW_SOC_SERIES_MIMX
    imply MCUX_PRJSEG_config.arm.shared

config MCUX_PRJSEG_config.wireless.shared
    bool
    default y if MCUX_HW_SOC_SERIES_WIRELESS
    imply MCUX_PRJSEG_config.arm.shared
```

## mcux/mcux-sdk-ng/arch/arm/cortexm/Kconfig
```kconfig
# Copyright 2024 NXP
#
# SPDX-License-Identifier: BSD-3-Clause

config MCUX_PRJSEG_config.arm.core.cm4
    bool
    default y if MCUX_HW_CORE_CM4

config MCUX_PRJSEG_config.arm.core.cm4f
    bool
    default y if MCUX_HW_CORE_CM4F

config MCUX_PRJSEG_config.arm.core.fpu.no_fpu
    bool
    default y if MCUX_HW_NO_FPU

config MCUX_PRJSEG_config.arm.core.fpu.fpv4_sp
    bool
    default y if MCUX_HW_FPV4_SP

config MCUX_PRJSEG_config.device_core.define
    bool
    default y

config MCUX_PRJSEG_config.arm.core.cm7f
    bool
    default y if MCUX_HW_CORE_CM7F

config MCUX_PRJSEG_config.arm.core.fpu.fpv5_dp
    bool
    default y if MCUX_HW_FPV5_DP

config MCUX_PRJSEG_config.arm.core.fpu.fpv5_sp
    bool
    default y if MCUX_HW_FPV5_SP

config MCUX_PRJSEG_config.arm.core.cm33
    bool
    default y if MCUX_HW_CORE_CM33 && MCUX_HW_DSP && MCUX_HW_SAU

config MCUX_PRJSEG_config.arm.core.cm33_nodsp_nosau
    bool
    default y if MCUX_HW_CORE_CM33 && !MCUX_HW_DSP && !MCUX_HW_SAU

config MCUX_PRJSEG_config.arm.core.cm33_dsp_nosau
    bool
    default y if MCUX_HW_CORE_CM33 && MCUX_HW_DSP && !MCUX_HW_SAU

config MCUX_PRJSEG_config.arm.core.cm33_nodsp_sau
    bool
    default y if MCUX_HW_CORE_CM33 && !MCUX_HW_DSP && MCUX_HW_SAU

config MCUX_PRJSEG_config.arm.core.cm0p
    bool
    default y if MCUX_HW_CORE_CM0P
```

## mcux/mcux-sdk-ng/arch/dsp56800/configuration/Kconfig
```kconfig
# Copyright 2024 NXP
#
# SPDX-License-Identifier: BSD-3-Clause

config MCUX_PRJSEG_config.dsp56800.shared
    bool
    default y if MCUX_HW_SOC_SERIES_DSC
```

## mcux/mcux-sdk-ng/arch/dsp56800/core/Kconfig
```kconfig
# Copyright 2024 NXP
#
# SPDX-License-Identifier: BSD-3-Clause

config MCUX_PRJSEG_config.codewarrior.core.dsp56800
    bool
    default y if MCUX_HW_CORE_DSP56800EX || MCUX_HW_CORE_DSP56800EF

config MCUX_PRJSEG_config.dsp56800.ex
    bool
    default y if MCUX_HW_CORE_DSP56800EX

config MCUX_PRJSEG_config.dsp56800.ef
    bool
    default y if MCUX_HW_CORE_DSP56800EF
```

## mcux/mcux-sdk-ng/arch/riscv/configuration/Kconfig
```kconfig
# Copyright 2024 NXP
#
# SPDX-License-Identifier: BSD-3-Clause

config MCUX_PRJSEG_config.ezhv.shared
    bool
    default y if MCUX_HW_CORE_ID_EZHV
```

## mcux/mcux-sdk-ng/arch/riscv/core/Kconfig
```kconfig
# Copyright 2024 NXP
#
# SPDX-License-Identifier: BSD-3-Clause

config MCUX_PRJSEG_config.riscv.core.ezhv
    bool
    default y if MCUX_HW_CORE_EZHV
```

## mcux/mcux-sdk-ng/arch/riscv/headers/Kconfig
```kconfig
#
# Copyright 2024 NXP
#
# SPDX-License-Identifier: BSD-3-Clause

config MCUX_COMPONENT_RISCV_Include_Core
    bool "Select core headers for EZHV cores"
    default y if MCUX_HW_CORE_EZHV
```

## mcux/mcux-sdk-ng/arch/xtensa/configuration/Kconfig
```kconfig
# Copyright 2024 NXP
#
# SPDX-License-Identifier: BSD-3-Clause

config MCUX_PRJSEG_config.syslib.xos
    bool "Use system lib xos"

config MCUX_PRJSEG_config.syslib.math
    bool "Use system lib math"

config MCUX_PRJSEG_config.xtensa.shared
    bool
    default y if MCUX_HW_CORE_ID_HIFI4 || MCUX_HW_CORE_ID_FUSIONF1 || MCUX_HW_CORE_ID_HIFI1
```

## mcux/mcux-sdk-ng/arch/xtensa/core/Kconfig
```kconfig
# Copyright 2024 NXP
#
# SPDX-License-Identifier: BSD-3-Clause

config MCUX_PRJSEG_config.xtensa.core.dsp
    bool
    default y if MCUX_HW_CORE_DSP
```

## mcux/mcux-sdk-ng/boards/evkmimxrt1060/xip/Kconfig
```kconfig
menu "Board Boot Header"
    config MCUX_COMPONENT_board.boot_header
        bool "Use board boot header"
endmenu
```

## mcux/mcux-sdk-ng/components/conn_fwloader/Kconfig
```kconfig
# Copyright 2024 NXP
# SPDX-License-Identifier: BSD-3-Clause

config MCUX_COMPONENT_driver.conn_fwloader
    bool "conn_fwloader"
    select MCUX_COMPONENT_driver.ocotp_rw61x
    select MCUX_COMPONENT_component.osa
    select MCUX_COMPONENT_component.mflash_offchip
    
config MCUX_COMPONENT_driver.conn_fwloader_ns
    bool "conn_fwloader_ns"
    
config MCUX_COMPONENT_driver.conn_fwloader.monolithic
    bool "Monolithic application"
    help
        Enable the monolithic property. This will embedd 
        the CPU1/CPU2 FW in the main application.

if MCUX_COMPONENT_driver.conn_fwloader.monolithic

config MONOLITHIC_WIFI
    bool "Monolithic Wi-Fi"
    help
        Enable monolithic property for WIFI.

config MONOLITHIC_BLE
    bool "Monolithic BLE"
    help
        Enable monolithic property for BLE.

config MONOLITHIC_BLE_15_4
    bool "Monolithic BLE/15.4 combo"
    help
        Enable monolithic property for BLE+15.4 combo.

endif # MCUX_COMPONENT_driver.conn_fwloader.monolithic
```

## mcux/mcux-sdk-ng/components/flash/Kconfig
```kconfig
# Copyright 2024 NXP
# SPDX-License-Identifier: BSD-3-Clause

menu "Flash"
    rsource "mflash/Kconfig"
    config MCUX_COMPONENT_component.flash_nand_flexspi
        bool "Nand flash component based on flexspi"
        default n
        select MCUX_COMPONENT_driver.flexspi

        if MCUX_COMPONENT_component.flash_nand_flexspi

        endif


    config MCUX_COMPONENT_component.flash_nand_semc
        bool "Nand flash component based on semc"
        default n
        select MCUX_COMPONENT_driver.semc

        if MCUX_COMPONENT_component.flash_nand_semc

        endif


    config MCUX_COMPONENT_component.flash_nor_flexspi
        bool "Nor flash component based on flexspi"
        default n
        select MCUX_COMPONENT_driver.flexspi

        if MCUX_COMPONENT_component.flash_nor_flexspi

        endif

    config MCUX_COMPONENT_component.flash_nor_lpspi
        bool "Nor flash component based on lpspi"
        default n
        select MCUX_COMPONENT_driver.lpspi

        if MCUX_COMPONENT_component.flash_nor_lpspi

        endif

    config MCUX_COMPONENT_component.flash_nor_spifi
        bool "Nor flash component based on spifi"
        default n
        select MCUX_COMPONENT_driver.spifi

        if MCUX_COMPONENT_component.flash_nor_spifi

        endif

    config MCUX_COMPONENT_component.flash_nor_xspi
        bool "Nor flash component based on xspi"
        default n
        select MCUX_COMPONENT_driver.xspi

        if MCUX_COMPONENT_component.flash_nor_xspi

        endif
endmenu
```

## mcux/mcux-sdk-ng/components/flash/mflash/Kconfig
```kconfig
# Copyright 2024 NXP
#
# SPDX-License-Identifier: BSD-3-Clause

config MCUX_COMPONENT_component.mflash_onchip
    bool "Statically allocated file system for on chip mflash"
    default n
    select MCUX_COMPONENT_driver.flash if MCUX_HAS_COMPONENT_driver.flash
    select MCUX_COMPONENT_driver.cache_lmem if MCUX_HAS_COMPONENT_driver.cache_lmem
    select MCUX_COMPONENT_driver.iap1 if MCUX_HAS_COMPONENT_driver.iap1
    select MCUX_COMPONENT_driver.flashiap if MCUX_HAS_COMPONENT_driver.flashiap
    select MCUX_COMPONENT_driver.romapi if MCUX_HAS_COMPONENT_driver.romapi
    select MCUX_COMPONENT_driver.cache_armv7_m7 if MCUX_HAS_COMPONENT_driver.cache_armv7_m7
    select MCUX_COMPONENT_driver.cache_xcache if MCUX_HAS_COMPONENT_driver.cache_xcache
    select MCUX_COMPONENT_driver.mcm if MCUX_HAS_COMPONENT_driver.mcm
    select MCUX_COMPONENT_driver.flash_k4 if MCUX_HAS_COMPONENT_driver.flash_k4

config MCUX_COMPONENT_component.mflash_onchip_fmu
    bool "Statically allocated file system for on chip mflash via FMU controller"
    default n

config MCUX_COMPONENT_component.mflash_offchip
    bool "Statically allocated file system for off chip mflash"
    default n
    imply MCUX_COMPONENT_driver.cache_lmem if MCUX_HAS_COMPONENT_driver.cache_lmem
    imply MCUX_COMPONENT_driver.qspi if MCUX_HAS_COMPONENT_driver.qspi
    imply MCUX_COMPONENT_driver.spifi if MCUX_HAS_COMPONENT_driver.spifi
    imply MCUX_COMPONENT_driver.flashiap if MCUX_HAS_COMPONENT_driver.flashiap
    imply MCUX_COMPONENT_driver.flexspi if MCUX_HAS_COMPONENT_driver.flexspi
    imply MCUX_COMPONENT_driver.cache_cache64 if MCUX_HAS_COMPONENT_driver.cache_cache64
    imply MCUX_COMPONENT_driver.romapi if MCUX_HAS_COMPONENT_driver.romapi
    imply MCUX_COMPONENT_driver.cache_armv7_m7 if MCUX_HAS_COMPONENT_driver.cache_armv7_m7
    imply MCUX_COMPONENT_driver.cache_xcache if MCUX_HAS_COMPONENT_driver.cache_xcache
    imply MCUX_COMPONENT_driver.xspi if MCUX_HAS_COMPONENT_driver.xspi
```

## mcux/mcux-sdk-ng/components/lists/Kconfig
```kconfig
# Copyright 2024 NXP
# SPDX-License-Identifier: BSD-3-Clause

config MCUX_COMPONENT_component.lists
    # depends on MCUX_COMPONENT_component.lists
    bool "lists"
    select MCUX_COMPONENT_driver.common

if MCUX_COMPONENT_component.lists

endif
```

## mcux/mcux-sdk-ng/components/osa/Kconfig
```kconfig
# Copyright 2024 NXP
# SPDX-License-Identifier: BSD-3-Clause

config MCUX_COMPONENT_component.osa_template_config
    bool "OSA template configuration header file"
    default n
    help
        Not generate fsl_os_abstraction_config.h, users need use default template fsl_os_abstraction_config.h.

config MCUX_COMPONENT_component.osa_interface
    bool "osa interface"
    select MCUX_COMPONENT_driver.common
    select MCUX_COMPONENT_component.lists
    select MCUX_COMPONENT_component.osa_template_config

config MCUX_PRJSEG_component.osa_interface.generated_config
    bool "Generate OSA configuration header"
    default y
    depends on MCUX_COMPONENT_component.osa_interface
    help
        Generate the fsl_os_abstraction_config.h, otherwise users need to provide their
        own fsl_os_abstraction_config.h.

config MCUX_PRJSEG_component.osa_interface.osa_macro_used
    bool "OSA USED"
    default y
    depends on MCUX_COMPONENT_component.osa_interface
    help
        Add OSA_USED macro for component osa.

if MCUX_PRJSEG_component.osa_interface.generated_config
    menu "OSA(fsl_os_abstraction_config.h)"
        config gMainThreadStackSize_c
            int "gMainThreadStackSize_c"
            default 1024
            help
                No prefix in generated macro

        config gMainThreadPriority_c
            int "gMainThreadPriority_c"
            default 7
            help
                No prefix in generated macro

        config gTaskMultipleInstancesManagement_c
            int "gTaskMultipleInstancesManagement_c"
            default 0
            help
                No prefix in generated macro

        config FSL_OSA_TASK_ENABLE
            bool "FSL_OSA_TASK_ENABLE"
            default y
            help
                No prefix in generated macro

        config FSL_OSA_MAIN_FUNC_ENABLE
            bool "FSL_OSA_MAIN_FUNC_ENABLE"
            default n
            help
                No prefix in generated macro

        config FSL_OSA_BM_TIMEOUT_ENABLE
            bool "FSL_OSA_BM_TIMEOUT_ENABLE"
            default n
            help
                No prefix in generated macro

        config FSL_OSA_ALLOCATED_HEAP
            bool "FSL_OSA_ALLOCATED_HEAP"
            default y
            help
                No prefix in generated macro
    endmenu
endif

config MCUX_COMPONENT_component.osa
    bool "osa"
    select MCUX_COMPONENT_component.osa_interface
    help
        Enable component.osa component

    if MCUX_COMPONENT_component.osa
        choice MCUX_COMPONENT_component.osa.selection
            prompt "OSA selection"
            config MCUX_COMPONENT_component.osa_bm
                bool "component.osa_bm"
                depends on !MCUX_COMPONENT_middleware.freertos-kernel
                depends on !MCUX_COMPONENT_middleware.azure_rtos.tx
                depends on !MCUX_COMPONENT_middleware.zephyr
            config MCUX_COMPONENT_component.osa_free_rtos
                bool "component.osa_free_rtos"
                depends on MCUX_COMPONENT_middleware.freertos-kernel
            config MCUX_COMPONENT_component.osa_threadx
                bool "component.osa_threadx"
                depends on MCUX_COMPONENT_middleware.wireless.ble_controller_threadx
            config MCUX_COMPONENT_component.osa_zephyr
                bool "component.osa_zephyr"
                depends on MCUX_COMPONENT_middleware.zephyr
        endchoice
    endif
```

## mcux/mcux-sdk-ng/components/wifi_bt_module/Kconfig
```kconfig
# Copyright 2024 NXP
# SPDX-License-Identifier: BSD-3-Clause

menu "wifi_bt_module"
    config MCUX_COMPONENT_component.wifi_bt_module.tx_pwr_limits
        bool "tx_pwr_limits"
    config MCUX_COMPONENT_component.wifi_bt_module.config
        bool "config"
    config MCUX_COMPONENT_component.wifi_bt_module.board_rw61x
        bool "board_rw61x"
        default y if MCUX_HW_DEVICE_RW612 || MCUX_HW_DEVICE_RW610
endmenu
```

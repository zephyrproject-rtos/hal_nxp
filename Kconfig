## mcux/mcux-sdk-ng/devices/Kinetis/K/MK22F12810/drivers/Kconfig
```kconfig
# Copyright 2024 NXP
# All rights reserved.
#
# SPDX-License-Identifier: BSD-3-Clause

menu "Device specific drivers configuration"

    config MCUX_COMPONENT_driver.clock
         bool "Use driver clock"
         default y

endmenu
```

## mcux/mcux-sdk-ng/devices/Kinetis/K/MK22F51212/Kconfig.chip
```kconfig
# Copyright 2024 NXP
#
# SPDX-License-Identifier: BSD-3-Clause

# core related
config MCUX_HW_CORE
    string
    default "cm4f"

config MCUX_HW_CORE_CM4F
    bool
    default y

config MCUX_HW_CORE_ID
    string
    default "core0"

config MCUX_HW_CORE_ID_CORE0
    bool
    default y

config MCUX_HW_DEVICE_CORE
    string
    default "MK22F51212"

config MCUX_HW_FPU
    string
    default "SP_FPU"

config MCUX_HW_FPU_TYPE
    string
    default "fpv4_sp"

config MCUX_HW_FPV4_SP
    bool
    default y

config MCUX_HW_INT_PRIO_BITS
    int
    default 4

config MCUX_HW_SOC_SERIES_KINETIS
    bool
    default y

config MCUX_HW_SOC_SINGLECORE_DEVICE
    bool
    default y

# device related

config MCUX_HW_DEVICE_ID_MK22FN512xxx12
    bool

choice
    prompt "Device MK22F51212 Part"
    config MCUX_HW_DEVICE_PART_MK22FN512VDC12
    bool "Device part MK22FN512VDC12"
    select MCUX_HW_DEVICE_ID_MK22FN512xxx12
    config MCUX_HW_DEVICE_PART_MK22FN512VLL12
    bool "Device part MK22FN512VLL12"
    select MCUX_HW_DEVICE_ID_MK22FN512xxx12
    config MCUX_HW_DEVICE_PART_MK22FN512VLH12
    bool "Device part MK22FN512VLH12"
    select MCUX_HW_DEVICE_ID_MK22FN512xxx12
    config MCUX_HW_DEVICE_PART_MK22FN512VFX12
    bool "Device part MK22FN512VFX12"
    select MCUX_HW_DEVICE_ID_MK22FN512xxx12
    config MCUX_HW_DEVICE_PART_MK22FN512CAP12
    bool "Device part MK22FN512CAP12"
    select MCUX_HW_DEVICE_ID_MK22FN512xxx12
    config MCUX_HW_DEVICE_PART_MK22FN512VMP12
    bool "Device part MK22FN512VMP12"
    select MCUX_HW_DEVICE_ID_MK22FN512xxx12
endchoice

config MCUX_HW_DEVICE_ID
    string
    default "MK22FN512xxx12" if MCUX_HW_DEVICE_ID_MK22FN512xxx12

config MCUX_HW_DEVICE_PART
    string
    default "MK22FN512VDC12" if MCUX_HW_DEVICE_PART_MK22FN512VDC12
    default "MK22FN512VLL12" if MCUX_HW_DEVICE_PART_MK22FN512VLL12
    default "MK22FN512VLH12" if MCUX_HW_DEVICE_PART_MK22FN512VLH12
    default "MK22FN512VFX12" if MCUX_HW_DEVICE_PART_MK22FN512VFX12
    default "MK22FN512CAP12" if MCUX_HW_DEVICE_PART_MK22FN512CAP12
    default "MK22FN512VMP12" if MCUX_HW_DEVICE_PART_MK22FN512VMP12

# For chipmodel generated files
config MCUX_TOOLCHAIN_LINKER_DEVICE_PREFIX
    string
    default "MK22FN512xxx12" if MCUX_HW_DEVICE_ID_MK22FN512xxx12

config MCUX_TOOLCHAIN_MCUX_STARTUP
    string
    default "mk22f51212"

# Toolchain related

config MCUX_TOOLCHAIN_IAR_CPU_IDENTIFIER
    string
    default "MK22FN512xxx12" if MCUX_HW_DEVICE_ID_MK22FN512xxx12

config MCUX_TOOLCHAIN_MDK_CPU_IDENTIFIER
    string
    default "MK22FN512VDC12" if MCUX_HW_DEVICE_PART_MK22FN512VDC12
    default "MK22FN512VLL12" if MCUX_HW_DEVICE_PART_MK22FN512VLL12
    default "MK22FN512VLH12" if MCUX_HW_DEVICE_PART_MK22FN512VLH12
    default "MK22FN512VFX12" if MCUX_HW_DEVICE_PART_MK22FN512VFX12
    default "MK22FN512CAP12" if MCUX_HW_DEVICE_PART_MK22FN512CAP12
    default "MK22FN512VMP12" if MCUX_HW_DEVICE_PART_MK22FN512VMP12

config MCUX_TOOLCHAIN_JLINK_CPU_IDENTIFIER
    string
    default "MK22FN512xxx12"

# ip information
config MCUX_HW_IP_DriverType_ADC16
    bool
    default y
    depends on MCUX_HW_DEVICE_ID_MK22FN512xxx12

config MCUX_HW_IP_DriverType_AIPS
    bool
    default y
    depends on MCUX_HW_DEVICE_ID_MK22FN512xxx12

config MCUX_HW_IP_DriverType_AXBS
    bool
    default y
    depends on MCUX_HW_DEVICE_ID_MK22FN512xxx12

config MCUX_HW_IP_DriverType_CMP
    bool
    default y
    depends on MCUX_HW_DEVICE_ID_MK22FN512xxx12

config MCUX_HW_IP_DriverType_CRC
    bool
    default y
    depends on MCUX_HW_DEVICE_ID_MK22FN512xxx12

config MCUX_HW_IP_DriverType_DAC
    bool
    default y
    depends on MCUX_HW_DEVICE_ID_MK22FN512xxx12

config MCUX_HW_IP_DriverType_DMAMUX
    bool
    default y
    depends on MCUX_HW_DEVICE_ID_MK22FN512xxx12

config MCUX_HW_IP_DriverType_DSPI
    bool
    default y
    depends on MCUX_HW_DEVICE_ID_MK22FN512xxx12

config MCUX_HW_IP_DriverType_EDMA
    bool
    default y
    depends on MCUX_HW_DEVICE_ID_MK22FN512xxx12

config MCUX_HW_IP_DriverType_EWM
    bool
    default y
    depends on MCUX_HW_DEVICE_ID_MK22FN512xxx12

config MCUX_HW_IP_DriverType_EzPort
    bool
    default y
    depends on MCUX_HW_DEVICE_ID_MK22FN512xxx12

config MCUX_HW_IP_DriverType_FB
    bool
    default y
    depends on MCUX_HW_DEVICE_ID_MK22FN512xxx12

config MCUX_HW_IP_DriverType_FMC
    bool
    default y
    depends on MCUX_HW_DEVICE_ID_MK22FN512xxx12

config MCUX_HW_IP_DriverType_FTFA
    bool
    default y
    depends on MCUX_HW_DEVICE_ID_MK22FN512xxx12

config MCUX_HW_IP_DriverType_FTM
    bool
    default y
    depends on MCUX_HW_DEVICE_ID_MK22FN512xxx12

config MCUX_HW_IP_DriverType_GPIO
    bool
    default y
    depends on MCUX_HW_DEVICE_ID_MK22FN512xxx12

config MCUX_HW_IP_DriverType_I2C
    bool
    default y
    depends on MCUX_HW_DEVICE_ID_MK22FN512xxx12

config MCUX_HW_IP_DriverType_LLWU
    bool
    default y
    depends on MCUX_HW_DEVICE_ID_MK22FN512xxx12

config MCUX_HW_IP_DriverType_LPTMR
    bool
    default y
    depends on MCUX_HW_DEVICE_ID_MK22FN512xxx12

config MCUX_HW_IP_DriverType_LPUART
    bool
    default y
    depends on MCUX_HW_DEVICE_ID_MK22FN512xxx12

config MCUX_HW_IP_DriverType_MCG
    bool
    default y
    depends on MCUX_HW_DEVICE_ID_MK22FN512xxx12

config MCUX_HW_IP_DriverType_MCM
    bool
    default y
    depends on MCUX_HW_DEVICE_ID_MK22FN512xxx12

config MCUX_HW_IP_DriverType_NV
    bool
    default y
    depends on MCUX_HW_DEVICE_ID_MK22FN512xxx12

config MCUX_HW_IP_DriverType_OSC
    bool
    default y
    depends on MCUX_HW_DEVICE_ID_MK22FN512xxx12

config MCUX_HW_IP_DriverType_PDB
    bool
    default y
    depends on MCUX_HW_DEVICE_ID_MK22FN512xxx12

config MCUX_HW_IP_DriverType_PIT
    bool
    default y
    depends on MCUX_HW_DEVICE_ID_MK22FN512xxx12

config MCUX_HW_IP_DriverType_PMC
    bool
    default y
    depends on MCUX_HW_DEVICE_ID_MK22FN512xxx12

config MCUX_HW_IP_DriverType_PORT
    bool
    default y
    depends on MCUX_HW_DEVICE_ID_MK22FN512xxx12

config MCUX_HW_IP_DriverType_RCM
    bool
    default y
    depends on MCUX_HW_DEVICE_ID_MK22FN512xxx12

config MCUX_HW_IP_DriverType_RFSYS
    bool
    default y
    depends on MCUX_HW_DEVICE_ID_MK22FN512xxx12

config MCUX_HW_IP_DriverType_RFVBAT
    bool
    default y
    depends on MCUX_HW_DEVICE_ID_MK22FN512xxx12

config MCUX_HW_IP_DriverType_RNGA
    bool
    default y
    depends on MCUX_HW_DEVICE_ID_MK22FN512xxx12

config MCUX_HW_IP_DriverType_SAI
    bool
    default y
    depends on MCUX_HW_DEVICE_ID_MK22FN512xxx12

config MCUX_HW_IP_DriverType_SIM
    bool
    default y
    depends on MCUX_HW_DEVICE_ID_MK22FN512xxx12

config MCUX_HW_IP_DriverType_SMC
    bool
    default y
    depends on MCUX_HW_DEVICE_ID_MK22FN512xxx12

config MCUX_HW_IP_DriverType_SRTC
    bool
    default y
    depends on MCUX_HW_DEVICE_ID_MK22FN512xxx12

config MCUX_HW_IP_DriverType_UART_ISO7816
    bool
    default y
    depends on MCUX_HW_DEVICE_ID_MK22FN512xxx12

config MCUX_HW_IP_DriverType_USB_HOST_DEVICE_KHCI
    bool
    default y
    depends on MCUX_HW_DEVICE_ID_MK22FN512xxx12

config MCUX_HW_IP_DriverType_VREF
    bool
    default y
    depends on MCUX_HW_DEVICE_ID_MK22FN512xxx12

config MCUX_HW_IP_DriverType_WDOG
    bool
    default y
    depends on MCUX_HW_DEVICE_ID_MK22FN512xxx12
```

## mcux/mcux-sdk-ng/devices/Kinetis/K32L/K32L2A31A/Kconfig
```kconfig
# Copyright 2024 NXP
# All rights reserved.
#
# SPDX-License-Identifier: BSD-3-Clause

rsource "Kconfig.chip"
rsource "drivers/Kconfig"
rsource "../../../arm/Kconfig.common"
rsource "Kconfig.defconfig"

## Project segment and component dependency data
config MCUX_HW_DEVICE_K32L2A31A
    # bool "Device K32L2A31A Configuration"
    bool
    default y

    # component dependency
    select MCUX_COMPONENT_driver.dmamux if MCUX_COMPONENT_device.RTE
    select MCUX_COMPONENT_driver.edma if MCUX_COMPONENT_device.RTE
    select MCUX_COMPONENT_driver.edma if MCUX_COMPONENT_driver.lpi2c_edma
    select MCUX_COMPONENT_driver.edma if MCUX_COMPONENT_driver.lpspi_edma
    select MCUX_COMPONENT_driver.edma if MCUX_COMPONENT_driver.lpuart_edma
    select MCUX_COMPONENT_component.lpuart_adapter if MCUX_COMPONENT_component.serial_manager_uart
    select MCUX_COMPONENT_component.lpuart_adapter if MCUX_COMPONENT_utility.debug_console_lite
    select MCUX_COMPONENT_driver.lpspi_edma if MCUX_COMPONENT_driver.cmsis_lpspi
    select MCUX_COMPONENT_driver.lpi2c_edma if MCUX_COMPONENT_driver.cmsis_lpi2c
    select MCUX_COMPONENT_driver.lpuart_edma if MCUX_COMPONENT_driver.cmsis_lpuart
    select MCUX_COMPONENT_driver.edma if MCUX_COMPONENT_driver.flexio_camera_edma
    select MCUX_COMPONENT_driver.edma if MCUX_COMPONENT_driver.flexio_i2s_edma
    select MCUX_COMPONENT_driver.edma if MCUX_COMPONENT_driver.flexio_mculcd_edma
    select MCUX_COMPONENT_driver.edma if MCUX_COMPONENT_driver.flexio_spi_edma
    select MCUX_COMPONENT_driver.edma if MCUX_COMPONENT_driver.flexio_uart_edma
```

## mcux/mcux-sdk-ng/devices/Kinetis/K32L/K32L2A31A/drivers/Kconfig
```kconfig
# Copyright 2024 NXP
# All rights reserved.
#
# SPDX-License-Identifier: BSD-3-Clause

rsource "../../K32L2A41A/drivers/Kconfig"
```

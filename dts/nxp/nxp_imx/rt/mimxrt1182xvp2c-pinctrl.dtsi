/*
 * Copyright 2025, NXP
 * SPDX-License-Identifier: Apache-2.0
 *
 * Note: File generated by gen_soc_headers.py
 * from configuration data for MIMXRT1182XVP2C
 */

/*
 * SOC level pinctrl defintions
 * These definitions define SOC level defaults for each pin,
 * and select the pinmux for the pin. Pinmux entries are a tuple of:
 * <mux_register mux_mode input_register input_daisy config_register>
 * the mux_register and input_daisy reside in the IOMUXC peripheral, and
 * the pinctrl driver will write the mux_mode and input_daisy values into
 * each register, respectively. The config_register is used to configure
 * the pin based on the devicetree properties set
 */

&iomuxc {
	/omit-if-no-ref/ iomuxc_gpio_ad_12_adc1_ch2a: IOMUXC_GPIO_AD_12_ADC1_CH2A {
		pinmux = <0x42a1013c 5 0x0 0 0x42a10384>;
		pin-pue;
	};
	/omit-if-no-ref/ iomuxc_gpio_ad_12_ewm_out_b: IOMUXC_GPIO_AD_12_EWM_OUT_B {
		pinmux = <0x42a1013c 7 0x0 0 0x42a10384>;
		pin-pue;
	};
	/omit-if-no-ref/ iomuxc_gpio_ad_12_flexio2_d12: IOMUXC_GPIO_AD_12_FLEXIO2_D12 {
		pinmux = <0x42a1013c 8 0x0 0 0x42a10384>;
		pin-pue;
	};
	/omit-if-no-ref/ iomuxc_gpio_ad_12_gpio4_io12: IOMUXC_GPIO_AD_12_GPIO4_IO12 {
		pinmux = <0x42a1013c 5 0x0 0 0x42a10384>;
		pin-pue;
	};
	/omit-if-no-ref/ iomuxc_gpio_ad_12_gpt1_capture1: IOMUXC_GPIO_AD_12_GPT1_CAPTURE1 {
		pinmux = <0x42a1013c 2 0x0 0 0x42a10384>;
		pin-pue;
	};
	/omit-if-no-ref/ iomuxc_gpio_ad_12_kpp_row7: IOMUXC_GPIO_AD_12_KPP_ROW7 {
		pinmux = <0x42a1013c 3 0x42a105e4 1 0x42a10384>;
		pin-pue;
	};
	/omit-if-no-ref/ iomuxc_gpio_ad_12_spdif_lock: IOMUXC_GPIO_AD_12_SPDIF_LOCK {
		pinmux = <0x42a1013c 0 0x0 0 0x42a10384>;
		pin-pue;
	};
	/omit-if-no-ref/ iomuxc_gpio_ad_12_xbar_inout18: IOMUXC_GPIO_AD_12_XBAR_INOUT18 {
		pinmux = <0x42a1013c 6 0x42a10940 0 0x42a10384>;
		pin-pue;
	};
	/omit-if-no-ref/ iomuxc_gpio_ad_13_adc1_ch2b: IOMUXC_GPIO_AD_13_ADC1_CH2B {
		pinmux = <0x42a10140 5 0x0 0 0x42a10388>;
		pin-pue;
	};
	/omit-if-no-ref/ iomuxc_gpio_ad_13_flexio2_d13: IOMUXC_GPIO_AD_13_FLEXIO2_D13 {
		pinmux = <0x42a10140 8 0x0 0 0x42a10388>;
		pin-pue;
	};
	/omit-if-no-ref/ iomuxc_gpio_ad_13_gpio4_io13: IOMUXC_GPIO_AD_13_GPIO4_IO13 {
		pinmux = <0x42a10140 5 0x0 0 0x42a10388>;
		pin-pue;
	};
	/omit-if-no-ref/ iomuxc_gpio_ad_13_gpt1_capture2: IOMUXC_GPIO_AD_13_GPT1_CAPTURE2 {
		pinmux = <0x42a10140 2 0x0 0 0x42a10388>;
		pin-pue;
	};
	/omit-if-no-ref/ iomuxc_gpio_ad_13_kpp_col7: IOMUXC_GPIO_AD_13_KPP_COL7 {
		pinmux = <0x42a10140 3 0x42a105c4 1 0x42a10388>;
		pin-pue;
	};
	/omit-if-no-ref/ iomuxc_gpio_ad_13_lpuart3_txd: IOMUXC_GPIO_AD_13_LPUART3_TXD {
		pinmux = <0x42a10140 6 0x42a10684 1 0x42a10388>;
		pin-pue;
	};
	/omit-if-no-ref/ iomuxc_gpio_ad_13_spdif_sr_clk: IOMUXC_GPIO_AD_13_SPDIF_SR_CLK {
		pinmux = <0x42a10140 0 0x0 0 0x42a10388>;
		pin-pue;
	};
	/omit-if-no-ref/ iomuxc_gpio_ad_13_usdhc2_cd_b: IOMUXC_GPIO_AD_13_USDHC2_CD_B {
		pinmux = <0x42a10140 7 0x42a1092c 1 0x42a10388>;
		pin-pue;
	};
	/omit-if-no-ref/ iomuxc_gpio_ad_14_adc1_ch1a: IOMUXC_GPIO_AD_14_ADC1_CH1A {
		pinmux = <0x42a10144 5 0x0 0 0x42a1038c>;
		pin-pue;
	};
	/omit-if-no-ref/ iomuxc_gpio_ad_14_flexio2_d14: IOMUXC_GPIO_AD_14_FLEXIO2_D14 {
		pinmux = <0x42a10144 8 0x0 0 0x42a1038c>;
		pin-pue;
	};
	/omit-if-no-ref/ iomuxc_gpio_ad_14_flexpwm3_pwm0_x: IOMUXC_GPIO_AD_14_FLEXPWM3_PWM0_X {
		pinmux = <0x42a10144 4 0x0 0 0x42a1038c>;
		pin-pue;
	};
	/omit-if-no-ref/ iomuxc_gpio_ad_14_gpio4_io14: IOMUXC_GPIO_AD_14_GPIO4_IO14 {
		pinmux = <0x42a10144 5 0x0 0 0x42a1038c>;
		pin-pue;
	};
	/omit-if-no-ref/ iomuxc_gpio_ad_14_gpt1_compare1: IOMUXC_GPIO_AD_14_GPT1_COMPARE1 {
		pinmux = <0x42a10144 2 0x0 0 0x42a1038c>;
		pin-pue;
	};
	/omit-if-no-ref/ iomuxc_gpio_ad_14_kpp_row6: IOMUXC_GPIO_AD_14_KPP_ROW6 {
		pinmux = <0x42a10144 3 0x42a105e0 1 0x42a1038c>;
		pin-pue;
	};
	/omit-if-no-ref/ iomuxc_gpio_ad_14_lpuart3_rxd: IOMUXC_GPIO_AD_14_LPUART3_RXD {
		pinmux = <0x42a10144 6 0x42a10680 1 0x42a1038c>;
		pin-pue;
	};
	/omit-if-no-ref/ iomuxc_gpio_ad_14_spdif_ext_clk: IOMUXC_GPIO_AD_14_SPDIF_EXT_CLK {
		pinmux = <0x42a10144 0 0x0 0 0x42a1038c>;
		pin-pue;
	};
	/omit-if-no-ref/ iomuxc_gpio_ad_14_usdhc2_wp: IOMUXC_GPIO_AD_14_USDHC2_WP {
		pinmux = <0x42a10144 7 0x42a10930 1 0x42a1038c>;
		pin-pue;
	};
	/omit-if-no-ref/ iomuxc_gpio_ad_15_adc1_ch1b: IOMUXC_GPIO_AD_15_ADC1_CH1B {
		pinmux = <0x42a10148 5 0x0 0 0x42a10390>;
		pin-pue;
	};
	/omit-if-no-ref/ iomuxc_gpio_ad_15_clkout25m: IOMUXC_GPIO_AD_15_CLKOUT25M {
		pinmux = <0x42a10148 12 0x0 0 0x42a10390>;
		pin-pue;
	};
	/omit-if-no-ref/ iomuxc_gpio_ad_15_flexcan1_tx: IOMUXC_GPIO_AD_15_FLEXCAN1_TX {
		pinmux = <0x42a10148 9 0x0 0 0x42a10390>;
		pin-pue;
	};
	/omit-if-no-ref/ iomuxc_gpio_ad_15_flexio2_d15: IOMUXC_GPIO_AD_15_FLEXIO2_D15 {
		pinmux = <0x42a10148 8 0x0 0 0x42a10390>;
		pin-pue;
	};
	/omit-if-no-ref/ iomuxc_gpio_ad_15_flexpwm3_pwm1_x: IOMUXC_GPIO_AD_15_FLEXPWM3_PWM1_X {
		pinmux = <0x42a10148 4 0x0 0 0x42a10390>;
		pin-pue;
	};
	/omit-if-no-ref/ iomuxc_gpio_ad_15_gpio4_io15: IOMUXC_GPIO_AD_15_GPIO4_IO15 {
		pinmux = <0x42a10148 5 0x0 0 0x42a10390>;
		pin-pue;
	};
	/omit-if-no-ref/ iomuxc_gpio_ad_15_gpt1_compare2: IOMUXC_GPIO_AD_15_GPT1_COMPARE2 {
		pinmux = <0x42a10148 2 0x0 0 0x42a10390>;
		pin-pue;
	};
	/omit-if-no-ref/ iomuxc_gpio_ad_15_kpp_col6: IOMUXC_GPIO_AD_15_KPP_COL6 {
		pinmux = <0x42a10148 3 0x42a105c0 1 0x42a10390>;
		pin-pue;
	};
	/omit-if-no-ref/ iomuxc_gpio_ad_15_lpspi3_pcs1: IOMUXC_GPIO_AD_15_LPSPI3_PCS1 {
		pinmux = <0x42a10148 7 0x42a1060c 1 0x42a10390>;
		pin-pue;
	};
	/omit-if-no-ref/ iomuxc_gpio_ad_15_lpuart3_cts_b: IOMUXC_GPIO_AD_15_LPUART3_CTS_B {
		pinmux = <0x42a10148 6 0x42a1067c 1 0x42a10390>;
		pin-pue;
	};
	/omit-if-no-ref/ iomuxc_gpio_ad_15_spdif_in: IOMUXC_GPIO_AD_15_SPDIF_IN {
		pinmux = <0x42a10148 0 0x42a10908 1 0x42a10390>;
		pin-pue;
	};
	/omit-if-no-ref/ iomuxc_gpio_ad_16_adc1_ch0a: IOMUXC_GPIO_AD_16_ADC1_CH0A {
		pinmux = <0x42a1014c 5 0x0 0 0x42a10394>;
		pin-pue;
	};
	/omit-if-no-ref/ iomuxc_gpio_ad_16_ecat_link_mii_0: IOMUXC_GPIO_AD_16_ECAT_LINK_MII_0 {
		pinmux = <0x42a1014c 12 0x0 0 0x42a10394>;
		pin-pue;
	};
	/omit-if-no-ref/ iomuxc_gpio_ad_16_flexcan1_rx: IOMUXC_GPIO_AD_16_FLEXCAN1_RX {
		pinmux = <0x42a1014c 9 0x42a104a0 0 0x42a10394>;
		pin-pue;
	};
	/omit-if-no-ref/ iomuxc_gpio_ad_16_flexio2_d16: IOMUXC_GPIO_AD_16_FLEXIO2_D16 {
		pinmux = <0x42a1014c 8 0x0 0 0x42a10394>;
		pin-pue;
	};
	/omit-if-no-ref/ iomuxc_gpio_ad_16_flexpwm3_pwm2_x: IOMUXC_GPIO_AD_16_FLEXPWM3_PWM2_X {
		pinmux = <0x42a1014c 4 0x0 0 0x42a10394>;
		pin-pue;
	};
	/omit-if-no-ref/ iomuxc_gpio_ad_16_gpio4_io16: IOMUXC_GPIO_AD_16_GPIO4_IO16 {
		pinmux = <0x42a1014c 5 0x0 0 0x42a10394>;
		pin-pue;
	};
	/omit-if-no-ref/ iomuxc_gpio_ad_16_gpt1_compare3: IOMUXC_GPIO_AD_16_GPT1_COMPARE3 {
		pinmux = <0x42a1014c 2 0x0 0 0x42a10394>;
		pin-pue;
	};
	/omit-if-no-ref/ iomuxc_gpio_ad_16_kpp_row5: IOMUXC_GPIO_AD_16_KPP_ROW5 {
		pinmux = <0x42a1014c 3 0x42a105dc 1 0x42a10394>;
		pin-pue;
	};
	/omit-if-no-ref/ iomuxc_gpio_ad_16_lpspi3_sck: IOMUXC_GPIO_AD_16_LPSPI3_SCK {
		pinmux = <0x42a1014c 7 0x42a10618 1 0x42a10394>;
		pin-pue;
	};
	/omit-if-no-ref/ iomuxc_gpio_ad_16_lpuart3_rts_b: IOMUXC_GPIO_AD_16_LPUART3_RTS_B {
		pinmux = <0x42a1014c 6 0x0 0 0x42a10394>;
		pin-pue;
	};
	/omit-if-no-ref/ iomuxc_gpio_ad_16_spdif_out: IOMUXC_GPIO_AD_16_SPDIF_OUT {
		pinmux = <0x42a1014c 0 0x0 0 0x42a10394>;
		pin-pue;
	};
	/omit-if-no-ref/ iomuxc_gpio_ad_17_adc1_ch0b: IOMUXC_GPIO_AD_17_ADC1_CH0B {
		pinmux = <0x42a10150 5 0x0 0 0x42a10398>;
		pin-pue;
	};
	/omit-if-no-ref/ iomuxc_gpio_ad_17_ecat_link_mii_1: IOMUXC_GPIO_AD_17_ECAT_LINK_MII_1 {
		pinmux = <0x42a10150 12 0x0 0 0x42a10398>;
		pin-pue;
	};
	/omit-if-no-ref/ iomuxc_gpio_ad_17_flexio2_d17: IOMUXC_GPIO_AD_17_FLEXIO2_D17 {
		pinmux = <0x42a10150 8 0x0 0 0x42a10398>;
		pin-pue;
	};
	/omit-if-no-ref/ iomuxc_gpio_ad_17_flexpwm3_pwm3_x: IOMUXC_GPIO_AD_17_FLEXPWM3_PWM3_X {
		pinmux = <0x42a10150 4 0x0 0 0x42a10398>;
		pin-pue;
	};
	/omit-if-no-ref/ iomuxc_gpio_ad_17_gpio4_io17: IOMUXC_GPIO_AD_17_GPIO4_IO17 {
		pinmux = <0x42a10150 5 0x0 0 0x42a10398>;
		pin-pue;
	};
	/omit-if-no-ref/ iomuxc_gpio_ad_17_gpt1_clk: IOMUXC_GPIO_AD_17_GPT1_CLK {
		pinmux = <0x42a10150 2 0x0 0 0x42a10398>;
		pin-pue;
	};
	/omit-if-no-ref/ iomuxc_gpio_ad_17_i3c2_pur: IOMUXC_GPIO_AD_17_I3C2_PUR {
		pinmux = <0x42a10150 6 0x0 0 0x42a10398>;
		pin-pue;
	};
	/omit-if-no-ref/ iomuxc_gpio_ad_17_kpp_col5: IOMUXC_GPIO_AD_17_KPP_COL5 {
		pinmux = <0x42a10150 3 0x42a105bc 1 0x42a10398>;
		pin-pue;
	};
	/omit-if-no-ref/ iomuxc_gpio_ad_17_lpi2c3_hreq: IOMUXC_GPIO_AD_17_LPI2C3_HREQ {
		pinmux = <0x42a10150 9 0x0 0 0x42a10398>;
		pin-pue;
	};
	/omit-if-no-ref/ iomuxc_gpio_ad_17_lpspi3_pcs0: IOMUXC_GPIO_AD_17_LPSPI3_PCS0 {
		pinmux = <0x42a10150 7 0x42a10608 1 0x42a10398>;
		pin-pue;
	};
	/omit-if-no-ref/ iomuxc_gpio_ad_18_adc2_ch0a: IOMUXC_GPIO_AD_18_ADC2_CH0A {
		pinmux = <0x42a10154 5 0x0 0 0x42a1039c>;
		pin-pue;
	};
	/omit-if-no-ref/ iomuxc_gpio_ad_18_ecat_scl: IOMUXC_GPIO_AD_18_ECAT_SCL {
		pinmux = <0x42a10154 12 0x0 0 0x42a1039c>;
		pin-pue;
	};
	/omit-if-no-ref/ iomuxc_gpio_ad_18_flexio2_d18: IOMUXC_GPIO_AD_18_FLEXIO2_D18 {
		pinmux = <0x42a10154 8 0x0 0 0x42a1039c>;
		pin-pue;
	};
	/omit-if-no-ref/ iomuxc_gpio_ad_18_flexpwm4_pwm0_x: IOMUXC_GPIO_AD_18_FLEXPWM4_PWM0_X {
		pinmux = <0x42a10154 4 0x0 0 0x42a1039c>;
		pin-pue;
	};
	/omit-if-no-ref/ iomuxc_gpio_ad_18_gpio4_io18: IOMUXC_GPIO_AD_18_GPIO4_IO18 {
		pinmux = <0x42a10154 5 0x0 0 0x42a1039c>;
		pin-pue;
	};
	/omit-if-no-ref/ iomuxc_gpio_ad_18_i3c2_scl: IOMUXC_GPIO_AD_18_I3C2_SCL {
		pinmux = <0x42a10154 6 0x42a105a0 0 0x42a1039c>;
		pin-pue;
	};
	/omit-if-no-ref/ iomuxc_gpio_ad_18_kpp_row4: IOMUXC_GPIO_AD_18_KPP_ROW4 {
		pinmux = <0x42a10154 3 0x42a105d8 1 0x42a1039c>;
		pin-pue;
	};
	/omit-if-no-ref/ iomuxc_gpio_ad_18_lpi2c3_scl: IOMUXC_GPIO_AD_18_LPI2C3_SCL {
		pinmux = <0x42a10154 9 0x42a105e8 2 0x42a1039c>;
		pin-pue;
	};
	/omit-if-no-ref/ iomuxc_gpio_ad_18_lpspi3_sout: IOMUXC_GPIO_AD_18_LPSPI3_SOUT {
		pinmux = <0x42a10154 7 0x42a10620 1 0x42a1039c>;
		pin-pue;
	};
	/omit-if-no-ref/ iomuxc_gpio_ad_18_lpuart5_ri_b: IOMUXC_GPIO_AD_18_LPUART5_RI_B {
		pinmux = <0x42a10154 2 0x42a10698 0 0x42a1039c>;
		pin-pue;
	};
	/omit-if-no-ref/ iomuxc_gpio_ad_19_acmp3_out: IOMUXC_GPIO_AD_19_ACMP3_OUT {
		pinmux = <0x42a10158 1 0x0 0 0x42a103a0>;
		pin-pue;
	};
	/omit-if-no-ref/ iomuxc_gpio_ad_19_adc2_ch0b: IOMUXC_GPIO_AD_19_ADC2_CH0B {
		pinmux = <0x42a10158 5 0x0 0 0x42a103a0>;
		pin-pue;
	};
	/omit-if-no-ref/ iomuxc_gpio_ad_19_ecat_sda: IOMUXC_GPIO_AD_19_ECAT_SDA {
		pinmux = <0x42a10158 12 0x42a104f0 0 0x42a103a0>;
		pin-pue;
	};
	/omit-if-no-ref/ iomuxc_gpio_ad_19_flexio2_d19: IOMUXC_GPIO_AD_19_FLEXIO2_D19 {
		pinmux = <0x42a10158 8 0x0 0 0x42a103a0>;
		pin-pue;
	};
	/omit-if-no-ref/ iomuxc_gpio_ad_19_flexpwm4_pwm1_x: IOMUXC_GPIO_AD_19_FLEXPWM4_PWM1_X {
		pinmux = <0x42a10158 4 0x0 0 0x42a103a0>;
		pin-pue;
	};
	/omit-if-no-ref/ iomuxc_gpio_ad_19_gpio4_io19: IOMUXC_GPIO_AD_19_GPIO4_IO19 {
		pinmux = <0x42a10158 5 0x0 0 0x42a103a0>;
		pin-pue;
	};
	/omit-if-no-ref/ iomuxc_gpio_ad_19_i3c2_sda: IOMUXC_GPIO_AD_19_I3C2_SDA {
		pinmux = <0x42a10158 6 0x42a105a4 0 0x42a103a0>;
		pin-pue;
	};
	/omit-if-no-ref/ iomuxc_gpio_ad_19_kpp_col4: IOMUXC_GPIO_AD_19_KPP_COL4 {
		pinmux = <0x42a10158 3 0x42a105b8 1 0x42a103a0>;
		pin-pue;
	};
	/omit-if-no-ref/ iomuxc_gpio_ad_19_lpi2c3_sda: IOMUXC_GPIO_AD_19_LPI2C3_SDA {
		pinmux = <0x42a10158 9 0x42a105ec 2 0x42a103a0>;
		pin-pue;
	};
	/omit-if-no-ref/ iomuxc_gpio_ad_19_lpspi3_sin: IOMUXC_GPIO_AD_19_LPSPI3_SIN {
		pinmux = <0x42a10158 7 0x42a1061c 1 0x42a103a0>;
		pin-pue;
	};
	/omit-if-no-ref/ iomuxc_gpio_ad_19_xbar_inout19: IOMUXC_GPIO_AD_19_XBAR_INOUT19 {
		pinmux = <0x42a10158 2 0x42a10944 0 0x42a103a0>;
		pin-pue;
	};
	/omit-if-no-ref/ iomuxc_gpio_ad_29_acmp3_in2: IOMUXC_GPIO_AD_29_ACMP3_IN2 {
		pinmux = <0x42a10180 5 0x0 0 0x42a103c8>;
		pin-pue;
	};
	/omit-if-no-ref/ iomuxc_gpio_ad_29_adc2_ch5b: IOMUXC_GPIO_AD_29_ADC2_CH5B {
		pinmux = <0x42a10180 5 0x0 0 0x42a103c8>;
		pin-pue;
	};
	/omit-if-no-ref/ iomuxc_gpio_ad_29_ewm_out_b: IOMUXC_GPIO_AD_29_EWM_OUT_B {
		pinmux = <0x42a10180 7 0x0 0 0x42a103c8>;
		pin-pue;
	};
	/omit-if-no-ref/ iomuxc_gpio_ad_29_flexio2_d29: IOMUXC_GPIO_AD_29_FLEXIO2_D29 {
		pinmux = <0x42a10180 8 0x0 0 0x42a103c8>;
		pin-pue;
	};
	/omit-if-no-ref/ iomuxc_gpio_ad_29_gpio4_io29: IOMUXC_GPIO_AD_29_GPIO4_IO29 {
		pinmux = <0x42a10180 5 0x0 0 0x42a103c8>;
		pin-pue;
	};
	/omit-if-no-ref/ iomuxc_gpio_ad_29_kpp_col3: IOMUXC_GPIO_AD_29_KPP_COL3 {
		pinmux = <0x42a10180 6 0x42a105b4 1 0x42a103c8>;
		pin-pue;
	};
	/omit-if-no-ref/ iomuxc_gpio_ad_29_lpspi5_pcs0: IOMUXC_GPIO_AD_29_LPSPI5_PCS0 {
		pinmux = <0x42a10180 0 0x42a10634 2 0x42a103c8>;
		pin-pue;
	};
	/omit-if-no-ref/ iomuxc_gpio_ad_29_mic_bitstream1: IOMUXC_GPIO_AD_29_MIC_BITSTREAM1 {
		pinmux = <0x42a10180 12 0x42a106d4 1 0x42a103c8>;
		pin-pue;
	};
	/omit-if-no-ref/ iomuxc_gpio_ad_29_sinc2_embit1: IOMUXC_GPIO_AD_29_SINC2_EMBIT1 {
		pinmux = <0x42a10180 3 0x0 0 0x42a103c8>;
		pin-pue;
	};
	/omit-if-no-ref/ iomuxc_gpio_ad_29_usdhc2_cd_b: IOMUXC_GPIO_AD_29_USDHC2_CD_B {
		pinmux = <0x42a10180 2 0x42a1092c 3 0x42a103c8>;
		pin-pue;
	};
	/omit-if-no-ref/ iomuxc_gpio_ad_29_usdhc2_vselect: IOMUXC_GPIO_AD_29_USDHC2_VSELECT {
		pinmux = <0x42a10180 9 0x0 0 0x42a103c8>;
		pin-pue;
	};
	/omit-if-no-ref/ iomuxc_gpio_ad_30_acmp3_in3: IOMUXC_GPIO_AD_30_ACMP3_IN3 {
		pinmux = <0x42a10184 5 0x0 0 0x42a103cc>;
		pin-pue;
	};
	/omit-if-no-ref/ iomuxc_gpio_ad_30_adc2_ch6a: IOMUXC_GPIO_AD_30_ADC2_CH6A {
		pinmux = <0x42a10184 5 0x0 0 0x42a103cc>;
		pin-pue;
	};
	/omit-if-no-ref/ iomuxc_gpio_ad_30_ecat_mdc: IOMUXC_GPIO_AD_30_ECAT_MDC {
		pinmux = <0x42a10184 12 0x0 0 0x42a103cc>;
		pin-pue;
	};
	/omit-if-no-ref/ iomuxc_gpio_ad_30_flexio2_d30: IOMUXC_GPIO_AD_30_FLEXIO2_D30 {
		pinmux = <0x42a10184 8 0x0 0 0x42a103cc>;
		pin-pue;
	};
	/omit-if-no-ref/ iomuxc_gpio_ad_30_gpio4_io30: IOMUXC_GPIO_AD_30_GPIO4_IO30 {
		pinmux = <0x42a10184 5 0x0 0 0x42a103cc>;
		pin-pue;
	};
	/omit-if-no-ref/ iomuxc_gpio_ad_30_kpp_row2: IOMUXC_GPIO_AD_30_KPP_ROW2 {
		pinmux = <0x42a10184 6 0x42a105d0 1 0x42a103cc>;
		pin-pue;
	};
	/omit-if-no-ref/ iomuxc_gpio_ad_30_lpspi5_sout: IOMUXC_GPIO_AD_30_LPSPI5_SOUT {
		pinmux = <0x42a10184 0 0x42a1064c 2 0x42a103cc>;
		pin-pue;
	};
	/omit-if-no-ref/ iomuxc_gpio_ad_30_lpuart8_txd: IOMUXC_GPIO_AD_30_LPUART8_TXD {
		pinmux = <0x42a10184 4 0x42a106c4 0 0x42a103cc>;
		pin-pue;
	};
	/omit-if-no-ref/ iomuxc_gpio_ad_30_netc_emdc: IOMUXC_GPIO_AD_30_NETC_EMDC {
		pinmux = <0x42a10184 7 0x0 0 0x42a103cc>;
		pin-pue;
	};
	/omit-if-no-ref/ iomuxc_gpio_ad_30_sinc2_emclk2: IOMUXC_GPIO_AD_30_SINC2_EMCLK2 {
		pinmux = <0x42a10184 3 0x42a10900 0 0x42a103cc>;
		pin-pue;
	};
	/omit-if-no-ref/ iomuxc_gpio_ad_30_xbar_inout24: IOMUXC_GPIO_AD_30_XBAR_INOUT24 {
		pinmux = <0x42a10184 9 0x42a10958 1 0x42a103cc>;
		pin-pue;
	};
	/omit-if-no-ref/ iomuxc_gpio_ad_31_acmp3_in4: IOMUXC_GPIO_AD_31_ACMP3_IN4 {
		pinmux = <0x42a10188 5 0x0 0 0x42a103d0>;
		pin-pue;
	};
	/omit-if-no-ref/ iomuxc_gpio_ad_31_adc2_ch6b: IOMUXC_GPIO_AD_31_ADC2_CH6B {
		pinmux = <0x42a10188 5 0x0 0 0x42a103d0>;
		pin-pue;
	};
	/omit-if-no-ref/ iomuxc_gpio_ad_31_ecat_mdio: IOMUXC_GPIO_AD_31_ECAT_MDIO {
		pinmux = <0x42a10188 12 0x42a104ec 0 0x42a103d0>;
		pin-pue;
	};
	/omit-if-no-ref/ iomuxc_gpio_ad_31_flexio2_d31: IOMUXC_GPIO_AD_31_FLEXIO2_D31 {
		pinmux = <0x42a10188 8 0x0 0 0x42a103d0>;
		pin-pue;
	};
	/omit-if-no-ref/ iomuxc_gpio_ad_31_gpio4_io31: IOMUXC_GPIO_AD_31_GPIO4_IO31 {
		pinmux = <0x42a10188 5 0x0 0 0x42a103d0>;
		pin-pue;
	};
	/omit-if-no-ref/ iomuxc_gpio_ad_31_kpp_col2: IOMUXC_GPIO_AD_31_KPP_COL2 {
		pinmux = <0x42a10188 6 0x42a105b0 1 0x42a103d0>;
		pin-pue;
	};
	/omit-if-no-ref/ iomuxc_gpio_ad_31_lpspi5_sin: IOMUXC_GPIO_AD_31_LPSPI5_SIN {
		pinmux = <0x42a10188 0 0x42a10648 2 0x42a103d0>;
		pin-pue;
	};
	/omit-if-no-ref/ iomuxc_gpio_ad_31_lpuart8_rxd: IOMUXC_GPIO_AD_31_LPUART8_RXD {
		pinmux = <0x42a10188 4 0x42a106c0 0 0x42a103d0>;
		pin-pue;
	};
	/omit-if-no-ref/ iomuxc_gpio_ad_31_netc_emdio: IOMUXC_GPIO_AD_31_NETC_EMDIO {
		pinmux = <0x42a10188 7 0x42a10798 4 0x42a103d0>;
		pin-pue;
	};
	/omit-if-no-ref/ iomuxc_gpio_ad_31_sinc2_embit2: IOMUXC_GPIO_AD_31_SINC2_EMBIT2 {
		pinmux = <0x42a10188 3 0x42a108f4 0 0x42a103d0>;
		pin-pue;
	};
	/omit-if-no-ref/ iomuxc_gpio_ad_31_xbar_inout25: IOMUXC_GPIO_AD_31_XBAR_INOUT25 {
		pinmux = <0x42a10188 9 0x42a1095c 1 0x42a103d0>;
		pin-pue;
	};
	/omit-if-no-ref/ iomuxc_aon_gpio_aon_00_flexcan1_tx: IOMUXC_AON_GPIO_AON_00_FLEXCAN1_TX {
		pinmux = <0x443c0000 1 0x0 0 0x443c0074>;
		pin-pue;
	};
	/omit-if-no-ref/ iomuxc_aon_gpio_aon_00_gpio1_io00: IOMUXC_AON_GPIO_AON_00_GPIO1_IO00 {
		pinmux = <0x443c0000 5 0x0 0 0x443c0074>;
		pin-pue;
	};
	/omit-if-no-ref/ iomuxc_aon_gpio_aon_00_lptmr1_alt1: IOMUXC_AON_GPIO_AON_00_LPTMR1_ALT1 {
		pinmux = <0x443c0000 4 0x443c012c 0 0x443c0074>;
		pin-pue;
	};
	/omit-if-no-ref/ iomuxc_aon_gpio_aon_00_lpuart2_txd: IOMUXC_AON_GPIO_AON_00_LPUART2_TXD {
		pinmux = <0x443c0000 6 0x443c0158 0 0x443c0074>;
		pin-pue;
	};
	/omit-if-no-ref/ iomuxc_aon_gpio_aon_00_src_boot_mode0: IOMUXC_AON_GPIO_AON_00_SRC_BOOT_MODE0 {
		pinmux = <0x443c0000 0 0x0 0 0x443c0074>;
		pin-pue;
	};
	/omit-if-no-ref/ iomuxc_aon_gpio_aon_00_tpm1_extclk: IOMUXC_AON_GPIO_AON_00_TPM1_EXTCLK {
		pinmux = <0x443c0000 8 0x0 0 0x443c0074>;
		pin-pue;
	};
	/omit-if-no-ref/ iomuxc_aon_gpio_aon_01_flexcan1_rx: IOMUXC_AON_GPIO_AON_01_FLEXCAN1_RX {
		pinmux = <0x443c0004 1 0x42a104a0 1 0x443c0078>;
		pin-pue;
	};
	/omit-if-no-ref/ iomuxc_aon_gpio_aon_01_gpio1_io01: IOMUXC_AON_GPIO_AON_01_GPIO1_IO01 {
		pinmux = <0x443c0004 5 0x0 0 0x443c0078>;
		pin-pue;
	};
	/omit-if-no-ref/ iomuxc_aon_gpio_aon_01_lptmr1_alt2: IOMUXC_AON_GPIO_AON_01_LPTMR1_ALT2 {
		pinmux = <0x443c0004 4 0x443c0130 0 0x443c0078>;
		pin-pue;
	};
	/omit-if-no-ref/ iomuxc_aon_gpio_aon_01_lpuart2_rxd: IOMUXC_AON_GPIO_AON_01_LPUART2_RXD {
		pinmux = <0x443c0004 6 0x443c0154 0 0x443c0078>;
		pin-pue;
	};
	/omit-if-no-ref/ iomuxc_aon_gpio_aon_01_src_boot_mode1: IOMUXC_AON_GPIO_AON_01_SRC_BOOT_MODE1 {
		pinmux = <0x443c0004 0 0x0 0 0x443c0078>;
		pin-pue;
	};
	/omit-if-no-ref/ iomuxc_aon_gpio_aon_01_tpm1_ch0: IOMUXC_AON_GPIO_AON_01_TPM1_CH0 {
		pinmux = <0x443c0004 8 0x0 0 0x443c0078>;
		pin-pue;
	};
	/omit-if-no-ref/ iomuxc_aon_gpio_aon_02_clkout25m: IOMUXC_AON_GPIO_AON_02_CLKOUT25M {
		pinmux = <0x443c0008 12 0x0 0 0x443c007c>;
		pin-pue;
	};
	/omit-if-no-ref/ iomuxc_aon_gpio_aon_02_flexcan3_tx: IOMUXC_AON_GPIO_AON_02_FLEXCAN3_TX {
		pinmux = <0x443c0008 1 0x0 0 0x443c007c>;
		pin-pue;
	};
	/omit-if-no-ref/ iomuxc_aon_gpio_aon_02_gpio1_io02: IOMUXC_AON_GPIO_AON_02_GPIO1_IO02 {
		pinmux = <0x443c0008 5 0x0 0 0x443c007c>;
		pin-pue;
	};
	/omit-if-no-ref/ iomuxc_aon_gpio_aon_02_lpspi2_pcs3: IOMUXC_AON_GPIO_AON_02_LPSPI2_PCS3 {
		pinmux = <0x443c0008 2 0x443c011c 0 0x443c007c>;
		pin-pue;
	};
	/omit-if-no-ref/ iomuxc_aon_gpio_aon_02_lpspi2_sout: IOMUXC_AON_GPIO_AON_02_LPSPI2_SOUT {
		pinmux = <0x443c0008 3 0x443c0128 0 0x443c007c>;
		pin-pue;
	};
	/omit-if-no-ref/ iomuxc_aon_gpio_aon_02_lptmr1_alt3: IOMUXC_AON_GPIO_AON_02_LPTMR1_ALT3 {
		pinmux = <0x443c0008 4 0x443c0134 0 0x443c007c>;
		pin-pue;
	};
	/omit-if-no-ref/ iomuxc_aon_gpio_aon_02_lpuart2_rts_b: IOMUXC_AON_GPIO_AON_02_LPUART2_RTS_B {
		pinmux = <0x443c0008 6 0x0 0 0x443c007c>;
		pin-pue;
	};
	/omit-if-no-ref/ iomuxc_aon_gpio_aon_02_src_boot_mode2: IOMUXC_AON_GPIO_AON_02_SRC_BOOT_MODE2 {
		pinmux = <0x443c0008 0 0x0 0 0x443c007c>;
		pin-pue;
	};
	/omit-if-no-ref/ iomuxc_aon_gpio_aon_02_tpm1_ch1: IOMUXC_AON_GPIO_AON_02_TPM1_CH1 {
		pinmux = <0x443c0008 8 0x0 0 0x443c007c>;
		pin-pue;
	};
	/omit-if-no-ref/ iomuxc_aon_gpio_aon_03_ecat_led_state_run: IOMUXC_AON_GPIO_AON_03_ECAT_LED_STATE_RUN {
		pinmux = <0x443c000c 12 0x0 0 0x443c0080>;
		pin-pue;
	};
	/omit-if-no-ref/ iomuxc_aon_gpio_aon_03_flexcan3_rx: IOMUXC_AON_GPIO_AON_03_FLEXCAN3_RX {
		pinmux = <0x443c000c 1 0x42a104a8 3 0x443c0080>;
		pin-pue;
	};
	/omit-if-no-ref/ iomuxc_aon_gpio_aon_03_gpio1_io03: IOMUXC_AON_GPIO_AON_03_GPIO1_IO03 {
		pinmux = <0x443c000c 5 0x0 0 0x443c0080>;
		pin-pue;
	};
	/omit-if-no-ref/ iomuxc_aon_gpio_aon_03_lpspi1_pcs1: IOMUXC_AON_GPIO_AON_03_LPSPI1_PCS1 {
		pinmux = <0x443c000c 2 0x443c0104 0 0x443c0080>;
		pin-pue;
	};
	/omit-if-no-ref/ iomuxc_aon_gpio_aon_03_lpspi1_pcs3: IOMUXC_AON_GPIO_AON_03_LPSPI1_PCS3 {
		pinmux = <0x443c000c 4 0x0 0 0x443c0080>;
		pin-pue;
	};
	/omit-if-no-ref/ iomuxc_aon_gpio_aon_03_lpspi2_sin: IOMUXC_AON_GPIO_AON_03_LPSPI2_SIN {
		pinmux = <0x443c000c 3 0x443c0124 0 0x443c0080>;
		pin-pue;
	};
	/omit-if-no-ref/ iomuxc_aon_gpio_aon_03_lpuart2_cts_b: IOMUXC_AON_GPIO_AON_03_LPUART2_CTS_B {
		pinmux = <0x443c000c 6 0x443c0150 0 0x443c0080>;
		pin-pue;
	};
	/omit-if-no-ref/ iomuxc_aon_gpio_aon_03_tpm1_ch2: IOMUXC_AON_GPIO_AON_03_TPM1_CH2 {
		pinmux = <0x443c000c 8 0x0 0 0x443c0080>;
		pin-pue;
	};
	/omit-if-no-ref/ iomuxc_aon_gpio_aon_04_ecat_led_run: IOMUXC_AON_GPIO_AON_04_ECAT_LED_RUN {
		pinmux = <0x443c0010 12 0x0 0 0x443c0084>;
		pin-pue;
	};
	/omit-if-no-ref/ iomuxc_aon_gpio_aon_04_gpio1_io04: IOMUXC_AON_GPIO_AON_04_GPIO1_IO04 {
		pinmux = <0x443c0010 5 0x0 0 0x443c0084>;
		pin-pue;
	};
	/omit-if-no-ref/ iomuxc_aon_gpio_aon_04_lpspi1_sck: IOMUXC_AON_GPIO_AON_04_LPSPI1_SCK {
		pinmux = <0x443c0010 0 0x443c0108 0 0x443c0084>;
		pin-pue;
	};
	/omit-if-no-ref/ iomuxc_aon_gpio_aon_04_lpuart7_cts_b: IOMUXC_AON_GPIO_AON_04_LPUART7_CTS_B {
		pinmux = <0x443c0010 6 0x443c015c 0 0x443c0084>;
		pin-pue;
	};
	/omit-if-no-ref/ iomuxc_aon_gpio_aon_04_sai1_rx_data1: IOMUXC_AON_GPIO_AON_04_SAI1_RX_DATA1 {
		pinmux = <0x443c0010 3 0x443c0174 0 0x443c0084>;
		pin-pue;
	};
	/omit-if-no-ref/ iomuxc_aon_gpio_aon_04_sai1_tx_data0: IOMUXC_AON_GPIO_AON_04_SAI1_TX_DATA0 {
		pinmux = <0x443c0010 2 0x0 0 0x443c0084>;
		pin-pue;
	};
	/omit-if-no-ref/ iomuxc_aon_gpio_aon_04_tpm1_ch3: IOMUXC_AON_GPIO_AON_04_TPM1_CH3 {
		pinmux = <0x443c0010 8 0x0 0 0x443c0084>;
		pin-pue;
	};
	/omit-if-no-ref/ iomuxc_aon_gpio_aon_05_ecat_led_err: IOMUXC_AON_GPIO_AON_05_ECAT_LED_ERR {
		pinmux = <0x443c0014 12 0x0 0 0x443c0088>;
		pin-pue;
	};
	/omit-if-no-ref/ iomuxc_aon_gpio_aon_05_gpio1_io05: IOMUXC_AON_GPIO_AON_05_GPIO1_IO05 {
		pinmux = <0x443c0014 5 0x0 0 0x443c0088>;
		pin-pue;
	};
	/omit-if-no-ref/ iomuxc_aon_gpio_aon_05_lpspi1_pcs0: IOMUXC_AON_GPIO_AON_05_LPSPI1_PCS0 {
		pinmux = <0x443c0014 0 0x443c0100 0 0x443c0088>;
		pin-pue;
	};
	/omit-if-no-ref/ iomuxc_aon_gpio_aon_05_lpuart7_rts_b: IOMUXC_AON_GPIO_AON_05_LPUART7_RTS_B {
		pinmux = <0x443c0014 6 0x0 0 0x443c0088>;
		pin-pue;
	};
	/omit-if-no-ref/ iomuxc_aon_gpio_aon_05_sai1_tx_sync: IOMUXC_AON_GPIO_AON_05_SAI1_TX_SYNC {
		pinmux = <0x443c0014 2 0x443c0180 0 0x443c0088>;
		pin-pue;
	};
	/omit-if-no-ref/ iomuxc_aon_gpio_aon_06_ecat_sda: IOMUXC_AON_GPIO_AON_06_ECAT_SDA {
		pinmux = <0x443c0018 12 0x42a104f0 1 0x443c008c>;
		pin-pue;
	};
	/omit-if-no-ref/ iomuxc_aon_gpio_aon_06_flexcan1_tx: IOMUXC_AON_GPIO_AON_06_FLEXCAN1_TX {
		pinmux = <0x443c0018 6 0x0 0 0x443c008c>;
		pin-pue;
	};
	/omit-if-no-ref/ iomuxc_aon_gpio_aon_06_gpio1_io06: IOMUXC_AON_GPIO_AON_06_GPIO1_IO06 {
		pinmux = <0x443c0018 5 0x0 0 0x443c008c>;
		pin-pue;
	};
	/omit-if-no-ref/ iomuxc_aon_gpio_aon_06_i3c1_pur: IOMUXC_AON_GPIO_AON_06_I3C1_PUR {
		pinmux = <0x443c0018 1 0x0 0 0x443c008c>;
		pin-pue;
	};
	/omit-if-no-ref/ iomuxc_aon_gpio_aon_06_lpi2c1_sda: IOMUXC_AON_GPIO_AON_06_LPI2C1_SDA {
		pinmux = <0x443c0018 3 0x443c00f4 0 0x443c008c>;
		pin-pue;
	};
	/omit-if-no-ref/ iomuxc_aon_gpio_aon_06_lpspi1_sout: IOMUXC_AON_GPIO_AON_06_LPSPI1_SOUT {
		pinmux = <0x443c0018 0 0x443c0110 0 0x443c008c>;
		pin-pue;
	};
	/omit-if-no-ref/ iomuxc_aon_gpio_aon_06_sai1_tx_bclk: IOMUXC_AON_GPIO_AON_06_SAI1_TX_BCLK {
		pinmux = <0x443c0018 2 0x443c017c 0 0x443c008c>;
		pin-pue;
	};
	/omit-if-no-ref/ iomuxc_aon_gpio_aon_07_ecat_scl: IOMUXC_AON_GPIO_AON_07_ECAT_SCL {
		pinmux = <0x443c001c 12 0x0 0 0x443c0090>;
		pin-pue;
	};
	/omit-if-no-ref/ iomuxc_aon_gpio_aon_07_flexcan1_rx: IOMUXC_AON_GPIO_AON_07_FLEXCAN1_RX {
		pinmux = <0x443c001c 6 0x42a104a0 2 0x443c0090>;
		pin-pue;
	};
	/omit-if-no-ref/ iomuxc_aon_gpio_aon_07_gpio1_io07: IOMUXC_AON_GPIO_AON_07_GPIO1_IO07 {
		pinmux = <0x443c001c 5 0x0 0 0x443c0090>;
		pin-pue;
	};
	/omit-if-no-ref/ iomuxc_aon_gpio_aon_07_lpi2c1_scl: IOMUXC_AON_GPIO_AON_07_LPI2C1_SCL {
		pinmux = <0x443c001c 3 0x443c00f0 0 0x443c0090>;
		pin-pue;
	};
	/omit-if-no-ref/ iomuxc_aon_gpio_aon_07_lpspi1_sin: IOMUXC_AON_GPIO_AON_07_LPSPI1_SIN {
		pinmux = <0x443c001c 0 0x443c010c 0 0x443c0090>;
		pin-pue;
	};
	/omit-if-no-ref/ iomuxc_aon_gpio_aon_07_sai1_mclk: IOMUXC_AON_GPIO_AON_07_SAI1_MCLK {
		pinmux = <0x443c001c 2 0x443c0168 0 0x443c0090>;
		pin-pue;
	};
	/omit-if-no-ref/ iomuxc_aon_gpio_aon_08_ecat_link_act_0: IOMUXC_AON_GPIO_AON_08_ECAT_LINK_ACT_0 {
		pinmux = <0x443c0020 12 0x0 0 0x443c0094>;
		pin-pue;
	};
	/omit-if-no-ref/ iomuxc_aon_gpio_aon_08_gpio1_io08: IOMUXC_AON_GPIO_AON_08_GPIO1_IO08 {
		pinmux = <0x443c0020 5 0x0 0 0x443c0094>;
		pin-pue;
	};
	/omit-if-no-ref/ iomuxc_aon_gpio_aon_08_lpi2c1_sda: IOMUXC_AON_GPIO_AON_08_LPI2C1_SDA {
		pinmux = <0x443c0020 6 0x443c00f4 1 0x443c0094>;
		pin-pue;
	};
	/omit-if-no-ref/ iomuxc_aon_gpio_aon_08_lpspi1_pcs1: IOMUXC_AON_GPIO_AON_08_LPSPI1_PCS1 {
		pinmux = <0x443c0020 8 0x443c0104 1 0x443c0094>;
		pin-pue;
	};
	/omit-if-no-ref/ iomuxc_aon_gpio_aon_08_lpuart1_txd: IOMUXC_AON_GPIO_AON_08_LPUART1_TXD {
		pinmux = <0x443c0020 0 0x0 0 0x443c0094>;
		pin-pue;
	};
	/omit-if-no-ref/ iomuxc_aon_gpio_aon_08_sai1_rx_data0: IOMUXC_AON_GPIO_AON_08_SAI1_RX_DATA0 {
		pinmux = <0x443c0020 2 0x443c0170 0 0x443c0094>;
		pin-pue;
	};
	/omit-if-no-ref/ iomuxc_aon_gpio_aon_08_sai1_tx_data1: IOMUXC_AON_GPIO_AON_08_SAI1_TX_DATA1 {
		pinmux = <0x443c0020 3 0x0 0 0x443c0094>;
		pin-pue;
	};
	/omit-if-no-ref/ iomuxc_aon_gpio_aon_08_seco_tx: IOMUXC_AON_GPIO_AON_08_SECO_TX {
		pinmux = <0x443c0020 1 0x0 0 0x443c0094>;
		pin-pue;
	};
	/omit-if-no-ref/ iomuxc_aon_gpio_aon_09_ecat_link_act_1: IOMUXC_AON_GPIO_AON_09_ECAT_LINK_ACT_1 {
		pinmux = <0x443c0024 12 0x0 0 0x443c0098>;
		pin-pue;
	};
	/omit-if-no-ref/ iomuxc_aon_gpio_aon_09_gpio1_io09: IOMUXC_AON_GPIO_AON_09_GPIO1_IO09 {
		pinmux = <0x443c0024 5 0x0 0 0x443c0098>;
		pin-pue;
	};
	/omit-if-no-ref/ iomuxc_aon_gpio_aon_09_lpi2c1_scl: IOMUXC_AON_GPIO_AON_09_LPI2C1_SCL {
		pinmux = <0x443c0024 6 0x443c00f0 1 0x443c0098>;
		pin-pue;
	};
	/omit-if-no-ref/ iomuxc_aon_gpio_aon_09_lpit1_trigger0: IOMUXC_AON_GPIO_AON_09_LPIT1_TRIGGER0 {
		pinmux = <0x443c0024 3 0x0 0 0x443c0098>;
		pin-pue;
	};
	/omit-if-no-ref/ iomuxc_aon_gpio_aon_09_lpspi1_pcs2: IOMUXC_AON_GPIO_AON_09_LPSPI1_PCS2 {
		pinmux = <0x443c0024 8 0x0 0 0x443c0098>;
		pin-pue;
	};
	/omit-if-no-ref/ iomuxc_aon_gpio_aon_09_lpuart1_rxd: IOMUXC_AON_GPIO_AON_09_LPUART1_RXD {
		pinmux = <0x443c0024 0 0x0 0 0x443c0098>;
		pin-pue;
	};
	/omit-if-no-ref/ iomuxc_aon_gpio_aon_09_sai1_rx_bclk: IOMUXC_AON_GPIO_AON_09_SAI1_RX_BCLK {
		pinmux = <0x443c0024 2 0x443c016c 0 0x443c0098>;
		pin-pue;
	};
	/omit-if-no-ref/ iomuxc_aon_gpio_aon_09_seco_rx: IOMUXC_AON_GPIO_AON_09_SECO_RX {
		pinmux = <0x443c0024 1 0x0 0 0x443c0098>;
		pin-pue;
	};
	/omit-if-no-ref/ iomuxc_aon_gpio_aon_10_gpio1_io10: IOMUXC_AON_GPIO_AON_10_GPIO1_IO10 {
		pinmux = <0x443c0028 5 0x0 0 0x443c009c>;
		pin-pue;
	};
	/omit-if-no-ref/ iomuxc_aon_gpio_aon_10_jtag_mux_trstb: IOMUXC_AON_GPIO_AON_10_JTAG_MUX_TRSTB {
		pinmux = <0x443c0028 0 0x0 0 0x443c009c>;
		pin-pue;
	};
	/omit-if-no-ref/ iomuxc_aon_gpio_aon_10_lpi2c1_scls: IOMUXC_AON_GPIO_AON_10_LPI2C1_SCLS {
		pinmux = <0x443c0028 6 0x0 0 0x443c009c>;
		pin-pue;
	};
	/omit-if-no-ref/ iomuxc_aon_gpio_aon_10_lpit1_trigger1: IOMUXC_AON_GPIO_AON_10_LPIT1_TRIGGER1 {
		pinmux = <0x443c0028 3 0x0 0 0x443c009c>;
		pin-pue;
	};
	/omit-if-no-ref/ iomuxc_aon_gpio_aon_10_lpspi2_pcs0: IOMUXC_AON_GPIO_AON_10_LPSPI2_PCS0 {
		pinmux = <0x443c0028 1 0x443c0114 0 0x443c009c>;
		pin-pue;
	};
	/omit-if-no-ref/ iomuxc_aon_gpio_aon_10_sai1_rx_sync: IOMUXC_AON_GPIO_AON_10_SAI1_RX_SYNC {
		pinmux = <0x443c0028 2 0x443c0178 0 0x443c009c>;
		pin-pue;
	};
	/omit-if-no-ref/ iomuxc_aon_gpio_aon_10_tpm2_extclk: IOMUXC_AON_GPIO_AON_10_TPM2_EXTCLK {
		pinmux = <0x443c0028 4 0x0 0 0x443c009c>;
		pin-pue;
	};
	/omit-if-no-ref/ iomuxc_aon_gpio_aon_11_arm_trace_swo: IOMUXC_AON_GPIO_AON_11_ARM_TRACE_SWO {
		pinmux = <0x443c002c 0 0x0 0 0x443c00a0>;
		pin-pue;
	};
	/omit-if-no-ref/ iomuxc_aon_gpio_aon_11_gpio1_io11: IOMUXC_AON_GPIO_AON_11_GPIO1_IO11 {
		pinmux = <0x443c002c 5 0x0 0 0x443c00a0>;
		pin-pue;
	};
	/omit-if-no-ref/ iomuxc_aon_gpio_aon_11_jtag_mux_tdo: IOMUXC_AON_GPIO_AON_11_JTAG_MUX_TDO {
		pinmux = <0x443c002c 0 0x0 0 0x443c00a0>;
		pin-pue;
	};
	/omit-if-no-ref/ iomuxc_aon_gpio_aon_11_lpi2c1_sdas: IOMUXC_AON_GPIO_AON_11_LPI2C1_SDAS {
		pinmux = <0x443c002c 6 0x0 0 0x443c00a0>;
		pin-pue;
	};
	/omit-if-no-ref/ iomuxc_aon_gpio_aon_11_lpit1_trigger2: IOMUXC_AON_GPIO_AON_11_LPIT1_TRIGGER2 {
		pinmux = <0x443c002c 3 0x0 0 0x443c00a0>;
		pin-pue;
	};
	/omit-if-no-ref/ iomuxc_aon_gpio_aon_11_lpuart1_cts_b: IOMUXC_AON_GPIO_AON_11_LPUART1_CTS_B {
		pinmux = <0x443c002c 2 0x443c0138 0 0x443c00a0>;
		pin-pue;
	};
	/omit-if-no-ref/ iomuxc_aon_gpio_aon_11_tpm2_ch0: IOMUXC_AON_GPIO_AON_11_TPM2_CH0 {
		pinmux = <0x443c002c 4 0x0 0 0x443c00a0>;
		pin-pue;
	};
	/omit-if-no-ref/ iomuxc_aon_gpio_aon_12_gpio1_io12: IOMUXC_AON_GPIO_AON_12_GPIO1_IO12 {
		pinmux = <0x443c0030 5 0x0 0 0x443c00a4>;
		pin-pue;
	};
	/omit-if-no-ref/ iomuxc_aon_gpio_aon_12_jtag_mux_tdi: IOMUXC_AON_GPIO_AON_12_JTAG_MUX_TDI {
		pinmux = <0x443c0030 0 0x0 0 0x443c00a4>;
		pin-pue;
	};
	/omit-if-no-ref/ iomuxc_aon_gpio_aon_12_lpi2c1_hreq: IOMUXC_AON_GPIO_AON_12_LPI2C1_HREQ {
		pinmux = <0x443c0030 6 0x0 0 0x443c00a4>;
		pin-pue;
	};
	/omit-if-no-ref/ iomuxc_aon_gpio_aon_12_lpit1_trigger3: IOMUXC_AON_GPIO_AON_12_LPIT1_TRIGGER3 {
		pinmux = <0x443c0030 3 0x0 0 0x443c00a4>;
		pin-pue;
	};
	/omit-if-no-ref/ iomuxc_aon_gpio_aon_12_lpspi1_sck: IOMUXC_AON_GPIO_AON_12_LPSPI1_SCK {
		pinmux = <0x443c0030 8 0x443c0108 1 0x443c00a4>;
		pin-pue;
	};
	/omit-if-no-ref/ iomuxc_aon_gpio_aon_12_lpuart1_rts_b: IOMUXC_AON_GPIO_AON_12_LPUART1_RTS_B {
		pinmux = <0x443c0030 2 0x0 0 0x443c00a4>;
		pin-pue;
	};
	/omit-if-no-ref/ iomuxc_aon_gpio_aon_12_tpm2_ch1: IOMUXC_AON_GPIO_AON_12_TPM2_CH1 {
		pinmux = <0x443c0030 4 0x0 0 0x443c00a4>;
		pin-pue;
	};
	/omit-if-no-ref/ iomuxc_aon_gpio_aon_13_gpio1_io13: IOMUXC_AON_GPIO_AON_13_GPIO1_IO13 {
		pinmux = <0x443c0034 5 0x0 0 0x443c00a8>;
		pin-pue;
	};
	/omit-if-no-ref/ iomuxc_aon_gpio_aon_13_jtag_mux_tck: IOMUXC_AON_GPIO_AON_13_JTAG_MUX_TCK {
		pinmux = <0x443c0034 0 0x0 0 0x443c00a8>;
		pin-pue;
	};
	/omit-if-no-ref/ iomuxc_aon_gpio_aon_13_lpspi1_pcs0: IOMUXC_AON_GPIO_AON_13_LPSPI1_PCS0 {
		pinmux = <0x443c0034 8 0x443c0100 1 0x443c00a8>;
		pin-pue;
	};
	/omit-if-no-ref/ iomuxc_aon_gpio_aon_13_lptmr1_alt1: IOMUXC_AON_GPIO_AON_13_LPTMR1_ALT1 {
		pinmux = <0x443c0034 6 0x443c012c 1 0x443c00a8>;
		pin-pue;
	};
	/omit-if-no-ref/ iomuxc_aon_gpio_aon_13_lpuart1_dsr_b: IOMUXC_AON_GPIO_AON_13_LPUART1_DSR_B {
		pinmux = <0x443c0034 3 0x443c0140 0 0x443c00a8>;
		pin-pue;
	};
	/omit-if-no-ref/ iomuxc_aon_gpio_aon_13_tpm2_ch2: IOMUXC_AON_GPIO_AON_13_TPM2_CH2 {
		pinmux = <0x443c0034 4 0x0 0 0x443c00a8>;
		pin-pue;
	};
	/omit-if-no-ref/ iomuxc_aon_gpio_aon_14_gpio1_io14: IOMUXC_AON_GPIO_AON_14_GPIO1_IO14 {
		pinmux = <0x443c0038 5 0x0 0 0x443c00ac>;
		pin-pue;
	};
	/omit-if-no-ref/ iomuxc_aon_gpio_aon_14_jtag_mux_tms: IOMUXC_AON_GPIO_AON_14_JTAG_MUX_TMS {
		pinmux = <0x443c0038 0 0x0 0 0x443c00ac>;
		pin-pue;
	};
	/omit-if-no-ref/ iomuxc_aon_gpio_aon_14_lpspi1_sout: IOMUXC_AON_GPIO_AON_14_LPSPI1_SOUT {
		pinmux = <0x443c0038 8 0x443c0110 1 0x443c00ac>;
		pin-pue;
	};
	/omit-if-no-ref/ iomuxc_aon_gpio_aon_14_lptmr1_alt2: IOMUXC_AON_GPIO_AON_14_LPTMR1_ALT2 {
		pinmux = <0x443c0038 6 0x443c0130 1 0x443c00ac>;
		pin-pue;
	};
	/omit-if-no-ref/ iomuxc_aon_gpio_aon_14_lpuart1_dcd_b: IOMUXC_AON_GPIO_AON_14_LPUART1_DCD_B {
		pinmux = <0x443c0038 3 0x443c013c 0 0x443c00ac>;
		pin-pue;
	};
	/omit-if-no-ref/ iomuxc_aon_gpio_aon_14_tpm2_ch3: IOMUXC_AON_GPIO_AON_14_TPM2_CH3 {
		pinmux = <0x443c0038 4 0x0 0 0x443c00ac>;
		pin-pue;
	};
	/omit-if-no-ref/ iomuxc_aon_gpio_aon_15_flexspi2_b_data3: IOMUXC_AON_GPIO_AON_15_FLEXSPI2_B_DATA3 {
		pinmux = <0x443c003c 0 0x42a10594 2 0x443c00b0>;
		pin-pue;
	};
	/omit-if-no-ref/ iomuxc_aon_gpio_aon_15_gpio1_io15: IOMUXC_AON_GPIO_AON_15_GPIO1_IO15 {
		pinmux = <0x443c003c 5 0x0 0 0x443c00b0>;
		pin-pue;
	};
	/omit-if-no-ref/ iomuxc_aon_gpio_aon_15_i3c1_sda: IOMUXC_AON_GPIO_AON_15_I3C1_SDA {
		pinmux = <0x443c003c 9 0x443c00ec 0 0x443c00b0>;
		pin-pue;
	};
	/omit-if-no-ref/ iomuxc_aon_gpio_aon_15_lpi2c2_sda: IOMUXC_AON_GPIO_AON_15_LPI2C2_SDA {
		pinmux = <0x443c003c 4 0x443c00fc 0 0x443c00b0>;
		pin-pue;
	};
	/omit-if-no-ref/ iomuxc_aon_gpio_aon_15_lpspi1_sin: IOMUXC_AON_GPIO_AON_15_LPSPI1_SIN {
		pinmux = <0x443c003c 8 0x443c010c 1 0x443c00b0>;
		pin-pue;
	};
	/omit-if-no-ref/ iomuxc_aon_gpio_aon_15_lpspi2_pcs1: IOMUXC_AON_GPIO_AON_15_LPSPI2_PCS1 {
		pinmux = <0x443c003c 1 0x443c0118 0 0x443c00b0>;
		pin-pue;
	};
	/omit-if-no-ref/ iomuxc_aon_gpio_aon_15_lptmr1_alt3: IOMUXC_AON_GPIO_AON_15_LPTMR1_ALT3 {
		pinmux = <0x443c003c 6 0x443c0134 1 0x443c00b0>;
		pin-pue;
	};
	/omit-if-no-ref/ iomuxc_aon_gpio_aon_15_lpuart1_ri_b: IOMUXC_AON_GPIO_AON_15_LPUART1_RI_B {
		pinmux = <0x443c003c 3 0x0 0 0x443c00b0>;
		pin-pue;
	};
	/omit-if-no-ref/ iomuxc_aon_gpio_aon_16_flexcan1_tx: IOMUXC_AON_GPIO_AON_16_FLEXCAN1_TX {
		pinmux = <0x443c0040 6 0x0 0 0x443c00b4>;
		pin-pue;
	};
	/omit-if-no-ref/ iomuxc_aon_gpio_aon_16_flexspi2_b_data2: IOMUXC_AON_GPIO_AON_16_FLEXSPI2_B_DATA2 {
		pinmux = <0x443c0040 0 0x42a10590 2 0x443c00b4>;
		pin-pue;
	};
	/omit-if-no-ref/ iomuxc_aon_gpio_aon_16_gpio1_io16: IOMUXC_AON_GPIO_AON_16_GPIO1_IO16 {
		pinmux = <0x443c0040 5 0x0 0 0x443c00b4>;
		pin-pue;
	};
	/omit-if-no-ref/ iomuxc_aon_gpio_aon_16_i3c1_scl: IOMUXC_AON_GPIO_AON_16_I3C1_SCL {
		pinmux = <0x443c0040 9 0x443c00e8 0 0x443c00b4>;
		pin-pue;
	};
	/omit-if-no-ref/ iomuxc_aon_gpio_aon_16_lpi2c2_scl: IOMUXC_AON_GPIO_AON_16_LPI2C2_SCL {
		pinmux = <0x443c0040 4 0x443c00f8 0 0x443c00b4>;
		pin-pue;
	};
	/omit-if-no-ref/ iomuxc_aon_gpio_aon_16_lpspi2_pcs0: IOMUXC_AON_GPIO_AON_16_LPSPI2_PCS0 {
		pinmux = <0x443c0040 1 0x443c0114 1 0x443c00b4>;
		pin-pue;
	};
	/omit-if-no-ref/ iomuxc_aon_gpio_aon_16_lpuart1_dtr_b: IOMUXC_AON_GPIO_AON_16_LPUART1_DTR_B {
		pinmux = <0x443c0040 3 0x0 0 0x443c00b4>;
		pin-pue;
	};
	/omit-if-no-ref/ iomuxc_aon_gpio_aon_16_lpuart7_cts_b: IOMUXC_AON_GPIO_AON_16_LPUART7_CTS_B {
		pinmux = <0x443c0040 8 0x443c015c 1 0x443c00b4>;
		pin-pue;
	};
	/omit-if-no-ref/ iomuxc_aon_gpio_aon_17_flexcan1_rx: IOMUXC_AON_GPIO_AON_17_FLEXCAN1_RX {
		pinmux = <0x443c0044 6 0x42a104a0 3 0x443c00b8>;
		pin-pue;
	};
	/omit-if-no-ref/ iomuxc_aon_gpio_aon_17_flexspi2_b_data1: IOMUXC_AON_GPIO_AON_17_FLEXSPI2_B_DATA1 {
		pinmux = <0x443c0044 0 0x42a1058c 2 0x443c00b8>;
		pin-pue;
	};
	/omit-if-no-ref/ iomuxc_aon_gpio_aon_17_gpio1_io17: IOMUXC_AON_GPIO_AON_17_GPIO1_IO17 {
		pinmux = <0x443c0044 5 0x0 0 0x443c00b8>;
		pin-pue;
	};
	/omit-if-no-ref/ iomuxc_aon_gpio_aon_17_lpi2c2_sda: IOMUXC_AON_GPIO_AON_17_LPI2C2_SDA {
		pinmux = <0x443c0044 3 0x443c00fc 1 0x443c00b8>;
		pin-pue;
	};
	/omit-if-no-ref/ iomuxc_aon_gpio_aon_17_lpspi2_sin: IOMUXC_AON_GPIO_AON_17_LPSPI2_SIN {
		pinmux = <0x443c0044 1 0x443c0124 1 0x443c00b8>;
		pin-pue;
	};
	/omit-if-no-ref/ iomuxc_aon_gpio_aon_17_lpuart1_dsr_b: IOMUXC_AON_GPIO_AON_17_LPUART1_DSR_B {
		pinmux = <0x443c0044 4 0x443c0140 1 0x443c00b8>;
		pin-pue;
	};
	/omit-if-no-ref/ iomuxc_aon_gpio_aon_17_lpuart7_txd: IOMUXC_AON_GPIO_AON_17_LPUART7_TXD {
		pinmux = <0x443c0044 2 0x443c0164 0 0x443c00b8>;
		pin-pue;
	};
	/omit-if-no-ref/ iomuxc_aon_gpio_aon_18_flexcan3_tx: IOMUXC_AON_GPIO_AON_18_FLEXCAN3_TX {
		pinmux = <0x443c0048 6 0x0 0 0x443c00bc>;
		pin-pue;
	};
	/omit-if-no-ref/ iomuxc_aon_gpio_aon_18_flexspi2_b_data0: IOMUXC_AON_GPIO_AON_18_FLEXSPI2_B_DATA0 {
		pinmux = <0x443c0048 0 0x42a10588 2 0x443c00bc>;
		pin-pue;
	};
	/omit-if-no-ref/ iomuxc_aon_gpio_aon_18_gpio1_io18: IOMUXC_AON_GPIO_AON_18_GPIO1_IO18 {
		pinmux = <0x443c0048 5 0x0 0 0x443c00bc>;
		pin-pue;
	};
	/omit-if-no-ref/ iomuxc_aon_gpio_aon_18_lpi2c2_scl: IOMUXC_AON_GPIO_AON_18_LPI2C2_SCL {
		pinmux = <0x443c0048 3 0x443c00f8 1 0x443c00bc>;
		pin-pue;
	};
	/omit-if-no-ref/ iomuxc_aon_gpio_aon_18_lpspi2_sout: IOMUXC_AON_GPIO_AON_18_LPSPI2_SOUT {
		pinmux = <0x443c0048 1 0x443c0128 1 0x443c00bc>;
		pin-pue;
	};
	/omit-if-no-ref/ iomuxc_aon_gpio_aon_18_lpuart1_dcd_b: IOMUXC_AON_GPIO_AON_18_LPUART1_DCD_B {
		pinmux = <0x443c0048 4 0x443c013c 1 0x443c00bc>;
		pin-pue;
	};
	/omit-if-no-ref/ iomuxc_aon_gpio_aon_18_lpuart7_rxd: IOMUXC_AON_GPIO_AON_18_LPUART7_RXD {
		pinmux = <0x443c0048 2 0x443c0160 0 0x443c00bc>;
		pin-pue;
	};
	/omit-if-no-ref/ iomuxc_aon_gpio_aon_19_flexcan3_rx: IOMUXC_AON_GPIO_AON_19_FLEXCAN3_RX {
		pinmux = <0x443c004c 6 0x42a104a8 4 0x443c00c0>;
		pin-pue;
	};
	/omit-if-no-ref/ iomuxc_aon_gpio_aon_19_flexspi2_a_ss1_b: IOMUXC_AON_GPIO_AON_19_FLEXSPI2_A_SS1_B {
		pinmux = <0x443c004c 3 0x0 0 0x443c00c0>;
		pin-pue;
	};
	/omit-if-no-ref/ iomuxc_aon_gpio_aon_19_flexspi2_b_sclk: IOMUXC_AON_GPIO_AON_19_FLEXSPI2_B_SCLK {
		pinmux = <0x443c004c 0 0x42a1059c 1 0x443c00c0>;
		pin-pue;
	};
	/omit-if-no-ref/ iomuxc_aon_gpio_aon_19_gpio1_io19: IOMUXC_AON_GPIO_AON_19_GPIO1_IO19 {
		pinmux = <0x443c004c 5 0x0 0 0x443c00c0>;
		pin-pue;
	};
	/omit-if-no-ref/ iomuxc_aon_gpio_aon_19_lpspi2_sck: IOMUXC_AON_GPIO_AON_19_LPSPI2_SCK {
		pinmux = <0x443c004c 1 0x443c0120 0 0x443c00c0>;
		pin-pue;
	};
	/omit-if-no-ref/ iomuxc_aon_gpio_aon_19_lpuart1_cts_b: IOMUXC_AON_GPIO_AON_19_LPUART1_CTS_B {
		pinmux = <0x443c004c 4 0x443c0138 1 0x443c00c0>;
		pin-pue;
	};
	/omit-if-no-ref/ iomuxc_aon_gpio_aon_19_lpuart7_rts_b: IOMUXC_AON_GPIO_AON_19_LPUART7_RTS_B {
		pinmux = <0x443c004c 8 0x0 0 0x443c00c0>;
		pin-pue;
	};
	/omit-if-no-ref/ iomuxc_aon_gpio_aon_20_flexspi2_a_ss1_b: IOMUXC_AON_GPIO_AON_20_FLEXSPI2_A_SS1_B {
		pinmux = <0x443c0050 1 0x0 0 0x443c00c4>;
		pin-pue;
	};
	/omit-if-no-ref/ iomuxc_aon_gpio_aon_20_flexspi2_b_dqs: IOMUXC_AON_GPIO_AON_20_FLEXSPI2_B_DQS {
		pinmux = <0x443c0050 0 0x42a10574 2 0x443c00c4>;
		pin-pue;
	};
	/omit-if-no-ref/ iomuxc_aon_gpio_aon_20_gpio1_io20: IOMUXC_AON_GPIO_AON_20_GPIO1_IO20 {
		pinmux = <0x443c0050 5 0x0 0 0x443c00c4>;
		pin-pue;
	};
	/omit-if-no-ref/ iomuxc_aon_gpio_aon_20_i3c1_sda: IOMUXC_AON_GPIO_AON_20_I3C1_SDA {
		pinmux = <0x443c0050 3 0x443c00ec 1 0x443c00c4>;
		pin-pue;
	};
	/omit-if-no-ref/ iomuxc_aon_gpio_aon_20_lpi2c1_sda: IOMUXC_AON_GPIO_AON_20_LPI2C1_SDA {
		pinmux = <0x443c0050 2 0x443c00f4 2 0x443c00c4>;
		pin-pue;
	};
	/omit-if-no-ref/ iomuxc_aon_gpio_aon_20_lpuart1_rts_b: IOMUXC_AON_GPIO_AON_20_LPUART1_RTS_B {
		pinmux = <0x443c0050 4 0x0 0 0x443c00c4>;
		pin-pue;
	};
	/omit-if-no-ref/ iomuxc_aon_gpio_aon_21_flexspi2_a_dqs: IOMUXC_AON_GPIO_AON_21_FLEXSPI2_A_DQS {
		pinmux = <0x443c0054 8 0x42a10570 1 0x443c00c8>;
		pin-pue;
	};
	/omit-if-no-ref/ iomuxc_aon_gpio_aon_21_flexspi2_b_ss0_b: IOMUXC_AON_GPIO_AON_21_FLEXSPI2_B_SS0_B {
		pinmux = <0x443c0054 0 0x0 0 0x443c00c8>;
		pin-pue;
	};
	/omit-if-no-ref/ iomuxc_aon_gpio_aon_21_gpio1_io21: IOMUXC_AON_GPIO_AON_21_GPIO1_IO21 {
		pinmux = <0x443c0054 5 0x0 0 0x443c00c8>;
		pin-pue;
	};
	/omit-if-no-ref/ iomuxc_aon_gpio_aon_21_i3c1_scl: IOMUXC_AON_GPIO_AON_21_I3C1_SCL {
		pinmux = <0x443c0054 3 0x443c00e8 1 0x443c00c8>;
		pin-pue;
	};
	/omit-if-no-ref/ iomuxc_aon_gpio_aon_21_lpi2c1_scl: IOMUXC_AON_GPIO_AON_21_LPI2C1_SCL {
		pinmux = <0x443c0054 2 0x443c00f0 2 0x443c00c8>;
		pin-pue;
	};
	/omit-if-no-ref/ iomuxc_aon_gpio_aon_21_lpspi2_pcs1: IOMUXC_AON_GPIO_AON_21_LPSPI2_PCS1 {
		pinmux = <0x443c0054 1 0x443c0118 1 0x443c00c8>;
		pin-pue;
	};
	/omit-if-no-ref/ iomuxc_aon_gpio_aon_21_sai1_rx_data1: IOMUXC_AON_GPIO_AON_21_SAI1_RX_DATA1 {
		pinmux = <0x443c0054 9 0x443c0174 1 0x443c00c8>;
		pin-pue;
	};
	/omit-if-no-ref/ iomuxc_aon_gpio_aon_21_sai1_tx_data0: IOMUXC_AON_GPIO_AON_21_SAI1_TX_DATA0 {
		pinmux = <0x443c0054 4 0x0 0 0x443c00c8>;
		pin-pue;
	};
	/omit-if-no-ref/ iomuxc_aon_gpio_aon_22_flexspi2_a_ss0_b: IOMUXC_AON_GPIO_AON_22_FLEXSPI2_A_SS0_B {
		pinmux = <0x443c0058 0 0x0 0 0x443c00cc>;
		pin-pue;
	};
	/omit-if-no-ref/ iomuxc_aon_gpio_aon_22_gpio1_io22: IOMUXC_AON_GPIO_AON_22_GPIO1_IO22 {
		pinmux = <0x443c0058 5 0x0 0 0x443c00cc>;
		pin-pue;
	};
	/omit-if-no-ref/ iomuxc_aon_gpio_aon_22_lpi2c2_sda: IOMUXC_AON_GPIO_AON_22_LPI2C2_SDA {
		pinmux = <0x443c0058 1 0x443c00fc 2 0x443c00cc>;
		pin-pue;
	};
	/omit-if-no-ref/ iomuxc_aon_gpio_aon_22_lpspi2_sck: IOMUXC_AON_GPIO_AON_22_LPSPI2_SCK {
		pinmux = <0x443c0058 6 0x443c0120 1 0x443c00cc>;
		pin-pue;
	};
	/omit-if-no-ref/ iomuxc_aon_gpio_aon_22_lpuart7_txd: IOMUXC_AON_GPIO_AON_22_LPUART7_TXD {
		pinmux = <0x443c0058 2 0x443c0164 1 0x443c00cc>;
		pin-pue;
	};
	/omit-if-no-ref/ iomuxc_aon_gpio_aon_22_sai1_tx_sync: IOMUXC_AON_GPIO_AON_22_SAI1_TX_SYNC {
		pinmux = <0x443c0058 4 0x443c0180 1 0x443c00cc>;
		pin-pue;
	};
	/omit-if-no-ref/ iomuxc_aon_gpio_aon_23_flexspi2_a_sclk: IOMUXC_AON_GPIO_AON_23_FLEXSPI2_A_SCLK {
		pinmux = <0x443c005c 0 0x42a10598 1 0x443c00d0>;
		pin-pue;
	};
	/omit-if-no-ref/ iomuxc_aon_gpio_aon_23_gpio1_io23: IOMUXC_AON_GPIO_AON_23_GPIO1_IO23 {
		pinmux = <0x443c005c 5 0x0 0 0x443c00d0>;
		pin-pue;
	};
	/omit-if-no-ref/ iomuxc_aon_gpio_aon_23_lpi2c2_scl: IOMUXC_AON_GPIO_AON_23_LPI2C2_SCL {
		pinmux = <0x443c005c 1 0x443c00f8 2 0x443c00d0>;
		pin-pue;
	};
	/omit-if-no-ref/ iomuxc_aon_gpio_aon_23_lpspi2_sout: IOMUXC_AON_GPIO_AON_23_LPSPI2_SOUT {
		pinmux = <0x443c005c 6 0x443c0128 2 0x443c00d0>;
		pin-pue;
	};
	/omit-if-no-ref/ iomuxc_aon_gpio_aon_23_lpuart7_rxd: IOMUXC_AON_GPIO_AON_23_LPUART7_RXD {
		pinmux = <0x443c005c 2 0x443c0160 1 0x443c00d0>;
		pin-pue;
	};
	/omit-if-no-ref/ iomuxc_aon_gpio_aon_23_sai1_tx_bclk: IOMUXC_AON_GPIO_AON_23_SAI1_TX_BCLK {
		pinmux = <0x443c005c 4 0x443c017c 1 0x443c00d0>;
		pin-pue;
	};
	/omit-if-no-ref/ iomuxc_aon_gpio_aon_24_flexspi2_a_data0: IOMUXC_AON_GPIO_AON_24_FLEXSPI2_A_DATA0 {
		pinmux = <0x443c0060 0 0x42a10578 1 0x443c00d4>;
		pin-pue;
	};
	/omit-if-no-ref/ iomuxc_aon_gpio_aon_24_gpio1_io24: IOMUXC_AON_GPIO_AON_24_GPIO1_IO24 {
		pinmux = <0x443c0060 5 0x0 0 0x443c00d4>;
		pin-pue;
	};
	/omit-if-no-ref/ iomuxc_aon_gpio_aon_24_lpi2c1_sda: IOMUXC_AON_GPIO_AON_24_LPI2C1_SDA {
		pinmux = <0x443c0060 1 0x443c00f4 3 0x443c00d4>;
		pin-pue;
	};
	/omit-if-no-ref/ iomuxc_aon_gpio_aon_24_lpspi2_sin: IOMUXC_AON_GPIO_AON_24_LPSPI2_SIN {
		pinmux = <0x443c0060 6 0x443c0124 2 0x443c00d4>;
		pin-pue;
	};
	/omit-if-no-ref/ iomuxc_aon_gpio_aon_24_lpuart2_rts_b: IOMUXC_AON_GPIO_AON_24_LPUART2_RTS_B {
		pinmux = <0x443c0060 2 0x0 0 0x443c00d4>;
		pin-pue;
	};
	/omit-if-no-ref/ iomuxc_aon_gpio_aon_24_lpuart7_cts_b: IOMUXC_AON_GPIO_AON_24_LPUART7_CTS_B {
		pinmux = <0x443c0060 3 0x443c015c 2 0x443c00d4>;
		pin-pue;
	};
	/omit-if-no-ref/ iomuxc_aon_gpio_aon_24_sai1_mclk: IOMUXC_AON_GPIO_AON_24_SAI1_MCLK {
		pinmux = <0x443c0060 4 0x443c0168 1 0x443c00d4>;
		pin-pue;
	};
	/omit-if-no-ref/ iomuxc_aon_gpio_aon_25_flexspi2_a_data1: IOMUXC_AON_GPIO_AON_25_FLEXSPI2_A_DATA1 {
		pinmux = <0x443c0064 0 0x42a1057c 1 0x443c00d8>;
		pin-pue;
	};
	/omit-if-no-ref/ iomuxc_aon_gpio_aon_25_gpio1_io25: IOMUXC_AON_GPIO_AON_25_GPIO1_IO25 {
		pinmux = <0x443c0064 5 0x0 0 0x443c00d8>;
		pin-pue;
	};
	/omit-if-no-ref/ iomuxc_aon_gpio_aon_25_lpi2c1_scl: IOMUXC_AON_GPIO_AON_25_LPI2C1_SCL {
		pinmux = <0x443c0064 1 0x443c00f0 3 0x443c00d8>;
		pin-pue;
	};
	/omit-if-no-ref/ iomuxc_aon_gpio_aon_25_lpspi2_pcs0: IOMUXC_AON_GPIO_AON_25_LPSPI2_PCS0 {
		pinmux = <0x443c0064 6 0x443c0114 2 0x443c00d8>;
		pin-pue;
	};
	/omit-if-no-ref/ iomuxc_aon_gpio_aon_25_lpuart2_cts_b: IOMUXC_AON_GPIO_AON_25_LPUART2_CTS_B {
		pinmux = <0x443c0064 2 0x443c0150 1 0x443c00d8>;
		pin-pue;
	};
	/omit-if-no-ref/ iomuxc_aon_gpio_aon_25_lpuart7_rts_b: IOMUXC_AON_GPIO_AON_25_LPUART7_RTS_B {
		pinmux = <0x443c0064 3 0x0 0 0x443c00d8>;
		pin-pue;
	};
	/omit-if-no-ref/ iomuxc_aon_gpio_aon_25_sai1_rx_data0: IOMUXC_AON_GPIO_AON_25_SAI1_RX_DATA0 {
		pinmux = <0x443c0064 4 0x443c0170 1 0x443c00d8>;
		pin-pue;
	};
	/omit-if-no-ref/ iomuxc_aon_gpio_aon_25_sai1_tx_data1: IOMUXC_AON_GPIO_AON_25_SAI1_TX_DATA1 {
		pinmux = <0x443c0064 7 0x0 0 0x443c00d8>;
		pin-pue;
	};
	/omit-if-no-ref/ iomuxc_aon_gpio_aon_26_flexspi2_a_data2: IOMUXC_AON_GPIO_AON_26_FLEXSPI2_A_DATA2 {
		pinmux = <0x443c0068 0 0x42a10580 1 0x443c00dc>;
		pin-pue;
	};
	/omit-if-no-ref/ iomuxc_aon_gpio_aon_26_gpio1_io26: IOMUXC_AON_GPIO_AON_26_GPIO1_IO26 {
		pinmux = <0x443c0068 5 0x0 0 0x443c00dc>;
		pin-pue;
	};
	/omit-if-no-ref/ iomuxc_aon_gpio_aon_26_lpspi2_pcs2: IOMUXC_AON_GPIO_AON_26_LPSPI2_PCS2 {
		pinmux = <0x443c0068 1 0x0 0 0x443c00dc>;
		pin-pue;
	};
	/omit-if-no-ref/ iomuxc_aon_gpio_aon_26_lpuart2_txd: IOMUXC_AON_GPIO_AON_26_LPUART2_TXD {
		pinmux = <0x443c0068 2 0x443c0158 1 0x443c00dc>;
		pin-pue;
	};
	/omit-if-no-ref/ iomuxc_aon_gpio_aon_26_sai1_rx_bclk: IOMUXC_AON_GPIO_AON_26_SAI1_RX_BCLK {
		pinmux = <0x443c0068 4 0x443c016c 1 0x443c00dc>;
		pin-pue;
	};
	/omit-if-no-ref/ iomuxc_aon_gpio_aon_27_ewm_out_b: IOMUXC_AON_GPIO_AON_27_EWM_OUT_B {
		pinmux = <0x443c006c 7 0x0 0 0x443c00e0>;
		pin-pue;
	};
	/omit-if-no-ref/ iomuxc_aon_gpio_aon_27_flexspi2_a_data3: IOMUXC_AON_GPIO_AON_27_FLEXSPI2_A_DATA3 {
		pinmux = <0x443c006c 0 0x42a10584 1 0x443c00e0>;
		pin-pue;
	};
	/omit-if-no-ref/ iomuxc_aon_gpio_aon_27_gpio1_io27: IOMUXC_AON_GPIO_AON_27_GPIO1_IO27 {
		pinmux = <0x443c006c 5 0x0 0 0x443c00e0>;
		pin-pue;
	};
	/omit-if-no-ref/ iomuxc_aon_gpio_aon_27_lpspi2_pcs3: IOMUXC_AON_GPIO_AON_27_LPSPI2_PCS3 {
		pinmux = <0x443c006c 1 0x443c011c 1 0x443c00e0>;
		pin-pue;
	};
	/omit-if-no-ref/ iomuxc_aon_gpio_aon_27_lpuart2_rxd: IOMUXC_AON_GPIO_AON_27_LPUART2_RXD {
		pinmux = <0x443c006c 2 0x443c0154 1 0x443c00e0>;
		pin-pue;
	};
	/omit-if-no-ref/ iomuxc_aon_gpio_aon_27_sai1_rx_sync: IOMUXC_AON_GPIO_AON_27_SAI1_RX_SYNC {
		pinmux = <0x443c006c 4 0x443c0178 1 0x443c00e0>;
		pin-pue;
	};
	/omit-if-no-ref/ iomuxc_gpio_emc_b1_00_ecat_pt0_txd_3: IOMUXC_GPIO_EMC_B1_00_ECAT_PT0_TXD_3 {
		pinmux = <0x42a10010 10 0x0 0 0x42a10258>;
		pin-pdrv;
	};
	/omit-if-no-ref/ iomuxc_gpio_emc_b1_00_eth3_tx_data3: IOMUXC_GPIO_EMC_B1_00_ETH3_TX_DATA3 {
		pinmux = <0x42a10010 4 0x0 0 0x42a10258>;
		pin-pdrv;
	};
	/omit-if-no-ref/ iomuxc_gpio_emc_b1_00_eth4_tx_data3: IOMUXC_GPIO_EMC_B1_00_ETH4_TX_DATA3 {
		pinmux = <0x42a10010 9 0x0 0 0x42a10258>;
		pin-pdrv;
	};
	/omit-if-no-ref/ iomuxc_gpio_emc_b1_00_flexio1_d00: IOMUXC_GPIO_EMC_B1_00_FLEXIO1_D00 {
		pinmux = <0x42a10010 8 0x0 0 0x42a10258>;
		pin-pdrv;
	};
	/omit-if-no-ref/ iomuxc_gpio_emc_b1_00_gpio2_io00: IOMUXC_GPIO_EMC_B1_00_GPIO2_IO00 {
		pinmux = <0x42a10010 5 0x0 0 0x42a10258>;
		pin-pdrv;
	};
	/omit-if-no-ref/ iomuxc_gpio_emc_b1_00_kpp_row3: IOMUXC_GPIO_EMC_B1_00_KPP_ROW3 {
		pinmux = <0x42a10010 6 0x42a105d4 0 0x42a10258>;
		pin-pdrv;
	};
	/omit-if-no-ref/ iomuxc_gpio_emc_b1_00_lpuart3_cts_b: IOMUXC_GPIO_EMC_B1_00_LPUART3_CTS_B {
		pinmux = <0x42a10010 3 0x42a1067c 0 0x42a10258>;
		pin-pdrv;
	};
	/omit-if-no-ref/ iomuxc_gpio_emc_b1_00_sinc3_mod_clk0: IOMUXC_GPIO_EMC_B1_00_SINC3_MOD_CLK0 {
		pinmux = <0x42a10010 2 0x0 0 0x42a10258>;
		pin-pdrv;
	};
	/omit-if-no-ref/ iomuxc_gpio_emc_b1_00_sramc_data_00: IOMUXC_GPIO_EMC_B1_00_SRAMC_DATA_00 {
		pinmux = <0x42a10010 12 0x0 0 0x42a10258>;
		pin-pdrv;
	};
	/omit-if-no-ref/ iomuxc_gpio_emc_b1_00_xbar_inout04: IOMUXC_GPIO_EMC_B1_00_XBAR_INOUT04 {
		pinmux = <0x42a10010 1 0x0 0 0x42a10258>;
		pin-pdrv;
	};
	/omit-if-no-ref/ iomuxc_gpio_emc_b1_01_ecat_pt0_txd_2: IOMUXC_GPIO_EMC_B1_01_ECAT_PT0_TXD_2 {
		pinmux = <0x42a10014 10 0x0 0 0x42a1025c>;
		pin-pdrv;
	};
	/omit-if-no-ref/ iomuxc_gpio_emc_b1_01_eth3_tx_data2: IOMUXC_GPIO_EMC_B1_01_ETH3_TX_DATA2 {
		pinmux = <0x42a10014 4 0x0 0 0x42a1025c>;
		pin-pdrv;
	};
	/omit-if-no-ref/ iomuxc_gpio_emc_b1_01_eth4_tx_data2: IOMUXC_GPIO_EMC_B1_01_ETH4_TX_DATA2 {
		pinmux = <0x42a10014 9 0x0 0 0x42a1025c>;
		pin-pdrv;
	};
	/omit-if-no-ref/ iomuxc_gpio_emc_b1_01_flexio1_d01: IOMUXC_GPIO_EMC_B1_01_FLEXIO1_D01 {
		pinmux = <0x42a10014 8 0x0 0 0x42a1025c>;
		pin-pdrv;
	};
	/omit-if-no-ref/ iomuxc_gpio_emc_b1_01_gpio2_io01: IOMUXC_GPIO_EMC_B1_01_GPIO2_IO01 {
		pinmux = <0x42a10014 5 0x0 0 0x42a1025c>;
		pin-pdrv;
	};
	/omit-if-no-ref/ iomuxc_gpio_emc_b1_01_kpp_col3: IOMUXC_GPIO_EMC_B1_01_KPP_COL3 {
		pinmux = <0x42a10014 6 0x42a105b4 0 0x42a1025c>;
		pin-pdrv;
	};
	/omit-if-no-ref/ iomuxc_gpio_emc_b1_01_lpuart3_rts_b: IOMUXC_GPIO_EMC_B1_01_LPUART3_RTS_B {
		pinmux = <0x42a10014 3 0x0 0 0x42a1025c>;
		pin-pdrv;
	};
	/omit-if-no-ref/ iomuxc_gpio_emc_b1_01_sinc3_mod_clk1: IOMUXC_GPIO_EMC_B1_01_SINC3_MOD_CLK1 {
		pinmux = <0x42a10014 2 0x0 0 0x42a1025c>;
		pin-pdrv;
	};
	/omit-if-no-ref/ iomuxc_gpio_emc_b1_01_sramc_data_01: IOMUXC_GPIO_EMC_B1_01_SRAMC_DATA_01 {
		pinmux = <0x42a10014 12 0x0 0 0x42a1025c>;
		pin-pdrv;
	};
	/omit-if-no-ref/ iomuxc_gpio_emc_b1_01_xbar_inout05: IOMUXC_GPIO_EMC_B1_01_XBAR_INOUT05 {
		pinmux = <0x42a10014 1 0x0 0 0x42a1025c>;
		pin-pdrv;
	};
	/omit-if-no-ref/ iomuxc_gpio_emc_b1_02_ecat_pt0_rx_clk: IOMUXC_GPIO_EMC_B1_02_ECAT_PT0_RX_CLK {
		pinmux = <0x42a10018 10 0x42a104ac 0 0x42a10260>;
		pin-pdrv;
	};
	/omit-if-no-ref/ iomuxc_gpio_emc_b1_02_eth3_rx_clk: IOMUXC_GPIO_EMC_B1_02_ETH3_RX_CLK {
		pinmux = <0x42a10018 4 0x42a10818 0 0x42a10260>;
		pin-pdrv;
	};
	/omit-if-no-ref/ iomuxc_gpio_emc_b1_02_eth4_rx_clk: IOMUXC_GPIO_EMC_B1_02_ETH4_RX_CLK {
		pinmux = <0x42a10018 9 0x42a10838 0 0x42a10260>;
		pin-pdrv;
	};
	/omit-if-no-ref/ iomuxc_gpio_emc_b1_02_flexio1_d02: IOMUXC_GPIO_EMC_B1_02_FLEXIO1_D02 {
		pinmux = <0x42a10018 8 0x0 0 0x42a10260>;
		pin-pdrv;
	};
	/omit-if-no-ref/ iomuxc_gpio_emc_b1_02_gpio2_io02: IOMUXC_GPIO_EMC_B1_02_GPIO2_IO02 {
		pinmux = <0x42a10018 5 0x0 0 0x42a10260>;
		pin-pdrv;
	};
	/omit-if-no-ref/ iomuxc_gpio_emc_b1_02_kpp_row2: IOMUXC_GPIO_EMC_B1_02_KPP_ROW2 {
		pinmux = <0x42a10018 6 0x42a105d0 0 0x42a10260>;
		pin-pdrv;
	};
	/omit-if-no-ref/ iomuxc_gpio_emc_b1_02_lpuart3_rxd: IOMUXC_GPIO_EMC_B1_02_LPUART3_RXD {
		pinmux = <0x42a10018 3 0x42a10680 0 0x42a10260>;
		pin-pdrv;
	};
	/omit-if-no-ref/ iomuxc_gpio_emc_b1_02_sinc3_mod_clk2: IOMUXC_GPIO_EMC_B1_02_SINC3_MOD_CLK2 {
		pinmux = <0x42a10018 2 0x0 0 0x42a10260>;
		pin-pdrv;
	};
	/omit-if-no-ref/ iomuxc_gpio_emc_b1_02_sramc_data_02: IOMUXC_GPIO_EMC_B1_02_SRAMC_DATA_02 {
		pinmux = <0x42a10018 12 0x0 0 0x42a10260>;
		pin-pdrv;
	};
	/omit-if-no-ref/ iomuxc_gpio_emc_b1_02_xbar_inout06: IOMUXC_GPIO_EMC_B1_02_XBAR_INOUT06 {
		pinmux = <0x42a10018 1 0x0 0 0x42a10260>;
		pin-pdrv;
	};
	/omit-if-no-ref/ iomuxc_gpio_emc_b1_03_ecat_pt0_rxd_3: IOMUXC_GPIO_EMC_B1_03_ECAT_PT0_RXD_3 {
		pinmux = <0x42a1001c 10 0x42a104cc 0 0x42a10264>;
		pin-pdrv;
	};
	/omit-if-no-ref/ iomuxc_gpio_emc_b1_03_eth3_rx_data3: IOMUXC_GPIO_EMC_B1_03_ETH3_RX_DATA3 {
		pinmux = <0x42a1001c 4 0x42a10830 0 0x42a10264>;
		pin-pdrv;
	};
	/omit-if-no-ref/ iomuxc_gpio_emc_b1_03_eth4_rx_data3: IOMUXC_GPIO_EMC_B1_03_ETH4_RX_DATA3 {
		pinmux = <0x42a1001c 9 0x42a10850 0 0x42a10264>;
		pin-pdrv;
	};
	/omit-if-no-ref/ iomuxc_gpio_emc_b1_03_flexio1_d03: IOMUXC_GPIO_EMC_B1_03_FLEXIO1_D03 {
		pinmux = <0x42a1001c 8 0x0 0 0x42a10264>;
		pin-pdrv;
	};
	/omit-if-no-ref/ iomuxc_gpio_emc_b1_03_gpio2_io03: IOMUXC_GPIO_EMC_B1_03_GPIO2_IO03 {
		pinmux = <0x42a1001c 5 0x0 0 0x42a10264>;
		pin-pdrv;
	};
	/omit-if-no-ref/ iomuxc_gpio_emc_b1_03_kpp_col2: IOMUXC_GPIO_EMC_B1_03_KPP_COL2 {
		pinmux = <0x42a1001c 6 0x42a105b0 0 0x42a10264>;
		pin-pdrv;
	};
	/omit-if-no-ref/ iomuxc_gpio_emc_b1_03_lpuart3_txd: IOMUXC_GPIO_EMC_B1_03_LPUART3_TXD {
		pinmux = <0x42a1001c 3 0x42a10684 0 0x42a10264>;
		pin-pdrv;
	};
	/omit-if-no-ref/ iomuxc_gpio_emc_b1_03_sinc3_emclk0: IOMUXC_GPIO_EMC_B1_03_SINC3_EMCLK0 {
		pinmux = <0x42a1001c 2 0x0 0 0x42a10264>;
		pin-pdrv;
	};
	/omit-if-no-ref/ iomuxc_gpio_emc_b1_03_sramc_data_03: IOMUXC_GPIO_EMC_B1_03_SRAMC_DATA_03 {
		pinmux = <0x42a1001c 12 0x0 0 0x42a10264>;
		pin-pdrv;
	};
	/omit-if-no-ref/ iomuxc_gpio_emc_b1_03_xbar_inout07: IOMUXC_GPIO_EMC_B1_03_XBAR_INOUT07 {
		pinmux = <0x42a1001c 1 0x0 0 0x42a10264>;
		pin-pdrv;
	};
	/omit-if-no-ref/ iomuxc_gpio_emc_b1_04_ecat_pt0_rxd_2: IOMUXC_GPIO_EMC_B1_04_ECAT_PT0_RXD_2 {
		pinmux = <0x42a10020 10 0x42a104c4 0 0x42a10268>;
		pin-pdrv;
	};
	/omit-if-no-ref/ iomuxc_gpio_emc_b1_04_eth3_rx_data2: IOMUXC_GPIO_EMC_B1_04_ETH3_RX_DATA2 {
		pinmux = <0x42a10020 4 0x42a1082c 0 0x42a10268>;
		pin-pdrv;
	};
	/omit-if-no-ref/ iomuxc_gpio_emc_b1_04_eth4_rx_data2: IOMUXC_GPIO_EMC_B1_04_ETH4_RX_DATA2 {
		pinmux = <0x42a10020 9 0x42a1084c 0 0x42a10268>;
		pin-pdrv;
	};
	/omit-if-no-ref/ iomuxc_gpio_emc_b1_04_flexio1_d04: IOMUXC_GPIO_EMC_B1_04_FLEXIO1_D04 {
		pinmux = <0x42a10020 8 0x0 0 0x42a10268>;
		pin-pdrv;
	};
	/omit-if-no-ref/ iomuxc_gpio_emc_b1_04_gpio2_io04: IOMUXC_GPIO_EMC_B1_04_GPIO2_IO04 {
		pinmux = <0x42a10020 5 0x0 0 0x42a10268>;
		pin-pdrv;
	};
	/omit-if-no-ref/ iomuxc_gpio_emc_b1_04_kpp_row1: IOMUXC_GPIO_EMC_B1_04_KPP_ROW1 {
		pinmux = <0x42a10020 6 0x42a105cc 0 0x42a10268>;
		pin-pdrv;
	};
	/omit-if-no-ref/ iomuxc_gpio_emc_b1_04_lpuart3_dsr_b: IOMUXC_GPIO_EMC_B1_04_LPUART3_DSR_B {
		pinmux = <0x42a10020 3 0x0 0 0x42a10268>;
		pin-pdrv;
	};
	/omit-if-no-ref/ iomuxc_gpio_emc_b1_04_sinc3_embit0: IOMUXC_GPIO_EMC_B1_04_SINC3_EMBIT0 {
		pinmux = <0x42a10020 2 0x0 0 0x42a10268>;
		pin-pdrv;
	};
	/omit-if-no-ref/ iomuxc_gpio_emc_b1_04_sramc_data_04: IOMUXC_GPIO_EMC_B1_04_SRAMC_DATA_04 {
		pinmux = <0x42a10020 12 0x0 0 0x42a10268>;
		pin-pdrv;
	};
	/omit-if-no-ref/ iomuxc_gpio_emc_b1_04_xbar_inout08: IOMUXC_GPIO_EMC_B1_04_XBAR_INOUT08 {
		pinmux = <0x42a10020 1 0x0 0 0x42a10268>;
		pin-pdrv;
	};
	/omit-if-no-ref/ iomuxc_gpio_emc_b1_05_ecat_pt0_txd_0: IOMUXC_GPIO_EMC_B1_05_ECAT_PT0_TXD_0 {
		pinmux = <0x42a10024 10 0x0 0 0x42a1026c>;
		pin-pdrv;
	};
	/omit-if-no-ref/ iomuxc_gpio_emc_b1_05_eth3_tx_data0: IOMUXC_GPIO_EMC_B1_05_ETH3_TX_DATA0 {
		pinmux = <0x42a10024 4 0x0 0 0x42a1026c>;
		pin-pdrv;
	};
	/omit-if-no-ref/ iomuxc_gpio_emc_b1_05_eth4_tx_data0: IOMUXC_GPIO_EMC_B1_05_ETH4_TX_DATA0 {
		pinmux = <0x42a10024 9 0x0 0 0x42a1026c>;
		pin-pdrv;
	};
	/omit-if-no-ref/ iomuxc_gpio_emc_b1_05_flexio1_d05: IOMUXC_GPIO_EMC_B1_05_FLEXIO1_D05 {
		pinmux = <0x42a10024 8 0x0 0 0x42a1026c>;
		pin-pdrv;
	};
	/omit-if-no-ref/ iomuxc_gpio_emc_b1_05_gpio2_io05: IOMUXC_GPIO_EMC_B1_05_GPIO2_IO05 {
		pinmux = <0x42a10024 5 0x0 0 0x42a1026c>;
		pin-pdrv;
	};
	/omit-if-no-ref/ iomuxc_gpio_emc_b1_05_kpp_row7: IOMUXC_GPIO_EMC_B1_05_KPP_ROW7 {
		pinmux = <0x42a10024 6 0x42a105e4 0 0x42a1026c>;
		pin-pdrv;
	};
	/omit-if-no-ref/ iomuxc_gpio_emc_b1_05_lpuart3_dcd_b: IOMUXC_GPIO_EMC_B1_05_LPUART3_DCD_B {
		pinmux = <0x42a10024 3 0x0 0 0x42a1026c>;
		pin-pdrv;
	};
	/omit-if-no-ref/ iomuxc_gpio_emc_b1_05_sinc3_emclk1: IOMUXC_GPIO_EMC_B1_05_SINC3_EMCLK1 {
		pinmux = <0x42a10024 2 0x0 0 0x42a1026c>;
		pin-pdrv;
	};
	/omit-if-no-ref/ iomuxc_gpio_emc_b1_05_sramc_data_05: IOMUXC_GPIO_EMC_B1_05_SRAMC_DATA_05 {
		pinmux = <0x42a10024 12 0x0 0 0x42a1026c>;
		pin-pdrv;
	};
	/omit-if-no-ref/ iomuxc_gpio_emc_b1_05_xbar_inout09: IOMUXC_GPIO_EMC_B1_05_XBAR_INOUT09 {
		pinmux = <0x42a10024 1 0x0 0 0x42a1026c>;
		pin-pdrv;
	};
	/omit-if-no-ref/ iomuxc_gpio_emc_b1_06_ecat_pt0_txd_1: IOMUXC_GPIO_EMC_B1_06_ECAT_PT0_TXD_1 {
		pinmux = <0x42a10028 10 0x0 0 0x42a10270>;
		pin-pdrv;
	};
	/omit-if-no-ref/ iomuxc_gpio_emc_b1_06_eth3_tx_data1: IOMUXC_GPIO_EMC_B1_06_ETH3_TX_DATA1 {
		pinmux = <0x42a10028 4 0x0 0 0x42a10270>;
		pin-pdrv;
	};
	/omit-if-no-ref/ iomuxc_gpio_emc_b1_06_eth4_tx_data1: IOMUXC_GPIO_EMC_B1_06_ETH4_TX_DATA1 {
		pinmux = <0x42a10028 9 0x0 0 0x42a10270>;
		pin-pdrv;
	};
	/omit-if-no-ref/ iomuxc_gpio_emc_b1_06_flexio1_d06: IOMUXC_GPIO_EMC_B1_06_FLEXIO1_D06 {
		pinmux = <0x42a10028 8 0x0 0 0x42a10270>;
		pin-pdrv;
	};
	/omit-if-no-ref/ iomuxc_gpio_emc_b1_06_flexpwm4_pwm3_b: IOMUXC_GPIO_EMC_B1_06_FLEXPWM4_PWM3_B {
		pinmux = <0x42a10028 1 0x0 0 0x42a10270>;
		pin-pdrv;
	};
	/omit-if-no-ref/ iomuxc_gpio_emc_b1_06_gpio2_io06: IOMUXC_GPIO_EMC_B1_06_GPIO2_IO06 {
		pinmux = <0x42a10028 5 0x0 0 0x42a10270>;
		pin-pdrv;
	};
	/omit-if-no-ref/ iomuxc_gpio_emc_b1_06_kpp_col7: IOMUXC_GPIO_EMC_B1_06_KPP_COL7 {
		pinmux = <0x42a10028 6 0x42a105c4 0 0x42a10270>;
		pin-pdrv;
	};
	/omit-if-no-ref/ iomuxc_gpio_emc_b1_06_lpuart3_ri_b: IOMUXC_GPIO_EMC_B1_06_LPUART3_RI_B {
		pinmux = <0x42a10028 3 0x0 0 0x42a10270>;
		pin-pdrv;
	};
	/omit-if-no-ref/ iomuxc_gpio_emc_b1_06_sinc3_embit1: IOMUXC_GPIO_EMC_B1_06_SINC3_EMBIT1 {
		pinmux = <0x42a10028 2 0x0 0 0x42a10270>;
		pin-pdrv;
	};
	/omit-if-no-ref/ iomuxc_gpio_emc_b1_06_sramc_data_06: IOMUXC_GPIO_EMC_B1_06_SRAMC_DATA_06 {
		pinmux = <0x42a10028 12 0x0 0 0x42a10270>;
		pin-pdrv;
	};
	/omit-if-no-ref/ iomuxc_gpio_emc_b1_07_ecat_pt0_tx_en: IOMUXC_GPIO_EMC_B1_07_ECAT_PT0_TX_EN {
		pinmux = <0x42a1002c 10 0x0 0 0x42a10274>;
		pin-pdrv;
	};
	/omit-if-no-ref/ iomuxc_gpio_emc_b1_07_eth3_tx_en: IOMUXC_GPIO_EMC_B1_07_ETH3_TX_EN {
		pinmux = <0x42a1002c 4 0x0 0 0x42a10274>;
		pin-pdrv;
	};
	/omit-if-no-ref/ iomuxc_gpio_emc_b1_07_eth4_tx_en: IOMUXC_GPIO_EMC_B1_07_ETH4_TX_EN {
		pinmux = <0x42a1002c 9 0x0 0 0x42a10274>;
		pin-pdrv;
	};
	/omit-if-no-ref/ iomuxc_gpio_emc_b1_07_flexio1_d07: IOMUXC_GPIO_EMC_B1_07_FLEXIO1_D07 {
		pinmux = <0x42a1002c 8 0x0 0 0x42a10274>;
		pin-pdrv;
	};
	/omit-if-no-ref/ iomuxc_gpio_emc_b1_07_flexpwm4_pwm3_a: IOMUXC_GPIO_EMC_B1_07_FLEXPWM4_PWM3_A {
		pinmux = <0x42a1002c 1 0x0 0 0x42a10274>;
		pin-pdrv;
	};
	/omit-if-no-ref/ iomuxc_gpio_emc_b1_07_gpio2_io07: IOMUXC_GPIO_EMC_B1_07_GPIO2_IO07 {
		pinmux = <0x42a1002c 5 0x0 0 0x42a10274>;
		pin-pdrv;
	};
	/omit-if-no-ref/ iomuxc_gpio_emc_b1_07_kpp_row6: IOMUXC_GPIO_EMC_B1_07_KPP_ROW6 {
		pinmux = <0x42a1002c 6 0x42a105e0 0 0x42a10274>;
		pin-pdrv;
	};
	/omit-if-no-ref/ iomuxc_gpio_emc_b1_07_lpuart3_dtr_b: IOMUXC_GPIO_EMC_B1_07_LPUART3_DTR_B {
		pinmux = <0x42a1002c 3 0x0 0 0x42a10274>;
		pin-pdrv;
	};
	/omit-if-no-ref/ iomuxc_gpio_emc_b1_07_sinc3_emclk2: IOMUXC_GPIO_EMC_B1_07_SINC3_EMCLK2 {
		pinmux = <0x42a1002c 2 0x0 0 0x42a10274>;
		pin-pdrv;
	};
	/omit-if-no-ref/ iomuxc_gpio_emc_b1_07_sramc_data_07: IOMUXC_GPIO_EMC_B1_07_SRAMC_DATA_07 {
		pinmux = <0x42a1002c 12 0x0 0 0x42a10274>;
		pin-pdrv;
	};
	/omit-if-no-ref/ iomuxc_gpio_emc_b1_08_ecat_pt0_tx_clk: IOMUXC_GPIO_EMC_B1_08_ECAT_PT0_TX_CLK {
		pinmux = <0x42a10030 10 0x42a104e4 0 0x42a10278>;
		pin-pdrv;
	};
	/omit-if-no-ref/ iomuxc_gpio_emc_b1_08_eth3_tx_clk: IOMUXC_GPIO_EMC_B1_08_ETH3_TX_CLK {
		pinmux = <0x42a10030 4 0x42a10834 0 0x42a10278>;
		pin-pdrv;
	};
	/omit-if-no-ref/ iomuxc_gpio_emc_b1_08_eth4_tx_clk: IOMUXC_GPIO_EMC_B1_08_ETH4_TX_CLK {
		pinmux = <0x42a10030 9 0x42a10854 0 0x42a10278>;
		pin-pdrv;
	};
	/omit-if-no-ref/ iomuxc_gpio_emc_b1_08_flexio1_d08: IOMUXC_GPIO_EMC_B1_08_FLEXIO1_D08 {
		pinmux = <0x42a10030 8 0x0 0 0x42a10278>;
		pin-pdrv;
	};
	/omit-if-no-ref/ iomuxc_gpio_emc_b1_08_gpio2_io08: IOMUXC_GPIO_EMC_B1_08_GPIO2_IO08 {
		pinmux = <0x42a10030 5 0x0 0 0x42a10278>;
		pin-pdrv;
	};
	/omit-if-no-ref/ iomuxc_gpio_emc_b1_08_kpp_col6: IOMUXC_GPIO_EMC_B1_08_KPP_COL6 {
		pinmux = <0x42a10030 6 0x42a105c0 0 0x42a10278>;
		pin-pdrv;
	};
	/omit-if-no-ref/ iomuxc_gpio_emc_b1_08_lpuart4_dsr_b: IOMUXC_GPIO_EMC_B1_08_LPUART4_DSR_B {
		pinmux = <0x42a10030 3 0x0 0 0x42a10278>;
		pin-pdrv;
	};
	/omit-if-no-ref/ iomuxc_gpio_emc_b1_08_sinc3_embit2: IOMUXC_GPIO_EMC_B1_08_SINC3_EMBIT2 {
		pinmux = <0x42a10030 2 0x0 0 0x42a10278>;
		pin-pdrv;
	};
	/omit-if-no-ref/ iomuxc_gpio_emc_b1_08_sramc_lbb: IOMUXC_GPIO_EMC_B1_08_SRAMC_LBB {
		pinmux = <0x42a10030 12 0x0 0 0x42a10278>;
		pin-pdrv;
	};
	/omit-if-no-ref/ iomuxc_gpio_emc_b1_09_ecat_pt0_rxd_0: IOMUXC_GPIO_EMC_B1_09_ECAT_PT0_RXD_0 {
		pinmux = <0x42a10034 10 0x42a104b4 0 0x42a1027c>;
		pin-pdrv;
	};
	/omit-if-no-ref/ iomuxc_gpio_emc_b1_09_eth3_rx_data0: IOMUXC_GPIO_EMC_B1_09_ETH3_RX_DATA0 {
		pinmux = <0x42a10034 4 0x42a10824 0 0x42a1027c>;
		pin-pdrv;
	};
	/omit-if-no-ref/ iomuxc_gpio_emc_b1_09_eth4_rx_data0: IOMUXC_GPIO_EMC_B1_09_ETH4_RX_DATA0 {
		pinmux = <0x42a10034 9 0x42a10844 0 0x42a1027c>;
		pin-pdrv;
	};
	/omit-if-no-ref/ iomuxc_gpio_emc_b1_09_flexio1_d09: IOMUXC_GPIO_EMC_B1_09_FLEXIO1_D09 {
		pinmux = <0x42a10034 8 0x0 0 0x42a1027c>;
		pin-pdrv;
	};
	/omit-if-no-ref/ iomuxc_gpio_emc_b1_09_gpio2_io09: IOMUXC_GPIO_EMC_B1_09_GPIO2_IO09 {
		pinmux = <0x42a10034 5 0x0 0 0x42a1027c>;
		pin-pdrv;
	};
	/omit-if-no-ref/ iomuxc_gpio_emc_b1_09_kpp_row5: IOMUXC_GPIO_EMC_B1_09_KPP_ROW5 {
		pinmux = <0x42a10034 6 0x42a105dc 0 0x42a1027c>;
		pin-pdrv;
	};
	/omit-if-no-ref/ iomuxc_gpio_emc_b1_09_lpuart4_dcd_b: IOMUXC_GPIO_EMC_B1_09_LPUART4_DCD_B {
		pinmux = <0x42a10034 3 0x0 0 0x42a1027c>;
		pin-pdrv;
	};
	/omit-if-no-ref/ iomuxc_gpio_emc_b1_09_sinc3_emclk3: IOMUXC_GPIO_EMC_B1_09_SINC3_EMCLK3 {
		pinmux = <0x42a10034 2 0x0 0 0x42a1027c>;
		pin-pdrv;
	};
	/omit-if-no-ref/ iomuxc_gpio_emc_b1_09_sramc_addr_00: IOMUXC_GPIO_EMC_B1_09_SRAMC_ADDR_00 {
		pinmux = <0x42a10034 12 0x0 0 0x42a1027c>;
		pin-pdrv;
	};
	/omit-if-no-ref/ iomuxc_gpio_emc_b1_10_ecat_pt0_rxd_1: IOMUXC_GPIO_EMC_B1_10_ECAT_PT0_RXD_1 {
		pinmux = <0x42a10038 10 0x42a104bc 0 0x42a10280>;
		pin-pdrv;
	};
	/omit-if-no-ref/ iomuxc_gpio_emc_b1_10_eth3_rx_data1: IOMUXC_GPIO_EMC_B1_10_ETH3_RX_DATA1 {
		pinmux = <0x42a10038 4 0x42a10828 0 0x42a10280>;
		pin-pdrv;
	};
	/omit-if-no-ref/ iomuxc_gpio_emc_b1_10_eth4_rx_data1: IOMUXC_GPIO_EMC_B1_10_ETH4_RX_DATA1 {
		pinmux = <0x42a10038 9 0x42a10848 0 0x42a10280>;
		pin-pdrv;
	};
	/omit-if-no-ref/ iomuxc_gpio_emc_b1_10_flexio1_d10: IOMUXC_GPIO_EMC_B1_10_FLEXIO1_D10 {
		pinmux = <0x42a10038 8 0x0 0 0x42a10280>;
		pin-pdrv;
	};
	/omit-if-no-ref/ iomuxc_gpio_emc_b1_10_flexpwm3_pwm3_b: IOMUXC_GPIO_EMC_B1_10_FLEXPWM3_PWM3_B {
		pinmux = <0x42a10038 1 0x42a10540 0 0x42a10280>;
		pin-pdrv;
	};
	/omit-if-no-ref/ iomuxc_gpio_emc_b1_10_gpio2_io10: IOMUXC_GPIO_EMC_B1_10_GPIO2_IO10 {
		pinmux = <0x42a10038 5 0x0 0 0x42a10280>;
		pin-pdrv;
	};
	/omit-if-no-ref/ iomuxc_gpio_emc_b1_10_kpp_col5: IOMUXC_GPIO_EMC_B1_10_KPP_COL5 {
		pinmux = <0x42a10038 6 0x42a105bc 0 0x42a10280>;
		pin-pdrv;
	};
	/omit-if-no-ref/ iomuxc_gpio_emc_b1_10_lpuart4_ri_b: IOMUXC_GPIO_EMC_B1_10_LPUART4_RI_B {
		pinmux = <0x42a10038 3 0x0 0 0x42a10280>;
		pin-pdrv;
	};
	/omit-if-no-ref/ iomuxc_gpio_emc_b1_10_sinc3_embit3: IOMUXC_GPIO_EMC_B1_10_SINC3_EMBIT3 {
		pinmux = <0x42a10038 2 0x0 0 0x42a10280>;
		pin-pdrv;
	};
	/omit-if-no-ref/ iomuxc_gpio_emc_b1_10_sramc_addr_01: IOMUXC_GPIO_EMC_B1_10_SRAMC_ADDR_01 {
		pinmux = <0x42a10038 12 0x0 0 0x42a10280>;
		pin-pdrv;
	};
	/omit-if-no-ref/ iomuxc_gpio_emc_b1_11_ecat_pt0_rx_dv: IOMUXC_GPIO_EMC_B1_11_ECAT_PT0_RX_DV {
		pinmux = <0x42a1003c 10 0x42a104d4 0 0x42a10284>;
		pin-pdrv;
	};
	/omit-if-no-ref/ iomuxc_gpio_emc_b1_11_eth3_rx_en: IOMUXC_GPIO_EMC_B1_11_ETH3_RX_EN {
		pinmux = <0x42a1003c 4 0x42a1081c 0 0x42a10284>;
		pin-pdrv;
	};
	/omit-if-no-ref/ iomuxc_gpio_emc_b1_11_eth4_rx_en: IOMUXC_GPIO_EMC_B1_11_ETH4_RX_EN {
		pinmux = <0x42a1003c 9 0x42a1083c 0 0x42a10284>;
		pin-pdrv;
	};
	/omit-if-no-ref/ iomuxc_gpio_emc_b1_11_flexio1_d11: IOMUXC_GPIO_EMC_B1_11_FLEXIO1_D11 {
		pinmux = <0x42a1003c 8 0x0 0 0x42a10284>;
		pin-pdrv;
	};
	/omit-if-no-ref/ iomuxc_gpio_emc_b1_11_flexpwm3_pwm3_a: IOMUXC_GPIO_EMC_B1_11_FLEXPWM3_PWM3_A {
		pinmux = <0x42a1003c 1 0x42a10530 0 0x42a10284>;
		pin-pdrv;
	};
	/omit-if-no-ref/ iomuxc_gpio_emc_b1_11_gpio2_io11: IOMUXC_GPIO_EMC_B1_11_GPIO2_IO11 {
		pinmux = <0x42a1003c 5 0x0 0 0x42a10284>;
		pin-pdrv;
	};
	/omit-if-no-ref/ iomuxc_gpio_emc_b1_11_kpp_row4: IOMUXC_GPIO_EMC_B1_11_KPP_ROW4 {
		pinmux = <0x42a1003c 6 0x42a105d8 0 0x42a10284>;
		pin-pdrv;
	};
	/omit-if-no-ref/ iomuxc_gpio_emc_b1_11_lpuart4_dtr_b: IOMUXC_GPIO_EMC_B1_11_LPUART4_DTR_B {
		pinmux = <0x42a1003c 3 0x0 0 0x42a10284>;
		pin-pdrv;
	};
	/omit-if-no-ref/ iomuxc_gpio_emc_b1_11_sinc3_break: IOMUXC_GPIO_EMC_B1_11_SINC3_BREAK {
		pinmux = <0x42a1003c 2 0x0 0 0x42a10284>;
		pin-pdrv;
	};
	/omit-if-no-ref/ iomuxc_gpio_emc_b1_11_sramc_addr_02: IOMUXC_GPIO_EMC_B1_11_SRAMC_ADDR_02 {
		pinmux = <0x42a1003c 12 0x0 0 0x42a10284>;
		pin-pdrv;
	};
	/omit-if-no-ref/ iomuxc_gpio_emc_b1_12_ecat_pt0_rx_er: IOMUXC_GPIO_EMC_B1_12_ECAT_PT0_RX_ER {
		pinmux = <0x42a10040 10 0x42a104dc 0 0x42a10288>;
		pin-pdrv;
	};
	/omit-if-no-ref/ iomuxc_gpio_emc_b1_12_eth3_rx_er: IOMUXC_GPIO_EMC_B1_12_ETH3_RX_ER {
		pinmux = <0x42a10040 4 0x42a10820 0 0x42a10288>;
		pin-pdrv;
	};
	/omit-if-no-ref/ iomuxc_gpio_emc_b1_12_eth4_rx_er: IOMUXC_GPIO_EMC_B1_12_ETH4_RX_ER {
		pinmux = <0x42a10040 9 0x42a10840 0 0x42a10288>;
		pin-pdrv;
	};
	/omit-if-no-ref/ iomuxc_gpio_emc_b1_12_flexio1_d12: IOMUXC_GPIO_EMC_B1_12_FLEXIO1_D12 {
		pinmux = <0x42a10040 8 0x0 0 0x42a10288>;
		pin-pdrv;
	};
	/omit-if-no-ref/ iomuxc_gpio_emc_b1_12_flexpwm4_pwm0_a: IOMUXC_GPIO_EMC_B1_12_FLEXPWM4_PWM0_A {
		pinmux = <0x42a10040 1 0x0 0 0x42a10288>;
		pin-pdrv;
	};
	/omit-if-no-ref/ iomuxc_gpio_emc_b1_12_gpio2_io12: IOMUXC_GPIO_EMC_B1_12_GPIO2_IO12 {
		pinmux = <0x42a10040 5 0x0 0 0x42a10288>;
		pin-pdrv;
	};
	/omit-if-no-ref/ iomuxc_gpio_emc_b1_12_kpp_col4: IOMUXC_GPIO_EMC_B1_12_KPP_COL4 {
		pinmux = <0x42a10040 6 0x42a105b8 0 0x42a10288>;
		pin-pdrv;
	};
	/omit-if-no-ref/ iomuxc_gpio_emc_b1_12_lpuart4_txd: IOMUXC_GPIO_EMC_B1_12_LPUART4_TXD {
		pinmux = <0x42a10040 2 0x0 0 0x42a10288>;
		pin-pdrv;
	};
	/omit-if-no-ref/ iomuxc_gpio_emc_b1_12_sramc_addr_03: IOMUXC_GPIO_EMC_B1_12_SRAMC_ADDR_03 {
		pinmux = <0x42a10040 12 0x0 0 0x42a10288>;
		pin-pdrv;
	};
	/omit-if-no-ref/ iomuxc_gpio_emc_b1_13_eth2_rx_en: IOMUXC_GPIO_EMC_B1_13_ETH2_RX_EN {
		pinmux = <0x42a10044 3 0x42a107fc 0 0x42a1028c>;
		pin-pdrv;
	};
	/omit-if-no-ref/ iomuxc_gpio_emc_b1_13_eth3_tx_er: IOMUXC_GPIO_EMC_B1_13_ETH3_TX_ER {
		pinmux = <0x42a10044 4 0x0 0 0x42a1028c>;
		pin-pdrv;
	};
	/omit-if-no-ref/ iomuxc_gpio_emc_b1_13_eth4_tx_er: IOMUXC_GPIO_EMC_B1_13_ETH4_TX_ER {
		pinmux = <0x42a10044 9 0x0 0 0x42a1028c>;
		pin-pdrv;
	};
	/omit-if-no-ref/ iomuxc_gpio_emc_b1_13_flexio1_d13: IOMUXC_GPIO_EMC_B1_13_FLEXIO1_D13 {
		pinmux = <0x42a10044 8 0x0 0 0x42a1028c>;
		pin-pdrv;
	};
	/omit-if-no-ref/ iomuxc_gpio_emc_b1_13_flexpwm4_pwm0_b: IOMUXC_GPIO_EMC_B1_13_FLEXPWM4_PWM0_B {
		pinmux = <0x42a10044 1 0x0 0 0x42a1028c>;
		pin-pdrv;
	};
	/omit-if-no-ref/ iomuxc_gpio_emc_b1_13_gpio2_io13: IOMUXC_GPIO_EMC_B1_13_GPIO2_IO13 {
		pinmux = <0x42a10044 5 0x0 0 0x42a1028c>;
		pin-pdrv;
	};
	/omit-if-no-ref/ iomuxc_gpio_emc_b1_13_kpp_col1: IOMUXC_GPIO_EMC_B1_13_KPP_COL1 {
		pinmux = <0x42a10044 6 0x42a105ac 0 0x42a1028c>;
		pin-pdrv;
	};
	/omit-if-no-ref/ iomuxc_gpio_emc_b1_13_lpuart4_rxd: IOMUXC_GPIO_EMC_B1_13_LPUART4_RXD {
		pinmux = <0x42a10044 2 0x0 0 0x42a1028c>;
		pin-pdrv;
	};
	/omit-if-no-ref/ iomuxc_gpio_emc_b1_13_qtimer1_timer1: IOMUXC_GPIO_EMC_B1_13_QTIMER1_TIMER1 {
		pinmux = <0x42a10044 10 0x42a1085c 0 0x42a1028c>;
		pin-pdrv;
	};
	/omit-if-no-ref/ iomuxc_gpio_emc_b1_13_sramc_addr_04: IOMUXC_GPIO_EMC_B1_13_SRAMC_ADDR_04 {
		pinmux = <0x42a10044 12 0x0 0 0x42a1028c>;
		pin-pdrv;
	};
	/omit-if-no-ref/ iomuxc_gpio_emc_b1_14_eth2_tx_en: IOMUXC_GPIO_EMC_B1_14_ETH2_TX_EN {
		pinmux = <0x42a10048 3 0x0 0 0x42a10290>;
		pin-pdrv;
	};
	/omit-if-no-ref/ iomuxc_gpio_emc_b1_14_eth3_crs: IOMUXC_GPIO_EMC_B1_14_ETH3_CRS {
		pinmux = <0x42a10048 4 0x42a107b0 0 0x42a10290>;
		pin-pdrv;
	};
	/omit-if-no-ref/ iomuxc_gpio_emc_b1_14_eth4_crs: IOMUXC_GPIO_EMC_B1_14_ETH4_CRS {
		pinmux = <0x42a10048 9 0x42a107c0 0 0x42a10290>;
		pin-pdrv;
	};
	/omit-if-no-ref/ iomuxc_gpio_emc_b1_14_flexio1_d14: IOMUXC_GPIO_EMC_B1_14_FLEXIO1_D14 {
		pinmux = <0x42a10048 8 0x0 0 0x42a10290>;
		pin-pdrv;
	};
	/omit-if-no-ref/ iomuxc_gpio_emc_b1_14_flexpwm4_pwm1_a: IOMUXC_GPIO_EMC_B1_14_FLEXPWM4_PWM1_A {
		pinmux = <0x42a10048 1 0x0 0 0x42a10290>;
		pin-pdrv;
	};
	/omit-if-no-ref/ iomuxc_gpio_emc_b1_14_gpio2_io14: IOMUXC_GPIO_EMC_B1_14_GPIO2_IO14 {
		pinmux = <0x42a10048 5 0x0 0 0x42a10290>;
		pin-pdrv;
	};
	/omit-if-no-ref/ iomuxc_gpio_emc_b1_14_kpp_row0: IOMUXC_GPIO_EMC_B1_14_KPP_ROW0 {
		pinmux = <0x42a10048 6 0x42a105c8 0 0x42a10290>;
		pin-pdrv;
	};
	/omit-if-no-ref/ iomuxc_gpio_emc_b1_14_lpuart4_cts_b: IOMUXC_GPIO_EMC_B1_14_LPUART4_CTS_B {
		pinmux = <0x42a10048 10 0x42a10688 0 0x42a10290>;
		pin-pdrv;
	};
	/omit-if-no-ref/ iomuxc_gpio_emc_b1_14_lpuart5_txd: IOMUXC_GPIO_EMC_B1_14_LPUART5_TXD {
		pinmux = <0x42a10048 2 0x42a106a0 0 0x42a10290>;
		pin-pdrv;
	};
	/omit-if-no-ref/ iomuxc_gpio_emc_b1_14_sramc_addr_05: IOMUXC_GPIO_EMC_B1_14_SRAMC_ADDR_05 {
		pinmux = <0x42a10048 12 0x0 0 0x42a10290>;
		pin-pdrv;
	};
	/omit-if-no-ref/ iomuxc_gpio_emc_b1_15_eth2_tx_clk: IOMUXC_GPIO_EMC_B1_15_ETH2_TX_CLK {
		pinmux = <0x42a1004c 3 0x42a10814 0 0x42a10294>;
		pin-pdrv;
	};
	/omit-if-no-ref/ iomuxc_gpio_emc_b1_15_eth3_col: IOMUXC_GPIO_EMC_B1_15_ETH3_COL {
		pinmux = <0x42a1004c 4 0x42a107ac 0 0x42a10294>;
		pin-pdrv;
	};
	/omit-if-no-ref/ iomuxc_gpio_emc_b1_15_eth4_col: IOMUXC_GPIO_EMC_B1_15_ETH4_COL {
		pinmux = <0x42a1004c 9 0x42a107bc 0 0x42a10294>;
		pin-pdrv;
	};
	/omit-if-no-ref/ iomuxc_gpio_emc_b1_15_flexio1_d15: IOMUXC_GPIO_EMC_B1_15_FLEXIO1_D15 {
		pinmux = <0x42a1004c 8 0x0 0 0x42a10294>;
		pin-pdrv;
	};
	/omit-if-no-ref/ iomuxc_gpio_emc_b1_15_flexpwm4_pwm1_b: IOMUXC_GPIO_EMC_B1_15_FLEXPWM4_PWM1_B {
		pinmux = <0x42a1004c 1 0x0 0 0x42a10294>;
		pin-pdrv;
	};
	/omit-if-no-ref/ iomuxc_gpio_emc_b1_15_gpio2_io15: IOMUXC_GPIO_EMC_B1_15_GPIO2_IO15 {
		pinmux = <0x42a1004c 5 0x0 0 0x42a10294>;
		pin-pdrv;
	};
	/omit-if-no-ref/ iomuxc_gpio_emc_b1_15_kpp_col0: IOMUXC_GPIO_EMC_B1_15_KPP_COL0 {
		pinmux = <0x42a1004c 6 0x42a105a8 0 0x42a10294>;
		pin-pdrv;
	};
	/omit-if-no-ref/ iomuxc_gpio_emc_b1_15_lpuart4_rts_b: IOMUXC_GPIO_EMC_B1_15_LPUART4_RTS_B {
		pinmux = <0x42a1004c 10 0x0 0 0x42a10294>;
		pin-pdrv;
	};
	/omit-if-no-ref/ iomuxc_gpio_emc_b1_15_lpuart5_rxd: IOMUXC_GPIO_EMC_B1_15_LPUART5_RXD {
		pinmux = <0x42a1004c 2 0x42a1069c 0 0x42a10294>;
		pin-pdrv;
	};
	/omit-if-no-ref/ iomuxc_gpio_emc_b1_15_sramc_addr_06: IOMUXC_GPIO_EMC_B1_15_SRAMC_ADDR_06 {
		pinmux = <0x42a1004c 12 0x0 0 0x42a10294>;
		pin-pdrv;
	};
	/omit-if-no-ref/ iomuxc_gpio_emc_b1_16_eth2_mdc: IOMUXC_GPIO_EMC_B1_16_ETH2_MDC {
		pinmux = <0x42a10050 9 0x42a107a4 0 0x42a10298>;
		pin-pdrv;
	};
	/omit-if-no-ref/ iomuxc_gpio_emc_b1_16_eth2_rx_data0: IOMUXC_GPIO_EMC_B1_16_ETH2_RX_DATA0 {
		pinmux = <0x42a10050 3 0x42a10804 0 0x42a10298>;
		pin-pdrv;
	};
	/omit-if-no-ref/ iomuxc_gpio_emc_b1_16_eth3_mdc: IOMUXC_GPIO_EMC_B1_16_ETH3_MDC {
		pinmux = <0x42a10050 4 0x42a107b4 0 0x42a10298>;
		pin-pdrv;
	};
	/omit-if-no-ref/ iomuxc_gpio_emc_b1_16_eth4_mdc: IOMUXC_GPIO_EMC_B1_16_ETH4_MDC {
		pinmux = <0x42a10050 6 0x42a107c4 0 0x42a10298>;
		pin-pdrv;
	};
	/omit-if-no-ref/ iomuxc_gpio_emc_b1_16_flexio1_d16: IOMUXC_GPIO_EMC_B1_16_FLEXIO1_D16 {
		pinmux = <0x42a10050 8 0x0 0 0x42a10298>;
		pin-pdrv;
	};
	/omit-if-no-ref/ iomuxc_gpio_emc_b1_16_flexpwm4_pwm2_b: IOMUXC_GPIO_EMC_B1_16_FLEXPWM4_PWM2_B {
		pinmux = <0x42a10050 1 0x0 0 0x42a10298>;
		pin-pdrv;
	};
	/omit-if-no-ref/ iomuxc_gpio_emc_b1_16_gpio2_io16: IOMUXC_GPIO_EMC_B1_16_GPIO2_IO16 {
		pinmux = <0x42a10050 5 0x0 0 0x42a10298>;
		pin-pdrv;
	};
	/omit-if-no-ref/ iomuxc_gpio_emc_b1_16_lpspi6_pcs2: IOMUXC_GPIO_EMC_B1_16_LPSPI6_PCS2 {
		pinmux = <0x42a10050 10 0x42a10658 0 0x42a10298>;
		pin-pdrv;
	};
	/omit-if-no-ref/ iomuxc_gpio_emc_b1_16_sramc_addr_07: IOMUXC_GPIO_EMC_B1_16_SRAMC_ADDR_07 {
		pinmux = <0x42a10050 12 0x0 0 0x42a10298>;
		pin-pdrv;
	};
	/omit-if-no-ref/ iomuxc_gpio_emc_b1_17_eth2_mdio: IOMUXC_GPIO_EMC_B1_17_ETH2_MDIO {
		pinmux = <0x42a10054 9 0x42a107a8 0 0x42a1029c>;
		pin-pdrv;
	};
	/omit-if-no-ref/ iomuxc_gpio_emc_b1_17_eth2_rx_data1: IOMUXC_GPIO_EMC_B1_17_ETH2_RX_DATA1 {
		pinmux = <0x42a10054 3 0x42a10808 0 0x42a1029c>;
		pin-pdrv;
	};
	/omit-if-no-ref/ iomuxc_gpio_emc_b1_17_eth3_mdio: IOMUXC_GPIO_EMC_B1_17_ETH3_MDIO {
		pinmux = <0x42a10054 4 0x42a107b8 0 0x42a1029c>;
		pin-pdrv;
	};
	/omit-if-no-ref/ iomuxc_gpio_emc_b1_17_eth4_mdio: IOMUXC_GPIO_EMC_B1_17_ETH4_MDIO {
		pinmux = <0x42a10054 6 0x42a107c8 0 0x42a1029c>;
		pin-pdrv;
	};
	/omit-if-no-ref/ iomuxc_gpio_emc_b1_17_flexio1_d17: IOMUXC_GPIO_EMC_B1_17_FLEXIO1_D17 {
		pinmux = <0x42a10054 8 0x0 0 0x42a1029c>;
		pin-pdrv;
	};
	/omit-if-no-ref/ iomuxc_gpio_emc_b1_17_flexpwm4_pwm2_a: IOMUXC_GPIO_EMC_B1_17_FLEXPWM4_PWM2_A {
		pinmux = <0x42a10054 1 0x0 0 0x42a1029c>;
		pin-pdrv;
	};
	/omit-if-no-ref/ iomuxc_gpio_emc_b1_17_gpio2_io17: IOMUXC_GPIO_EMC_B1_17_GPIO2_IO17 {
		pinmux = <0x42a10054 5 0x0 0 0x42a1029c>;
		pin-pdrv;
	};
	/omit-if-no-ref/ iomuxc_gpio_emc_b1_17_lpspi6_pcs1: IOMUXC_GPIO_EMC_B1_17_LPSPI6_PCS1 {
		pinmux = <0x42a10054 10 0x42a10654 0 0x42a1029c>;
		pin-pdrv;
	};
	/omit-if-no-ref/ iomuxc_gpio_emc_b1_17_sramc_addr_08: IOMUXC_GPIO_EMC_B1_17_SRAMC_ADDR_08 {
		pinmux = <0x42a10054 12 0x0 0 0x42a1029c>;
		pin-pdrv;
	};
	/omit-if-no-ref/ iomuxc_gpio_emc_b1_26_ecat_pt1_txd_1: IOMUXC_GPIO_EMC_B1_26_ECAT_PT1_TXD_1 {
		pinmux = <0x42a10078 6 0x0 0 0x42a102c0>;
		pin-pdrv;
	};
	/omit-if-no-ref/ iomuxc_gpio_emc_b1_26_eth2_tx_data1: IOMUXC_GPIO_EMC_B1_26_ETH2_TX_DATA1 {
		pinmux = <0x42a10078 4 0x0 0 0x42a102c0>;
		pin-pdrv;
	};
	/omit-if-no-ref/ iomuxc_gpio_emc_b1_26_flexspi2_a_ss1_b: IOMUXC_GPIO_EMC_B1_26_FLEXSPI2_A_SS1_B {
		pinmux = <0x42a10078 3 0x0 0 0x42a102c0>;
		pin-pdrv;
	};
	/omit-if-no-ref/ iomuxc_gpio_emc_b1_26_gpio2_io26: IOMUXC_GPIO_EMC_B1_26_GPIO2_IO26 {
		pinmux = <0x42a10078 5 0x0 0 0x42a102c0>;
		pin-pdrv;
	};
	/omit-if-no-ref/ iomuxc_gpio_emc_b1_26_lpspi6_sck: IOMUXC_GPIO_EMC_B1_26_LPSPI6_SCK {
		pinmux = <0x42a10078 10 0x42a10660 1 0x42a102c0>;
		pin-pdrv;
	};
	/omit-if-no-ref/ iomuxc_gpio_emc_b1_26_sramc_we: IOMUXC_GPIO_EMC_B1_26_SRAMC_WE {
		pinmux = <0x42a10078 12 0x0 0 0x42a102c0>;
		pin-pdrv;
	};
	/omit-if-no-ref/ iomuxc_gpio_emc_b1_26_xbar_inout10: IOMUXC_GPIO_EMC_B1_26_XBAR_INOUT10 {
		pinmux = <0x42a10078 2 0x0 0 0x42a102c0>;
		pin-pdrv;
	};
	/omit-if-no-ref/ iomuxc_gpio_emc_b1_27_ecat_pt1_txd_0: IOMUXC_GPIO_EMC_B1_27_ECAT_PT1_TXD_0 {
		pinmux = <0x42a1007c 6 0x0 0 0x42a102c4>;
		pin-pdrv;
	};
	/omit-if-no-ref/ iomuxc_gpio_emc_b1_27_eth2_tx_data0: IOMUXC_GPIO_EMC_B1_27_ETH2_TX_DATA0 {
		pinmux = <0x42a1007c 4 0x0 0 0x42a102c4>;
		pin-pdrv;
	};
	/omit-if-no-ref/ iomuxc_gpio_emc_b1_27_flexspi2_b_ss1_b: IOMUXC_GPIO_EMC_B1_27_FLEXSPI2_B_SS1_B {
		pinmux = <0x42a1007c 3 0x0 0 0x42a102c4>;
		pin-pdrv;
	};
	/omit-if-no-ref/ iomuxc_gpio_emc_b1_27_gpio2_io27: IOMUXC_GPIO_EMC_B1_27_GPIO2_IO27 {
		pinmux = <0x42a1007c 5 0x0 0 0x42a102c4>;
		pin-pdrv;
	};
	/omit-if-no-ref/ iomuxc_gpio_emc_b1_27_lpspi6_sin: IOMUXC_GPIO_EMC_B1_27_LPSPI6_SIN {
		pinmux = <0x42a1007c 10 0x42a10664 1 0x42a102c4>;
		pin-pdrv;
	};
	/omit-if-no-ref/ iomuxc_gpio_emc_b1_27_lpuart6_ri_b: IOMUXC_GPIO_EMC_B1_27_LPUART6_RI_B {
		pinmux = <0x42a1007c 9 0x42a106b0 0 0x42a102c4>;
		pin-pdrv;
	};
	/omit-if-no-ref/ iomuxc_gpio_emc_b1_27_sramc_oeb: IOMUXC_GPIO_EMC_B1_27_SRAMC_OEB {
		pinmux = <0x42a1007c 12 0x0 0 0x42a102c4>;
		pin-pdrv;
	};
	/omit-if-no-ref/ iomuxc_gpio_emc_b1_27_xbar_inout11: IOMUXC_GPIO_EMC_B1_27_XBAR_INOUT11 {
		pinmux = <0x42a1007c 2 0x0 0 0x42a102c4>;
		pin-pdrv;
	};
	/omit-if-no-ref/ iomuxc_gpio_emc_b1_28_ecat_pt1_tx_en: IOMUXC_GPIO_EMC_B1_28_ECAT_PT1_TX_EN {
		pinmux = <0x42a10080 6 0x0 0 0x42a102c8>;
		pin-pdrv;
	};
	/omit-if-no-ref/ iomuxc_gpio_emc_b1_28_eth2_tx_en: IOMUXC_GPIO_EMC_B1_28_ETH2_TX_EN {
		pinmux = <0x42a10080 4 0x0 0 0x42a102c8>;
		pin-pdrv;
	};
	/omit-if-no-ref/ iomuxc_gpio_emc_b1_28_flexspi2_b_ss0_b: IOMUXC_GPIO_EMC_B1_28_FLEXSPI2_B_SS0_B {
		pinmux = <0x42a10080 3 0x0 0 0x42a102c8>;
		pin-pdrv;
	};
	/omit-if-no-ref/ iomuxc_gpio_emc_b1_28_gpio2_io28: IOMUXC_GPIO_EMC_B1_28_GPIO2_IO28 {
		pinmux = <0x42a10080 5 0x0 0 0x42a102c8>;
		pin-pdrv;
	};
	/omit-if-no-ref/ iomuxc_gpio_emc_b1_28_lpspi6_sout: IOMUXC_GPIO_EMC_B1_28_LPSPI6_SOUT {
		pinmux = <0x42a10080 10 0x42a10668 1 0x42a102c8>;
		pin-pdrv;
	};
	/omit-if-no-ref/ iomuxc_gpio_emc_b1_28_lpuart6_dtr_b: IOMUXC_GPIO_EMC_B1_28_LPUART6_DTR_B {
		pinmux = <0x42a10080 9 0x0 0 0x42a102c8>;
		pin-pdrv;
	};
	/omit-if-no-ref/ iomuxc_gpio_emc_b1_28_sramc_adv: IOMUXC_GPIO_EMC_B1_28_SRAMC_ADV {
		pinmux = <0x42a10080 12 0x0 0 0x42a102c8>;
		pin-pdrv;
	};
	/omit-if-no-ref/ iomuxc_gpio_emc_b1_28_xbar_inout12: IOMUXC_GPIO_EMC_B1_28_XBAR_INOUT12 {
		pinmux = <0x42a10080 2 0x0 0 0x42a102c8>;
		pin-pdrv;
	};
	/omit-if-no-ref/ iomuxc_gpio_emc_b1_29_ecat_pt1_tx_clk: IOMUXC_GPIO_EMC_B1_29_ECAT_PT1_TX_CLK {
		pinmux = <0x42a10084 6 0x42a104e8 0 0x42a102cc>;
		pin-pdrv;
	};
	/omit-if-no-ref/ iomuxc_gpio_emc_b1_29_eth2_tx_clk: IOMUXC_GPIO_EMC_B1_29_ETH2_TX_CLK {
		pinmux = <0x42a10084 4 0x42a10814 1 0x42a102cc>;
		pin-pdrv;
	};
	/omit-if-no-ref/ iomuxc_gpio_emc_b1_29_flexspi2_b_dqs: IOMUXC_GPIO_EMC_B1_29_FLEXSPI2_B_DQS {
		pinmux = <0x42a10084 3 0x42a10574 1 0x42a102cc>;
		pin-pdrv;
	};
	/omit-if-no-ref/ iomuxc_gpio_emc_b1_29_gpio2_io29: IOMUXC_GPIO_EMC_B1_29_GPIO2_IO29 {
		pinmux = <0x42a10084 5 0x0 0 0x42a102cc>;
		pin-pdrv;
	};
	/omit-if-no-ref/ iomuxc_gpio_emc_b1_29_lpspi6_pcs0: IOMUXC_GPIO_EMC_B1_29_LPSPI6_PCS0 {
		pinmux = <0x42a10084 10 0x42a10650 1 0x42a102cc>;
		pin-pdrv;
	};
	/omit-if-no-ref/ iomuxc_gpio_emc_b1_29_lpuart6_dcd_b: IOMUXC_GPIO_EMC_B1_29_LPUART6_DCD_B {
		pinmux = <0x42a10084 9 0x42a106a8 0 0x42a102cc>;
		pin-pdrv;
	};
	/omit-if-no-ref/ iomuxc_gpio_emc_b1_29_sramc_cs0: IOMUXC_GPIO_EMC_B1_29_SRAMC_CS0 {
		pinmux = <0x42a10084 12 0x0 0 0x42a102cc>;
		pin-pdrv;
	};
	/omit-if-no-ref/ iomuxc_gpio_emc_b1_29_xbar_inout13: IOMUXC_GPIO_EMC_B1_29_XBAR_INOUT13 {
		pinmux = <0x42a10084 2 0x0 0 0x42a102cc>;
		pin-pdrv;
	};
	/omit-if-no-ref/ iomuxc_gpio_emc_b1_30_ecat_pt1_rxd_0: IOMUXC_GPIO_EMC_B1_30_ECAT_PT1_RXD_0 {
		pinmux = <0x42a10088 6 0x42a104b8 0 0x42a102d0>;
		pin-pdrv;
	};
	/omit-if-no-ref/ iomuxc_gpio_emc_b1_30_eth2_rx_data0: IOMUXC_GPIO_EMC_B1_30_ETH2_RX_DATA0 {
		pinmux = <0x42a10088 4 0x42a10804 1 0x42a102d0>;
		pin-pdrv;
	};
	/omit-if-no-ref/ iomuxc_gpio_emc_b1_30_flexpwm3_pwm0_a: IOMUXC_GPIO_EMC_B1_30_FLEXPWM3_PWM0_A {
		pinmux = <0x42a10088 1 0x42a10524 0 0x42a102d0>;
		pin-pdrv;
	};
	/omit-if-no-ref/ iomuxc_gpio_emc_b1_30_flexspi2_b_data3: IOMUXC_GPIO_EMC_B1_30_FLEXSPI2_B_DATA3 {
		pinmux = <0x42a10088 3 0x42a10594 1 0x42a102d0>;
		pin-pdrv;
	};
	/omit-if-no-ref/ iomuxc_gpio_emc_b1_30_gpio2_io30: IOMUXC_GPIO_EMC_B1_30_GPIO2_IO30 {
		pinmux = <0x42a10088 5 0x0 0 0x42a102d0>;
		pin-pdrv;
	};
	/omit-if-no-ref/ iomuxc_gpio_emc_b1_30_lpspi6_pcs1: IOMUXC_GPIO_EMC_B1_30_LPSPI6_PCS1 {
		pinmux = <0x42a10088 10 0x42a10654 1 0x42a102d0>;
		pin-pdrv;
	};
	/omit-if-no-ref/ iomuxc_gpio_emc_b1_30_lpuart6_dsr_b: IOMUXC_GPIO_EMC_B1_30_LPUART6_DSR_B {
		pinmux = <0x42a10088 9 0x42a106ac 0 0x42a102d0>;
		pin-pdrv;
	};
	/omit-if-no-ref/ iomuxc_gpio_emc_b1_30_sramc_data_08: IOMUXC_GPIO_EMC_B1_30_SRAMC_DATA_08 {
		pinmux = <0x42a10088 12 0x0 0 0x42a102d0>;
		pin-pdrv;
	};
	/omit-if-no-ref/ iomuxc_gpio_emc_b1_30_xbar_inout14: IOMUXC_GPIO_EMC_B1_30_XBAR_INOUT14 {
		pinmux = <0x42a10088 2 0x42a10934 0 0x42a102d0>;
		pin-pdrv;
	};
	/omit-if-no-ref/ iomuxc_gpio_emc_b1_31_ecat_pt1_rxd_1: IOMUXC_GPIO_EMC_B1_31_ECAT_PT1_RXD_1 {
		pinmux = <0x42a1008c 6 0x42a104c0 0 0x42a102d4>;
		pin-pdrv;
	};
	/omit-if-no-ref/ iomuxc_gpio_emc_b1_31_eth2_rx_data1: IOMUXC_GPIO_EMC_B1_31_ETH2_RX_DATA1 {
		pinmux = <0x42a1008c 4 0x42a10808 1 0x42a102d4>;
		pin-pdrv;
	};
	/omit-if-no-ref/ iomuxc_gpio_emc_b1_31_flexpwm3_pwm0_b: IOMUXC_GPIO_EMC_B1_31_FLEXPWM3_PWM0_B {
		pinmux = <0x42a1008c 1 0x42a10534 0 0x42a102d4>;
		pin-pdrv;
	};
	/omit-if-no-ref/ iomuxc_gpio_emc_b1_31_flexspi2_b_data2: IOMUXC_GPIO_EMC_B1_31_FLEXSPI2_B_DATA2 {
		pinmux = <0x42a1008c 3 0x42a10590 1 0x42a102d4>;
		pin-pdrv;
	};
	/omit-if-no-ref/ iomuxc_gpio_emc_b1_31_gpio2_io31: IOMUXC_GPIO_EMC_B1_31_GPIO2_IO31 {
		pinmux = <0x42a1008c 5 0x0 0 0x42a102d4>;
		pin-pdrv;
	};
	/omit-if-no-ref/ iomuxc_gpio_emc_b1_31_lpspi5_sck: IOMUXC_GPIO_EMC_B1_31_LPSPI5_SCK {
		pinmux = <0x42a1008c 9 0x42a10644 0 0x42a102d4>;
		pin-pdrv;
	};
	/omit-if-no-ref/ iomuxc_gpio_emc_b1_31_lpspi6_pcs2: IOMUXC_GPIO_EMC_B1_31_LPSPI6_PCS2 {
		pinmux = <0x42a1008c 10 0x42a10658 1 0x42a102d4>;
		pin-pdrv;
	};
	/omit-if-no-ref/ iomuxc_gpio_emc_b1_31_lpuart6_txd: IOMUXC_GPIO_EMC_B1_31_LPUART6_TXD {
		pinmux = <0x42a1008c 2 0x42a106b8 0 0x42a102d4>;
		pin-pdrv;
	};
	/omit-if-no-ref/ iomuxc_gpio_emc_b1_31_sramc_data_09: IOMUXC_GPIO_EMC_B1_31_SRAMC_DATA_09 {
		pinmux = <0x42a1008c 12 0x0 0 0x42a102d4>;
		pin-pdrv;
	};
	/omit-if-no-ref/ iomuxc_gpio_emc_b1_32_ecat_pt1_rx_dv: IOMUXC_GPIO_EMC_B1_32_ECAT_PT1_RX_DV {
		pinmux = <0x42a10090 6 0x42a104d8 0 0x42a102d8>;
		pin-pdrv;
	};
	/omit-if-no-ref/ iomuxc_gpio_emc_b1_32_eth2_rx_en: IOMUXC_GPIO_EMC_B1_32_ETH2_RX_EN {
		pinmux = <0x42a10090 4 0x42a107fc 1 0x42a102d8>;
		pin-pdrv;
	};
	/omit-if-no-ref/ iomuxc_gpio_emc_b1_32_flexpwm3_pwm1_a: IOMUXC_GPIO_EMC_B1_32_FLEXPWM3_PWM1_A {
		pinmux = <0x42a10090 1 0x42a10528 0 0x42a102d8>;
		pin-pdrv;
	};
	/omit-if-no-ref/ iomuxc_gpio_emc_b1_32_flexspi2_b_data1: IOMUXC_GPIO_EMC_B1_32_FLEXSPI2_B_DATA1 {
		pinmux = <0x42a10090 3 0x42a1058c 1 0x42a102d8>;
		pin-pdrv;
	};
	/omit-if-no-ref/ iomuxc_gpio_emc_b1_32_gpio3_io00: IOMUXC_GPIO_EMC_B1_32_GPIO3_IO00 {
		pinmux = <0x42a10090 5 0x0 0 0x42a102d8>;
		pin-pdrv;
	};
	/omit-if-no-ref/ iomuxc_gpio_emc_b1_32_lpspi5_sout: IOMUXC_GPIO_EMC_B1_32_LPSPI5_SOUT {
		pinmux = <0x42a10090 9 0x42a1064c 0 0x42a102d8>;
		pin-pdrv;
	};
	/omit-if-no-ref/ iomuxc_gpio_emc_b1_32_lpspi6_pcs3: IOMUXC_GPIO_EMC_B1_32_LPSPI6_PCS3 {
		pinmux = <0x42a10090 10 0x42a1065c 0 0x42a102d8>;
		pin-pdrv;
	};
	/omit-if-no-ref/ iomuxc_gpio_emc_b1_32_lpuart6_rxd: IOMUXC_GPIO_EMC_B1_32_LPUART6_RXD {
		pinmux = <0x42a10090 2 0x42a106b4 0 0x42a102d8>;
		pin-pdrv;
	};
	/omit-if-no-ref/ iomuxc_gpio_emc_b1_32_sramc_data_10: IOMUXC_GPIO_EMC_B1_32_SRAMC_DATA_10 {
		pinmux = <0x42a10090 12 0x0 0 0x42a102d8>;
		pin-pdrv;
	};
	/omit-if-no-ref/ iomuxc_gpio_emc_b1_33_ecat_pt1_rx_er: IOMUXC_GPIO_EMC_B1_33_ECAT_PT1_RX_ER {
		pinmux = <0x42a10094 6 0x42a104e0 0 0x42a102dc>;
		pin-pdrv;
	};
	/omit-if-no-ref/ iomuxc_gpio_emc_b1_33_eth2_rx_clk: IOMUXC_GPIO_EMC_B1_33_ETH2_RX_CLK {
		pinmux = <0x42a10094 10 0x42a107f8 1 0x42a102dc>;
		pin-pdrv;
	};
	/omit-if-no-ref/ iomuxc_gpio_emc_b1_33_eth2_rx_er: IOMUXC_GPIO_EMC_B1_33_ETH2_RX_ER {
		pinmux = <0x42a10094 4 0x42a10800 0 0x42a102dc>;
		pin-pdrv;
	};
	/omit-if-no-ref/ iomuxc_gpio_emc_b1_33_flexpwm3_pwm1_b: IOMUXC_GPIO_EMC_B1_33_FLEXPWM3_PWM1_B {
		pinmux = <0x42a10094 1 0x42a10538 0 0x42a102dc>;
		pin-pdrv;
	};
	/omit-if-no-ref/ iomuxc_gpio_emc_b1_33_flexspi2_b_data0: IOMUXC_GPIO_EMC_B1_33_FLEXSPI2_B_DATA0 {
		pinmux = <0x42a10094 3 0x42a10588 1 0x42a102dc>;
		pin-pdrv;
	};
	/omit-if-no-ref/ iomuxc_gpio_emc_b1_33_gpio3_io01: IOMUXC_GPIO_EMC_B1_33_GPIO3_IO01 {
		pinmux = <0x42a10094 5 0x0 0 0x42a102dc>;
		pin-pdrv;
	};
	/omit-if-no-ref/ iomuxc_gpio_emc_b1_33_lpspi5_sin: IOMUXC_GPIO_EMC_B1_33_LPSPI5_SIN {
		pinmux = <0x42a10094 9 0x42a10648 0 0x42a102dc>;
		pin-pdrv;
	};
	/omit-if-no-ref/ iomuxc_gpio_emc_b1_33_lpuart6_cts_b: IOMUXC_GPIO_EMC_B1_33_LPUART6_CTS_B {
		pinmux = <0x42a10094 2 0x42a106a4 0 0x42a102dc>;
		pin-pdrv;
	};
	/omit-if-no-ref/ iomuxc_gpio_emc_b1_33_sramc_data_11: IOMUXC_GPIO_EMC_B1_33_SRAMC_DATA_11 {
		pinmux = <0x42a10094 12 0x0 0 0x42a102dc>;
		pin-pdrv;
	};
	/omit-if-no-ref/ iomuxc_gpio_emc_b1_34_ecat_pt1_rxd_2: IOMUXC_GPIO_EMC_B1_34_ECAT_PT1_RXD_2 {
		pinmux = <0x42a10098 6 0x42a104c8 0 0x42a102e0>;
		pin-pdrv;
	};
	/omit-if-no-ref/ iomuxc_gpio_emc_b1_34_eth0_tx_data0: IOMUXC_GPIO_EMC_B1_34_ETH0_TX_DATA0 {
		pinmux = <0x42a10098 9 0x0 0 0x42a102e0>;
		pin-pdrv;
	};
	/omit-if-no-ref/ iomuxc_gpio_emc_b1_34_eth2_rx_data2: IOMUXC_GPIO_EMC_B1_34_ETH2_RX_DATA2 {
		pinmux = <0x42a10098 4 0x42a1080c 1 0x42a102e0>;
		pin-pdrv;
	};
	/omit-if-no-ref/ iomuxc_gpio_emc_b1_34_flexpwm3_pwm2_b: IOMUXC_GPIO_EMC_B1_34_FLEXPWM3_PWM2_B {
		pinmux = <0x42a10098 1 0x42a1053c 0 0x42a102e0>;
		pin-pdrv;
	};
	/omit-if-no-ref/ iomuxc_gpio_emc_b1_34_flexspi2_b_sclk: IOMUXC_GPIO_EMC_B1_34_FLEXSPI2_B_SCLK {
		pinmux = <0x42a10098 3 0x42a1059c 0 0x42a102e0>;
		pin-pdrv;
	};
	/omit-if-no-ref/ iomuxc_gpio_emc_b1_34_gpio3_io02: IOMUXC_GPIO_EMC_B1_34_GPIO3_IO02 {
		pinmux = <0x42a10098 5 0x0 0 0x42a102e0>;
		pin-pdrv;
	};
	/omit-if-no-ref/ iomuxc_gpio_emc_b1_34_lpspi5_pcs0: IOMUXC_GPIO_EMC_B1_34_LPSPI5_PCS0 {
		pinmux = <0x42a10098 10 0x42a10634 0 0x42a102e0>;
		pin-pdrv;
	};
	/omit-if-no-ref/ iomuxc_gpio_emc_b1_34_lpuart6_rts_b: IOMUXC_GPIO_EMC_B1_34_LPUART6_RTS_B {
		pinmux = <0x42a10098 2 0x0 0 0x42a102e0>;
		pin-pdrv;
	};
	/omit-if-no-ref/ iomuxc_gpio_emc_b1_34_sramc_data_12: IOMUXC_GPIO_EMC_B1_34_SRAMC_DATA_12 {
		pinmux = <0x42a10098 12 0x0 0 0x42a102e0>;
		pin-pdrv;
	};
	/omit-if-no-ref/ iomuxc_gpio_emc_b1_35_ecat_pt1_rxd_3: IOMUXC_GPIO_EMC_B1_35_ECAT_PT1_RXD_3 {
		pinmux = <0x42a1009c 6 0x42a104d0 0 0x42a102e4>;
		pin-pdrv;
	};
	/omit-if-no-ref/ iomuxc_gpio_emc_b1_35_eth0_tx_data1: IOMUXC_GPIO_EMC_B1_35_ETH0_TX_DATA1 {
		pinmux = <0x42a1009c 9 0x0 0 0x42a102e4>;
		pin-pdrv;
	};
	/omit-if-no-ref/ iomuxc_gpio_emc_b1_35_eth2_rx_data3: IOMUXC_GPIO_EMC_B1_35_ETH2_RX_DATA3 {
		pinmux = <0x42a1009c 4 0x42a10810 1 0x42a102e4>;
		pin-pdrv;
	};
	/omit-if-no-ref/ iomuxc_gpio_emc_b1_35_flexpwm3_pwm2_a: IOMUXC_GPIO_EMC_B1_35_FLEXPWM3_PWM2_A {
		pinmux = <0x42a1009c 1 0x42a1052c 0 0x42a102e4>;
		pin-pdrv;
	};
	/omit-if-no-ref/ iomuxc_gpio_emc_b1_35_flexspi2_a_data0: IOMUXC_GPIO_EMC_B1_35_FLEXSPI2_A_DATA0 {
		pinmux = <0x42a1009c 3 0x42a10578 0 0x42a102e4>;
		pin-pdrv;
	};
	/omit-if-no-ref/ iomuxc_gpio_emc_b1_35_gpio3_io03: IOMUXC_GPIO_EMC_B1_35_GPIO3_IO03 {
		pinmux = <0x42a1009c 5 0x0 0 0x42a102e4>;
		pin-pdrv;
	};
	/omit-if-no-ref/ iomuxc_gpio_emc_b1_35_lpspi5_pcs1: IOMUXC_GPIO_EMC_B1_35_LPSPI5_PCS1 {
		pinmux = <0x42a1009c 10 0x42a10638 0 0x42a102e4>;
		pin-pdrv;
	};
	/omit-if-no-ref/ iomuxc_gpio_emc_b1_35_lpuart5_txd: IOMUXC_GPIO_EMC_B1_35_LPUART5_TXD {
		pinmux = <0x42a1009c 2 0x42a106a0 1 0x42a102e4>;
		pin-pdrv;
	};
	/omit-if-no-ref/ iomuxc_gpio_emc_b1_35_sramc_data_13: IOMUXC_GPIO_EMC_B1_35_SRAMC_DATA_13 {
		pinmux = <0x42a1009c 12 0x0 0 0x42a102e4>;
		pin-pdrv;
	};
	/omit-if-no-ref/ iomuxc_gpio_emc_b1_36_ecat_pt1_txd_3: IOMUXC_GPIO_EMC_B1_36_ECAT_PT1_TXD_3 {
		pinmux = <0x42a100a0 6 0x0 0 0x42a102e8>;
		pin-pdrv;
	};
	/omit-if-no-ref/ iomuxc_gpio_emc_b1_36_eth0_tx_en: IOMUXC_GPIO_EMC_B1_36_ETH0_TX_EN {
		pinmux = <0x42a100a0 9 0x0 0 0x42a102e8>;
		pin-pdrv;
	};
	/omit-if-no-ref/ iomuxc_gpio_emc_b1_36_eth2_tx_data3: IOMUXC_GPIO_EMC_B1_36_ETH2_TX_DATA3 {
		pinmux = <0x42a100a0 4 0x0 0 0x42a102e8>;
		pin-pdrv;
	};
	/omit-if-no-ref/ iomuxc_gpio_emc_b1_36_flexspi2_a_data1: IOMUXC_GPIO_EMC_B1_36_FLEXSPI2_A_DATA1 {
		pinmux = <0x42a100a0 3 0x42a1057c 0 0x42a102e8>;
		pin-pdrv;
	};
	/omit-if-no-ref/ iomuxc_gpio_emc_b1_36_gpio3_io04: IOMUXC_GPIO_EMC_B1_36_GPIO3_IO04 {
		pinmux = <0x42a100a0 5 0x0 0 0x42a102e8>;
		pin-pdrv;
	};
	/omit-if-no-ref/ iomuxc_gpio_emc_b1_36_lpuart5_rxd: IOMUXC_GPIO_EMC_B1_36_LPUART5_RXD {
		pinmux = <0x42a100a0 2 0x42a1069c 1 0x42a102e8>;
		pin-pdrv;
	};
	/omit-if-no-ref/ iomuxc_gpio_emc_b1_36_sramc_data_14: IOMUXC_GPIO_EMC_B1_36_SRAMC_DATA_14 {
		pinmux = <0x42a100a0 12 0x0 0 0x42a102e8>;
		pin-pdrv;
	};
	/omit-if-no-ref/ iomuxc_gpio_emc_b1_37_ecat_pt1_txd_2: IOMUXC_GPIO_EMC_B1_37_ECAT_PT1_TXD_2 {
		pinmux = <0x42a100a4 6 0x0 0 0x42a102ec>;
		pin-pdrv;
	};
	/omit-if-no-ref/ iomuxc_gpio_emc_b1_37_eth0_tx_clk: IOMUXC_GPIO_EMC_B1_37_ETH0_TX_CLK {
		pinmux = <0x42a100a4 9 0x42a107f4 0 0x42a102ec>;
		pin-pdrv;
	};
	/omit-if-no-ref/ iomuxc_gpio_emc_b1_37_eth2_tx_data2: IOMUXC_GPIO_EMC_B1_37_ETH2_TX_DATA2 {
		pinmux = <0x42a100a4 4 0x0 0 0x42a102ec>;
		pin-pdrv;
	};
	/omit-if-no-ref/ iomuxc_gpio_emc_b1_37_flexspi2_a_data2: IOMUXC_GPIO_EMC_B1_37_FLEXSPI2_A_DATA2 {
		pinmux = <0x42a100a4 3 0x42a10580 0 0x42a102ec>;
		pin-pdrv;
	};
	/omit-if-no-ref/ iomuxc_gpio_emc_b1_37_gpio3_io05: IOMUXC_GPIO_EMC_B1_37_GPIO3_IO05 {
		pinmux = <0x42a100a4 5 0x0 0 0x42a102ec>;
		pin-pdrv;
	};
	/omit-if-no-ref/ iomuxc_gpio_emc_b1_37_lpuart5_cts_b: IOMUXC_GPIO_EMC_B1_37_LPUART5_CTS_B {
		pinmux = <0x42a100a4 2 0x42a1068c 0 0x42a102ec>;
		pin-pdrv;
	};
	/omit-if-no-ref/ iomuxc_gpio_emc_b1_37_sramc_data_15: IOMUXC_GPIO_EMC_B1_37_SRAMC_DATA_15 {
		pinmux = <0x42a100a4 12 0x0 0 0x42a102ec>;
		pin-pdrv;
	};
	/omit-if-no-ref/ iomuxc_gpio_emc_b1_38_ecat_pt1_rx_clk: IOMUXC_GPIO_EMC_B1_38_ECAT_PT1_RX_CLK {
		pinmux = <0x42a100a8 6 0x42a104b0 0 0x42a102f0>;
		pin-pdrv;
	};
	/omit-if-no-ref/ iomuxc_gpio_emc_b1_38_eth0_rx_data0: IOMUXC_GPIO_EMC_B1_38_ETH0_RX_DATA0 {
		pinmux = <0x42a100a8 9 0x42a107e4 0 0x42a102f0>;
		pin-pdrv;
	};
	/omit-if-no-ref/ iomuxc_gpio_emc_b1_38_eth2_rx_clk: IOMUXC_GPIO_EMC_B1_38_ETH2_RX_CLK {
		pinmux = <0x42a100a8 4 0x42a107f8 2 0x42a102f0>;
		pin-pdrv;
	};
	/omit-if-no-ref/ iomuxc_gpio_emc_b1_38_flexspi2_a_data3: IOMUXC_GPIO_EMC_B1_38_FLEXSPI2_A_DATA3 {
		pinmux = <0x42a100a8 3 0x42a10584 0 0x42a102f0>;
		pin-pdrv;
	};
	/omit-if-no-ref/ iomuxc_gpio_emc_b1_38_gpio3_io06: IOMUXC_GPIO_EMC_B1_38_GPIO3_IO06 {
		pinmux = <0x42a100a8 5 0x0 0 0x42a102f0>;
		pin-pdrv;
	};
	/omit-if-no-ref/ iomuxc_gpio_emc_b1_38_lpuart5_rts_b: IOMUXC_GPIO_EMC_B1_38_LPUART5_RTS_B {
		pinmux = <0x42a100a8 2 0x0 0 0x42a102f0>;
		pin-pdrv;
	};
	/omit-if-no-ref/ iomuxc_gpio_emc_b1_38_sramc_ubb: IOMUXC_GPIO_EMC_B1_38_SRAMC_UBB {
		pinmux = <0x42a100a8 12 0x0 0 0x42a102f0>;
		pin-pdrv;
	};
	/omit-if-no-ref/ iomuxc_gpio_emc_b1_39_eth0_rx_data1: IOMUXC_GPIO_EMC_B1_39_ETH0_RX_DATA1 {
		pinmux = <0x42a100ac 9 0x42a107e8 0 0x42a102f4>;
		pin-pdrv;
	};
	/omit-if-no-ref/ iomuxc_gpio_emc_b1_39_eth2_tx_er: IOMUXC_GPIO_EMC_B1_39_ETH2_TX_ER {
		pinmux = <0x42a100ac 4 0x0 0 0x42a102f4>;
		pin-pdrv;
	};
	/omit-if-no-ref/ iomuxc_gpio_emc_b1_39_flexspi2_a_ss0_b: IOMUXC_GPIO_EMC_B1_39_FLEXSPI2_A_SS0_B {
		pinmux = <0x42a100ac 3 0x0 0 0x42a102f4>;
		pin-pdrv;
	};
	/omit-if-no-ref/ iomuxc_gpio_emc_b1_39_gpio3_io07: IOMUXC_GPIO_EMC_B1_39_GPIO3_IO07 {
		pinmux = <0x42a100ac 5 0x0 0 0x42a102f4>;
		pin-pdrv;
	};
	/omit-if-no-ref/ iomuxc_gpio_emc_b1_39_qtimer2_timer1: IOMUXC_GPIO_EMC_B1_39_QTIMER2_TIMER1 {
		pinmux = <0x42a100ac 6 0x42a10868 0 0x42a102f4>;
		pin-pdrv;
	};
	/omit-if-no-ref/ iomuxc_gpio_emc_b1_39_sramc_cs1: IOMUXC_GPIO_EMC_B1_39_SRAMC_CS1 {
		pinmux = <0x42a100ac 12 0x0 0 0x42a102f4>;
		pin-pdrv;
	};
	/omit-if-no-ref/ iomuxc_gpio_emc_b1_39_xbar_inout15: IOMUXC_GPIO_EMC_B1_39_XBAR_INOUT15 {
		pinmux = <0x42a100ac 2 0x42a10938 0 0x42a102f4>;
		pin-pdrv;
	};
	/omit-if-no-ref/ iomuxc_gpio_emc_b1_40_eth0_rx_en: IOMUXC_GPIO_EMC_B1_40_ETH0_RX_EN {
		pinmux = <0x42a100b0 9 0x42a107dc 0 0x42a102f8>;
		pin-pdrv;
	};
	/omit-if-no-ref/ iomuxc_gpio_emc_b1_40_eth2_crs: IOMUXC_GPIO_EMC_B1_40_ETH2_CRS {
		pinmux = <0x42a100b0 4 0x42a107a0 1 0x42a102f8>;
		pin-pdrv;
	};
	/omit-if-no-ref/ iomuxc_gpio_emc_b1_40_eth2_mdc: IOMUXC_GPIO_EMC_B1_40_ETH2_MDC {
		pinmux = <0x42a100b0 2 0x42a107a4 1 0x42a102f8>;
		pin-pdrv;
	};
	/omit-if-no-ref/ iomuxc_gpio_emc_b1_40_flexspi2_a_dqs: IOMUXC_GPIO_EMC_B1_40_FLEXSPI2_A_DQS {
		pinmux = <0x42a100b0 3 0x42a10570 0 0x42a102f8>;
		pin-pdrv;
	};
	/omit-if-no-ref/ iomuxc_gpio_emc_b1_40_gpio3_io08: IOMUXC_GPIO_EMC_B1_40_GPIO3_IO08 {
		pinmux = <0x42a100b0 5 0x0 0 0x42a102f8>;
		pin-pdrv;
	};
	/omit-if-no-ref/ iomuxc_gpio_emc_b1_40_netc_emdc: IOMUXC_GPIO_EMC_B1_40_NETC_EMDC {
		pinmux = <0x42a100b0 1 0x0 0 0x42a102f8>;
		pin-pdrv;
	};
	/omit-if-no-ref/ iomuxc_gpio_emc_b1_40_qtimer3_timer1: IOMUXC_GPIO_EMC_B1_40_QTIMER3_TIMER1 {
		pinmux = <0x42a100b0 6 0x42a10874 0 0x42a102f8>;
		pin-pdrv;
	};
	/omit-if-no-ref/ iomuxc_gpio_emc_b1_40_sramc_cs2: IOMUXC_GPIO_EMC_B1_40_SRAMC_CS2 {
		pinmux = <0x42a100b0 12 0x0 0 0x42a102f8>;
		pin-pdrv;
	};
	/omit-if-no-ref/ iomuxc_gpio_emc_b1_41_eth0_rx_er: IOMUXC_GPIO_EMC_B1_41_ETH0_RX_ER {
		pinmux = <0x42a100b4 9 0x42a107e0 0 0x42a102fc>;
		pin-pdrv;
	};
	/omit-if-no-ref/ iomuxc_gpio_emc_b1_41_eth2_col: IOMUXC_GPIO_EMC_B1_41_ETH2_COL {
		pinmux = <0x42a100b4 4 0x42a1079c 1 0x42a102fc>;
		pin-pdrv;
	};
	/omit-if-no-ref/ iomuxc_gpio_emc_b1_41_eth2_mdio: IOMUXC_GPIO_EMC_B1_41_ETH2_MDIO {
		pinmux = <0x42a100b4 2 0x42a107a8 1 0x42a102fc>;
		pin-pdrv;
	};
	/omit-if-no-ref/ iomuxc_gpio_emc_b1_41_flexspi2_a_sclk: IOMUXC_GPIO_EMC_B1_41_FLEXSPI2_A_SCLK {
		pinmux = <0x42a100b4 3 0x42a10598 0 0x42a102fc>;
		pin-pdrv;
	};
	/omit-if-no-ref/ iomuxc_gpio_emc_b1_41_gpio3_io09: IOMUXC_GPIO_EMC_B1_41_GPIO3_IO09 {
		pinmux = <0x42a100b4 5 0x0 0 0x42a102fc>;
		pin-pdrv;
	};
	/omit-if-no-ref/ iomuxc_gpio_emc_b1_41_netc_emdio: IOMUXC_GPIO_EMC_B1_41_NETC_EMDIO {
		pinmux = <0x42a100b4 1 0x42a10798 1 0x42a102fc>;
		pin-pdrv;
	};
	/omit-if-no-ref/ iomuxc_gpio_emc_b1_41_qtimer4_timer1: IOMUXC_GPIO_EMC_B1_41_QTIMER4_TIMER1 {
		pinmux = <0x42a100b4 6 0x42a10880 0 0x42a102fc>;
		pin-pdrv;
	};
	/omit-if-no-ref/ iomuxc_gpio_emc_b1_41_sramc_cs3: IOMUXC_GPIO_EMC_B1_41_SRAMC_CS3 {
		pinmux = <0x42a100b4 12 0x0 0 0x42a102fc>;
		pin-pdrv;
	};
	/omit-if-no-ref/ iomuxc_gpio_sd_b2_00_flexspi1_b_data4: IOMUXC_GPIO_SD_B2_00_FLEXSPI1_B_DATA4 {
		pinmux = <0x42a101b4 1 0x42a1055c 0 0x42a103fc>;
		pin-pdrv;
	};
	/omit-if-no-ref/ iomuxc_gpio_sd_b2_00_gpio5_io10: IOMUXC_GPIO_SD_B2_00_GPIO5_IO10 {
		pinmux = <0x42a101b4 5 0x0 0 0x42a103fc>;
		pin-pdrv;
	};
	/omit-if-no-ref/ iomuxc_gpio_sd_b2_00_kpp_row1: IOMUXC_GPIO_SD_B2_00_KPP_ROW1 {
		pinmux = <0x42a101b4 4 0x42a105cc 2 0x42a103fc>;
		pin-pdrv;
	};
	/omit-if-no-ref/ iomuxc_gpio_sd_b2_00_lpspi3_pcs3: IOMUXC_GPIO_SD_B2_00_LPSPI3_PCS3 {
		pinmux = <0x42a101b4 6 0x42a10614 1 0x42a103fc>;
		pin-pdrv;
	};
	/omit-if-no-ref/ iomuxc_gpio_sd_b2_00_lpuart8_txd: IOMUXC_GPIO_SD_B2_00_LPUART8_TXD {
		pinmux = <0x42a101b4 9 0x42a106c4 1 0x42a103fc>;
		pin-pdrv;
	};
	/omit-if-no-ref/ iomuxc_gpio_sd_b2_00_mic_bitstream0: IOMUXC_GPIO_SD_B2_00_MIC_BITSTREAM0 {
		pinmux = <0x42a101b4 12 0x42a106d0 2 0x42a103fc>;
		pin-pdrv;
	};
	/omit-if-no-ref/ iomuxc_gpio_sd_b2_00_netc_1588_clk: IOMUXC_GPIO_SD_B2_00_NETC_1588_CLK {
		pinmux = <0x42a101b4 8 0x42a107d4 1 0x42a103fc>;
		pin-pdrv;
	};
	/omit-if-no-ref/ iomuxc_gpio_sd_b2_00_usdhc2_data3: IOMUXC_GPIO_SD_B2_00_USDHC2_DATA3 {
		pinmux = <0x42a101b4 0 0x0 0 0x42a103fc>;
		pin-pdrv;
	};
	/omit-if-no-ref/ iomuxc_gpio_sd_b2_00_xbar_inout17: IOMUXC_GPIO_SD_B2_00_XBAR_INOUT17 {
		pinmux = <0x42a101b4 3 0x42a1093c 1 0x42a103fc>;
		pin-pdrv;
	};
	/omit-if-no-ref/ iomuxc_gpio_sd_b2_00_xspi_slv_data4: IOMUXC_GPIO_SD_B2_00_XSPI_SLV_DATA4 {
		pinmux = <0x42a101b4 2 0x42a10a18 1 0x42a103fc>;
		pin-pdrv;
	};
	/omit-if-no-ref/ iomuxc_gpio_sd_b2_01_flexspi1_b_data5: IOMUXC_GPIO_SD_B2_01_FLEXSPI1_B_DATA5 {
		pinmux = <0x42a101b8 1 0x42a10560 0 0x42a10400>;
		pin-pdrv;
	};
	/omit-if-no-ref/ iomuxc_gpio_sd_b2_01_gpio5_io11: IOMUXC_GPIO_SD_B2_01_GPIO5_IO11 {
		pinmux = <0x42a101b8 5 0x0 0 0x42a10400>;
		pin-pdrv;
	};
	/omit-if-no-ref/ iomuxc_gpio_sd_b2_01_kpp_col1: IOMUXC_GPIO_SD_B2_01_KPP_COL1 {
		pinmux = <0x42a101b8 4 0x42a105ac 2 0x42a10400>;
		pin-pdrv;
	};
	/omit-if-no-ref/ iomuxc_gpio_sd_b2_01_lpuart8_rxd: IOMUXC_GPIO_SD_B2_01_LPUART8_RXD {
		pinmux = <0x42a101b8 9 0x42a106c0 1 0x42a10400>;
		pin-pdrv;
	};
	/omit-if-no-ref/ iomuxc_gpio_sd_b2_01_mic_bitstream1: IOMUXC_GPIO_SD_B2_01_MIC_BITSTREAM1 {
		pinmux = <0x42a101b8 12 0x42a106d4 2 0x42a10400>;
		pin-pdrv;
	};
	/omit-if-no-ref/ iomuxc_gpio_sd_b2_01_netc_tmr_gclk: IOMUXC_GPIO_SD_B2_01_NETC_TMR_GCLK {
		pinmux = <0x42a101b8 8 0x0 0 0x42a10400>;
		pin-pdrv;
	};
	/omit-if-no-ref/ iomuxc_gpio_sd_b2_01_usdhc2_data2: IOMUXC_GPIO_SD_B2_01_USDHC2_DATA2 {
		pinmux = <0x42a101b8 0 0x0 0 0x42a10400>;
		pin-pdrv;
	};
	/omit-if-no-ref/ iomuxc_gpio_sd_b2_01_xspi_slv_data5: IOMUXC_GPIO_SD_B2_01_XSPI_SLV_DATA5 {
		pinmux = <0x42a101b8 2 0x42a10a1c 1 0x42a10400>;
		pin-pdrv;
	};
	/omit-if-no-ref/ iomuxc_gpio_sd_b2_02_flexspi1_b_data6: IOMUXC_GPIO_SD_B2_02_FLEXSPI1_B_DATA6 {
		pinmux = <0x42a101bc 1 0x42a10564 0 0x42a10404>;
		pin-pdrv;
	};
	/omit-if-no-ref/ iomuxc_gpio_sd_b2_02_gpio5_io12: IOMUXC_GPIO_SD_B2_02_GPIO5_IO12 {
		pinmux = <0x42a101bc 5 0x0 0 0x42a10404>;
		pin-pdrv;
	};
	/omit-if-no-ref/ iomuxc_gpio_sd_b2_02_kpp_row0: IOMUXC_GPIO_SD_B2_02_KPP_ROW0 {
		pinmux = <0x42a101bc 4 0x42a105c8 2 0x42a10404>;
		pin-pdrv;
	};
	/omit-if-no-ref/ iomuxc_gpio_sd_b2_02_lpuart8_cts_b: IOMUXC_GPIO_SD_B2_02_LPUART8_CTS_B {
		pinmux = <0x42a101bc 9 0x42a106bc 0 0x42a10404>;
		pin-pdrv;
	};
	/omit-if-no-ref/ iomuxc_gpio_sd_b2_02_mic_bitstream2: IOMUXC_GPIO_SD_B2_02_MIC_BITSTREAM2 {
		pinmux = <0x42a101bc 12 0x42a106d8 2 0x42a10404>;
		pin-pdrv;
	};
	/omit-if-no-ref/ iomuxc_gpio_sd_b2_02_netc_tmr_alarm1: IOMUXC_GPIO_SD_B2_02_NETC_TMR_ALARM1 {
		pinmux = <0x42a101bc 8 0x0 0 0x42a10404>;
		pin-pdrv;
	};
	/omit-if-no-ref/ iomuxc_gpio_sd_b2_02_usdhc2_data1: IOMUXC_GPIO_SD_B2_02_USDHC2_DATA1 {
		pinmux = <0x42a101bc 0 0x0 0 0x42a10404>;
		pin-pdrv;
	};
	/omit-if-no-ref/ iomuxc_gpio_sd_b2_02_xspi_slv_data6: IOMUXC_GPIO_SD_B2_02_XSPI_SLV_DATA6 {
		pinmux = <0x42a101bc 2 0x42a10a20 1 0x42a10404>;
		pin-pdrv;
	};
	/omit-if-no-ref/ iomuxc_gpio_sd_b2_03_flexspi1_b_data7: IOMUXC_GPIO_SD_B2_03_FLEXSPI1_B_DATA7 {
		pinmux = <0x42a101c0 1 0x42a10568 0 0x42a10408>;
		pin-pdrv;
	};
	/omit-if-no-ref/ iomuxc_gpio_sd_b2_03_gpio5_io13: IOMUXC_GPIO_SD_B2_03_GPIO5_IO13 {
		pinmux = <0x42a101c0 5 0x0 0 0x42a10408>;
		pin-pdrv;
	};
	/omit-if-no-ref/ iomuxc_gpio_sd_b2_03_kpp_col0: IOMUXC_GPIO_SD_B2_03_KPP_COL0 {
		pinmux = <0x42a101c0 4 0x42a105a8 2 0x42a10408>;
		pin-pdrv;
	};
	/omit-if-no-ref/ iomuxc_gpio_sd_b2_03_lpuart8_rts_b: IOMUXC_GPIO_SD_B2_03_LPUART8_RTS_B {
		pinmux = <0x42a101c0 9 0x0 0 0x42a10408>;
		pin-pdrv;
	};
	/omit-if-no-ref/ iomuxc_gpio_sd_b2_03_mic_bitstream3: IOMUXC_GPIO_SD_B2_03_MIC_BITSTREAM3 {
		pinmux = <0x42a101c0 12 0x42a106dc 2 0x42a10408>;
		pin-pdrv;
	};
	/omit-if-no-ref/ iomuxc_gpio_sd_b2_03_netc_tmr_alarm2: IOMUXC_GPIO_SD_B2_03_NETC_TMR_ALARM2 {
		pinmux = <0x42a101c0 8 0x0 0 0x42a10408>;
		pin-pdrv;
	};
	/omit-if-no-ref/ iomuxc_gpio_sd_b2_03_usdhc2_data0: IOMUXC_GPIO_SD_B2_03_USDHC2_DATA0 {
		pinmux = <0x42a101c0 0 0x0 0 0x42a10408>;
		pin-pdrv;
	};
	/omit-if-no-ref/ iomuxc_gpio_sd_b2_03_xspi_slv_data7: IOMUXC_GPIO_SD_B2_03_XSPI_SLV_DATA7 {
		pinmux = <0x42a101c0 2 0x42a10a24 1 0x42a10408>;
		pin-pdrv;
	};
	/omit-if-no-ref/ iomuxc_gpio_sd_b2_04_flexspi1_b_ss1_b: IOMUXC_GPIO_SD_B2_04_FLEXSPI1_B_SS1_B {
		pinmux = <0x42a101c4 1 0x0 0 0x42a1040c>;
		pin-pdrv;
	};
	/omit-if-no-ref/ iomuxc_gpio_sd_b2_04_gpio5_io14: IOMUXC_GPIO_SD_B2_04_GPIO5_IO14 {
		pinmux = <0x42a101c4 5 0x0 0 0x42a1040c>;
		pin-pdrv;
	};
	/omit-if-no-ref/ iomuxc_gpio_sd_b2_04_kpp_row3: IOMUXC_GPIO_SD_B2_04_KPP_ROW3 {
		pinmux = <0x42a101c4 4 0x42a105d4 2 0x42a1040c>;
		pin-pdrv;
	};
	/omit-if-no-ref/ iomuxc_gpio_sd_b2_04_lpuart5_ri_b: IOMUXC_GPIO_SD_B2_04_LPUART5_RI_B {
		pinmux = <0x42a101c4 6 0x42a10698 1 0x42a1040c>;
		pin-pdrv;
	};
	/omit-if-no-ref/ iomuxc_gpio_sd_b2_04_mic_clk: IOMUXC_GPIO_SD_B2_04_MIC_CLK {
		pinmux = <0x42a101c4 12 0x0 0 0x42a1040c>;
		pin-pdrv;
	};
	/omit-if-no-ref/ iomuxc_gpio_sd_b2_04_netc_tmr_pp1: IOMUXC_GPIO_SD_B2_04_NETC_TMR_PP1 {
		pinmux = <0x42a101c4 8 0x0 0 0x42a1040c>;
		pin-pdrv;
	};
	/omit-if-no-ref/ iomuxc_gpio_sd_b2_04_usdhc2_clk: IOMUXC_GPIO_SD_B2_04_USDHC2_CLK {
		pinmux = <0x42a101c4 0 0x0 0 0x42a1040c>;
		pin-pdrv;
	};
	/omit-if-no-ref/ iomuxc_gpio_sd_b2_05_flexspi1_b_dqs: IOMUXC_GPIO_SD_B2_05_FLEXSPI1_B_DQS {
		pinmux = <0x42a101c8 1 0x42a10548 0 0x42a10410>;
		pin-pdrv;
	};
	/omit-if-no-ref/ iomuxc_gpio_sd_b2_05_gpio5_io15: IOMUXC_GPIO_SD_B2_05_GPIO5_IO15 {
		pinmux = <0x42a101c8 5 0x0 0 0x42a10410>;
		pin-pdrv;
	};
	/omit-if-no-ref/ iomuxc_gpio_sd_b2_05_lpspi4_pcs3: IOMUXC_GPIO_SD_B2_05_LPSPI4_PCS3 {
		pinmux = <0x42a101c8 4 0x0 0 0x42a10410>;
		pin-pdrv;
	};
	/omit-if-no-ref/ iomuxc_gpio_sd_b2_05_lpuart5_dtr_b: IOMUXC_GPIO_SD_B2_05_LPUART5_DTR_B {
		pinmux = <0x42a101c8 6 0x0 0 0x42a10410>;
		pin-pdrv;
	};
	/omit-if-no-ref/ iomuxc_gpio_sd_b2_05_netc_tmr_pp2: IOMUXC_GPIO_SD_B2_05_NETC_TMR_PP2 {
		pinmux = <0x42a101c8 8 0x0 0 0x42a10410>;
		pin-pdrv;
	};
	/omit-if-no-ref/ iomuxc_gpio_sd_b2_05_usdhc2_cmd: IOMUXC_GPIO_SD_B2_05_USDHC2_CMD {
		pinmux = <0x42a101c8 0 0x0 0 0x42a10410>;
		pin-pdrv;
	};
	/omit-if-no-ref/ iomuxc_gpio_sd_b2_05_xspi_slv_dqs: IOMUXC_GPIO_SD_B2_05_XSPI_SLV_DQS {
		pinmux = <0x42a101c8 2 0x42a10a04 0 0x42a10410>;
		pin-pdrv;
	};
	/omit-if-no-ref/ iomuxc_gpio_sd_b2_06_flexspi1_b_ss0_b: IOMUXC_GPIO_SD_B2_06_FLEXSPI1_B_SS0_B {
		pinmux = <0x42a101cc 1 0x0 0 0x42a10414>;
		pin-pdrv;
	};
	/omit-if-no-ref/ iomuxc_gpio_sd_b2_06_gpio5_io16: IOMUXC_GPIO_SD_B2_06_GPIO5_IO16 {
		pinmux = <0x42a101cc 5 0x0 0 0x42a10414>;
		pin-pdrv;
	};
	/omit-if-no-ref/ iomuxc_gpio_sd_b2_06_lpspi4_pcs2: IOMUXC_GPIO_SD_B2_06_LPSPI4_PCS2 {
		pinmux = <0x42a101cc 4 0x0 0 0x42a10414>;
		pin-pdrv;
	};
	/omit-if-no-ref/ iomuxc_gpio_sd_b2_06_lpuart5_cts_b: IOMUXC_GPIO_SD_B2_06_LPUART5_CTS_B {
		pinmux = <0x42a101cc 6 0x42a1068c 2 0x42a10414>;
		pin-pdrv;
	};
	/omit-if-no-ref/ iomuxc_gpio_sd_b2_06_netc_tmr_pp3: IOMUXC_GPIO_SD_B2_06_NETC_TMR_PP3 {
		pinmux = <0x42a101cc 8 0x0 0 0x42a10414>;
		pin-pdrv;
	};
	/omit-if-no-ref/ iomuxc_gpio_sd_b2_06_usdhc2_reset_b: IOMUXC_GPIO_SD_B2_06_USDHC2_RESET_B {
		pinmux = <0x42a101cc 0 0x0 0 0x42a10414>;
		pin-pdrv;
	};
	/omit-if-no-ref/ iomuxc_gpio_sd_b2_06_xspi_slv_cs: IOMUXC_GPIO_SD_B2_06_XSPI_SLV_CS {
		pinmux = <0x42a101cc 2 0x42a10a00 1 0x42a10414>;
		pin-pdrv;
	};
	/omit-if-no-ref/ iomuxc_gpio_sd_b2_07_flexspi1_b_sclk: IOMUXC_GPIO_SD_B2_07_FLEXSPI1_B_SCLK {
		pinmux = <0x42a101d0 1 0x42a1056c 0 0x42a10418>;
		pin-pdrv;
	};
	/omit-if-no-ref/ iomuxc_gpio_sd_b2_07_gpio5_io17: IOMUXC_GPIO_SD_B2_07_GPIO5_IO17 {
		pinmux = <0x42a101d0 5 0x0 0 0x42a10418>;
		pin-pdrv;
	};
	/omit-if-no-ref/ iomuxc_gpio_sd_b2_07_lpspi4_pcs1: IOMUXC_GPIO_SD_B2_07_LPSPI4_PCS1 {
		pinmux = <0x42a101d0 4 0x0 0 0x42a10418>;
		pin-pdrv;
	};
	/omit-if-no-ref/ iomuxc_gpio_sd_b2_07_lpuart5_rts_b: IOMUXC_GPIO_SD_B2_07_LPUART5_RTS_B {
		pinmux = <0x42a101d0 6 0x0 0 0x42a10418>;
		pin-pdrv;
	};
	/omit-if-no-ref/ iomuxc_gpio_sd_b2_07_netc_tmr_alarm1: IOMUXC_GPIO_SD_B2_07_NETC_TMR_ALARM1 {
		pinmux = <0x42a101d0 8 0x0 0 0x42a10418>;
		pin-pdrv;
	};
	/omit-if-no-ref/ iomuxc_gpio_sd_b2_07_usdhc2_strobe: IOMUXC_GPIO_SD_B2_07_USDHC2_STROBE {
		pinmux = <0x42a101d0 0 0x0 0 0x42a10418>;
		pin-pdrv;
	};
	/omit-if-no-ref/ iomuxc_gpio_sd_b2_07_xspi_slv_clk: IOMUXC_GPIO_SD_B2_07_XSPI_SLV_CLK {
		pinmux = <0x42a101d0 2 0x42a10a28 1 0x42a10418>;
		pin-pdrv;
	};
	/omit-if-no-ref/ iomuxc_gpio_sd_b2_08_flexspi1_b_data0: IOMUXC_GPIO_SD_B2_08_FLEXSPI1_B_DATA0 {
		pinmux = <0x42a101d4 1 0x42a1054c 0 0x42a1041c>;
		pin-pdrv;
	};
	/omit-if-no-ref/ iomuxc_gpio_sd_b2_08_gpio5_io18: IOMUXC_GPIO_SD_B2_08_GPIO5_IO18 {
		pinmux = <0x42a101d4 5 0x0 0 0x42a1041c>;
		pin-pdrv;
	};
	/omit-if-no-ref/ iomuxc_gpio_sd_b2_08_lpspi4_sck: IOMUXC_GPIO_SD_B2_08_LPSPI4_SCK {
		pinmux = <0x42a101d4 4 0x42a10628 1 0x42a1041c>;
		pin-pdrv;
	};
	/omit-if-no-ref/ iomuxc_gpio_sd_b2_08_lpuart5_txd: IOMUXC_GPIO_SD_B2_08_LPUART5_TXD {
		pinmux = <0x42a101d4 6 0x42a106a0 4 0x42a1041c>;
		pin-pdrv;
	};
	/omit-if-no-ref/ iomuxc_gpio_sd_b2_08_netc_tmr_alarm2: IOMUXC_GPIO_SD_B2_08_NETC_TMR_ALARM2 {
		pinmux = <0x42a101d4 8 0x0 0 0x42a1041c>;
		pin-pdrv;
	};
	/omit-if-no-ref/ iomuxc_gpio_sd_b2_08_netc_tmr_pp2: IOMUXC_GPIO_SD_B2_08_NETC_TMR_PP2 {
		pinmux = <0x42a101d4 9 0x0 0 0x42a1041c>;
		pin-pdrv;
	};
	/omit-if-no-ref/ iomuxc_gpio_sd_b2_08_usdhc2_data4: IOMUXC_GPIO_SD_B2_08_USDHC2_DATA4 {
		pinmux = <0x42a101d4 0 0x0 0 0x42a1041c>;
		pin-pdrv;
	};
	/omit-if-no-ref/ iomuxc_gpio_sd_b2_08_xspi_slv_data0: IOMUXC_GPIO_SD_B2_08_XSPI_SLV_DATA0 {
		pinmux = <0x42a101d4 2 0x42a10a08 0 0x42a1041c>;
		pin-pdrv;
	};
	/omit-if-no-ref/ iomuxc_gpio_sd_b2_09_flexspi1_b_data1: IOMUXC_GPIO_SD_B2_09_FLEXSPI1_B_DATA1 {
		pinmux = <0x42a101d8 1 0x42a10550 0 0x42a10420>;
		pin-pdrv;
	};
	/omit-if-no-ref/ iomuxc_gpio_sd_b2_09_gpio5_io19: IOMUXC_GPIO_SD_B2_09_GPIO5_IO19 {
		pinmux = <0x42a101d8 5 0x0 0 0x42a10420>;
		pin-pdrv;
	};
	/omit-if-no-ref/ iomuxc_gpio_sd_b2_09_lpspi4_pcs0: IOMUXC_GPIO_SD_B2_09_LPSPI4_PCS0 {
		pinmux = <0x42a101d8 4 0x42a10624 1 0x42a10420>;
		pin-pdrv;
	};
	/omit-if-no-ref/ iomuxc_gpio_sd_b2_09_lpuart5_rxd: IOMUXC_GPIO_SD_B2_09_LPUART5_RXD {
		pinmux = <0x42a101d8 6 0x42a1069c 4 0x42a10420>;
		pin-pdrv;
	};
	/omit-if-no-ref/ iomuxc_gpio_sd_b2_09_netc_tmr_pp1: IOMUXC_GPIO_SD_B2_09_NETC_TMR_PP1 {
		pinmux = <0x42a101d8 9 0x0 0 0x42a10420>;
		pin-pdrv;
	};
	/omit-if-no-ref/ iomuxc_gpio_sd_b2_09_usdhc2_data5: IOMUXC_GPIO_SD_B2_09_USDHC2_DATA5 {
		pinmux = <0x42a101d8 0 0x0 0 0x42a10420>;
		pin-pdrv;
	};
	/omit-if-no-ref/ iomuxc_gpio_sd_b2_09_xspi_slv_data1: IOMUXC_GPIO_SD_B2_09_XSPI_SLV_DATA1 {
		pinmux = <0x42a101d8 2 0x42a10a0c 0 0x42a10420>;
		pin-pdrv;
	};
	/omit-if-no-ref/ iomuxc_gpio_sd_b2_10_ecat_mdio: IOMUXC_GPIO_SD_B2_10_ECAT_MDIO {
		pinmux = <0x42a101dc 12 0x42a104ec 1 0x42a10424>;
		pin-pdrv;
	};
	/omit-if-no-ref/ iomuxc_gpio_sd_b2_10_flexspi1_b_data2: IOMUXC_GPIO_SD_B2_10_FLEXSPI1_B_DATA2 {
		pinmux = <0x42a101dc 1 0x42a10554 0 0x42a10424>;
		pin-pdrv;
	};
	/omit-if-no-ref/ iomuxc_gpio_sd_b2_10_gpio5_io20: IOMUXC_GPIO_SD_B2_10_GPIO5_IO20 {
		pinmux = <0x42a101dc 5 0x0 0 0x42a10424>;
		pin-pdrv;
	};
	/omit-if-no-ref/ iomuxc_gpio_sd_b2_10_lpspi4_sout: IOMUXC_GPIO_SD_B2_10_LPSPI4_SOUT {
		pinmux = <0x42a101dc 4 0x42a10630 1 0x42a10424>;
		pin-pdrv;
	};
	/omit-if-no-ref/ iomuxc_gpio_sd_b2_10_lpuart5_dcd_b: IOMUXC_GPIO_SD_B2_10_LPUART5_DCD_B {
		pinmux = <0x42a101dc 6 0x42a10690 1 0x42a10424>;
		pin-pdrv;
	};
	/omit-if-no-ref/ iomuxc_gpio_sd_b2_10_netc_emdio: IOMUXC_GPIO_SD_B2_10_NETC_EMDIO {
		pinmux = <0x42a101dc 10 0x42a10798 5 0x42a10424>;
		pin-pdrv;
	};
	/omit-if-no-ref/ iomuxc_gpio_sd_b2_10_netc_tmr_pp3: IOMUXC_GPIO_SD_B2_10_NETC_TMR_PP3 {
		pinmux = <0x42a101dc 9 0x0 0 0x42a10424>;
		pin-pdrv;
	};
	/omit-if-no-ref/ iomuxc_gpio_sd_b2_10_netc_tmr_trig2: IOMUXC_GPIO_SD_B2_10_NETC_TMR_TRIG2 {
		pinmux = <0x42a101dc 8 0x42a107d0 3 0x42a10424>;
		pin-pdrv;
	};
	/omit-if-no-ref/ iomuxc_gpio_sd_b2_10_usdhc2_data6: IOMUXC_GPIO_SD_B2_10_USDHC2_DATA6 {
		pinmux = <0x42a101dc 0 0x0 0 0x42a10424>;
		pin-pdrv;
	};
	/omit-if-no-ref/ iomuxc_gpio_sd_b2_10_xspi_slv_data2: IOMUXC_GPIO_SD_B2_10_XSPI_SLV_DATA2 {
		pinmux = <0x42a101dc 2 0x42a10a10 0 0x42a10424>;
		pin-pdrv;
	};
	/omit-if-no-ref/ iomuxc_gpio_sd_b2_11_ecat_mdc: IOMUXC_GPIO_SD_B2_11_ECAT_MDC {
		pinmux = <0x42a101e0 12 0x0 0 0x42a10428>;
		pin-pdrv;
	};
	/omit-if-no-ref/ iomuxc_gpio_sd_b2_11_flexspi1_b_data3: IOMUXC_GPIO_SD_B2_11_FLEXSPI1_B_DATA3 {
		pinmux = <0x42a101e0 1 0x42a10558 0 0x42a10428>;
		pin-pdrv;
	};
	/omit-if-no-ref/ iomuxc_gpio_sd_b2_11_gpio5_io21: IOMUXC_GPIO_SD_B2_11_GPIO5_IO21 {
		pinmux = <0x42a101e0 5 0x0 0 0x42a10428>;
		pin-pdrv;
	};
	/omit-if-no-ref/ iomuxc_gpio_sd_b2_11_lpspi4_sin: IOMUXC_GPIO_SD_B2_11_LPSPI4_SIN {
		pinmux = <0x42a101e0 4 0x42a1062c 1 0x42a10428>;
		pin-pdrv;
	};
	/omit-if-no-ref/ iomuxc_gpio_sd_b2_11_lpuart5_dsr_b: IOMUXC_GPIO_SD_B2_11_LPUART5_DSR_B {
		pinmux = <0x42a101e0 6 0x42a10694 1 0x42a10428>;
		pin-pdrv;
	};
	/omit-if-no-ref/ iomuxc_gpio_sd_b2_11_netc_emdc: IOMUXC_GPIO_SD_B2_11_NETC_EMDC {
		pinmux = <0x42a101e0 10 0x0 0 0x42a10428>;
		pin-pdrv;
	};
	/omit-if-no-ref/ iomuxc_gpio_sd_b2_11_netc_tmr_trig1: IOMUXC_GPIO_SD_B2_11_NETC_TMR_TRIG1 {
		pinmux = <0x42a101e0 8 0x42a107cc 3 0x42a10428>;
		pin-pdrv;
	};
	/omit-if-no-ref/ iomuxc_gpio_sd_b2_11_usdhc2_data7: IOMUXC_GPIO_SD_B2_11_USDHC2_DATA7 {
		pinmux = <0x42a101e0 0 0x0 0 0x42a10428>;
		pin-pdrv;
	};
	/omit-if-no-ref/ iomuxc_gpio_sd_b2_11_xspi_slv_data3: IOMUXC_GPIO_SD_B2_11_XSPI_SLV_DATA3 {
		pinmux = <0x42a101e0 2 0x42a10a14 0 0x42a10428>;
		pin-pdrv;
	};
};


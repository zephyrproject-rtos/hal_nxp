## mcux/mcux-sdk-ng/drivers/mcx_vbat/Kconfig
```kconfig
# Copyright 2024 NXP
#
# SPDX-License-Identifier: BSD-3-Clause

config MCUX_HAS_COMPONENT_driver.mcx_vbat
    bool
    default y if MCUX_HW_IP_DriverType_MCX_VBAT

config MCUX_COMPONENT_driver.mcx_vbat
    bool "mcx_vbat"
    select MCUX_COMPONENT_driver.common
    depends on MCUX_HAS_COMPONENT_driver.mcx_vbat
```

## mcux/mcux-sdk-ng/drivers/mecc/Kconfig
```kconfig
# Copyright 2024 NXP
#
# SPDX-License-Identifier: BSD-3-Clause

config MCUX_HAS_COMPONENT_driver.mecc
    bool
    default y if MCUX_HW_IP_DriverType_MECC64

config MCUX_COMPONENT_driver.mecc
    bool "mecc"
    select MCUX_COMPONENT_driver.common
    depends on MCUX_HAS_COMPONENT_driver.mecc
```

## mcux/mcux-sdk-ng/drivers/mipi_csi2rx/Kconfig
```kconfig
# Copyright 2024 NXP
#
# SPDX-License-Identifier: BSD-3-Clause

config MCUX_HAS_COMPONENT_driver.mipi_csi2rx
    bool
    default y if MCUX_HW_IP_DriverType_MIPI_CSI2RX

config MCUX_COMPONENT_driver.mipi_csi2rx
    bool "mipi_csi2rx"
    select MCUX_COMPONENT_driver.common
    select MCUX_COMPONENT_driver.mipi_csi2rx_soc
    depends on MCUX_HAS_COMPONENT_driver.mipi_csi2rx
```

## mcux/mcux-sdk-ng/drivers/mipi_csi2rx_dwc/Kconfig
```kconfig
# Copyright 2024 NXP
#
# SPDX-License-Identifier: BSD-3-Clause

config MCUX_HAS_COMPONENT_driver.mipi_csi2rx_dwc
    bool
    default y if MCUX_HW_IP_DriverType_MIPI_CSI2

config MCUX_COMPONENT_driver.mipi_csi2rx_dwc
    bool "mipi_csi2rx_dwc"
    select MCUX_COMPONENT_driver.common
    depends on MCUX_HAS_COMPONENT_driver.mipi_csi2rx_dwc
```

## mcux/mcux-sdk-ng/drivers/mipi_dsi/Kconfig
```kconfig
# Copyright 2024 NXP
#
# SPDX-License-Identifier: BSD-3-Clause

config MCUX_HAS_COMPONENT_driver.mipi_dsi_smartdma
    bool
    default y if MCUX_HAS_COMPONENT_driver.mipi_dsi && MCUX_HAS_COMPONENT_driver.smartdma

config MCUX_HAS_COMPONENT_driver.mipi_dsi
    bool
    default y if MCUX_HW_IP_DriverType_MIPI_DSI

config MCUX_COMPONENT_driver.mipi_dsi_smartdma
    bool "mipi_dsi_smartdma"
    select MCUX_COMPONENT_driver.mipi_dsi
    select MCUX_COMPONENT_driver.smartdma
    depends on MCUX_HAS_COMPONENT_driver.mipi_dsi_smartdma

config MCUX_COMPONENT_driver.mipi_dsi
    bool "mipi_dsi"
    select MCUX_COMPONENT_driver.common
    select MCUX_COMPONENT_driver.mipi_dsi_soc
    depends on MCUX_HAS_COMPONENT_driver.mipi_dsi
```

## mcux/mcux-sdk-ng/drivers/mipi_dsi_imx/Kconfig
```kconfig
# Copyright 2024 NXP
#
# SPDX-License-Identifier: BSD-3-Clause

config MCUX_HAS_COMPONENT_driver.mipi_dsi_imx
    bool
    default y if MCUX_HW_IP_DriverType_MIPI_DSI_4L

config MCUX_COMPONENT_driver.mipi_dsi_imx
    bool "mipi_dsi_imx"
    select MCUX_COMPONENT_driver.common
    depends on MCUX_HAS_COMPONENT_driver.mipi_dsi_imx
```

## mcux/mcux-sdk-ng/drivers/mipi_dsi_split/Kconfig
```kconfig
# Copyright 2024 NXP
#
# SPDX-License-Identifier: BSD-3-Clause

config MCUX_HAS_COMPONENT_driver.mipi_dsi_split
    bool
    default y if MCUX_HW_IP_DriverType_MIPI_DSI_SPLIT

config MCUX_COMPONENT_driver.mipi_dsi_split
    bool "mipi_dsi_split"
    select MCUX_COMPONENT_driver.common
    select MCUX_COMPONENT_driver.mipi_dsi_soc
    select MCUX_COMPONENT_driver.mipi_csi2rx_soc
    depends on MCUX_HAS_COMPONENT_driver.mipi_dsi_split
```

## mcux/mcux-sdk-ng/drivers/mmau/Kconfig
```kconfig
# Copyright 2024 NXP
#
# SPDX-License-Identifier: BSD-3-Clause

config MCUX_HAS_COMPONENT_driver.mmau
    bool
    default y if MCUX_HW_IP_DriverType_MMAU

config MCUX_COMPONENT_driver.mmau
    bool "mmau"
    select MCUX_COMPONENT_driver.common
    depends on MCUX_HAS_COMPONENT_driver.mmau
```

## mcux/mcux-sdk-ng/drivers/mmdc/Kconfig
```kconfig
# Copyright 2024 NXP
#
# SPDX-License-Identifier: BSD-3-Clause

config MCUX_HAS_COMPONENT_driver.mmdc
    bool
    default y if MCUX_HW_IP_DriverType_MMDC

config MCUX_COMPONENT_driver.mmdc
    bool "mmdc"
    select MCUX_COMPONENT_driver.common
    depends on MCUX_HAS_COMPONENT_driver.mmdc
```

## mcux/mcux-sdk-ng/drivers/mmdvsq/Kconfig
```kconfig
# Copyright 2024 NXP
#
# SPDX-License-Identifier: BSD-3-Clause

config MCUX_HAS_COMPONENT_driver.mmdvsq
    bool
    default y if MCUX_HW_IP_DriverType_MMDVSQ

config MCUX_COMPONENT_driver.mmdvsq
    bool "mmdvsq"
    select MCUX_COMPONENT_driver.common
    depends on MCUX_HAS_COMPONENT_driver.mmdvsq
```

## mcux/mcux-sdk-ng/drivers/msgintr/Kconfig
```kconfig
# Copyright 2024 NXP
#
# SPDX-License-Identifier: BSD-3-Clause

config MCUX_HAS_COMPONENT_driver.msgintr
    bool
    default y if MCUX_HW_IP_DriverType_MSGINTR

config MCUX_COMPONENT_driver.msgintr
    bool "msgintr"
    select MCUX_COMPONENT_driver.common
    depends on MCUX_HAS_COMPONENT_driver.msgintr
```

## mcux/mcux-sdk-ng/drivers/msmc/Kconfig
```kconfig
# Copyright 2024 NXP
#
# SPDX-License-Identifier: BSD-3-Clause

config MCUX_HAS_COMPONENT_driver.msmc
    bool
    default y if MCUX_HW_IP_DriverType_MSMC

config MCUX_COMPONENT_driver.msmc
    bool "msmc"
    select MCUX_COMPONENT_driver.common
    depends on MCUX_HAS_COMPONENT_driver.msmc
```

## mcux/mcux-sdk-ng/drivers/mu/Kconfig
```kconfig
# Copyright 2024 NXP
#
# SPDX-License-Identifier: BSD-3-Clause

config MCUX_HAS_COMPONENT_driver.mu
    bool
    default y if MCUX_HW_IP_DriverType_MU

config MCUX_COMPONENT_driver.mu
    bool "mu"
    select MCUX_COMPONENT_driver.common
    depends on MCUX_HAS_COMPONENT_driver.mu
```

## mcux/mcux-sdk-ng/drivers/mx25/Kconfig
```kconfig
# Copyright 2024 NXP
#
# SPDX-License-Identifier: BSD-3-Clause

config MCUX_COMPONENT_driver.mx25
    bool "mx25"
    select MCUX_COMPONENT_driver.spifi_dma
    depends on MCUX_HAS_COMPONENT_driver.spifi_dma
```

## mcux/mcux-sdk-ng/drivers/netc/Kconfig
```kconfig
# Copyright 2024 NXP
#
# SPDX-License-Identifier: BSD-3-Clause

config MCUX_HAS_COMPONENT_driver.netc_rt1180
    bool
    default y if MCUX_HW_DEVICE_ID_MIMXRT1189xxxxx || MCUX_HW_DEVICE_ID_MIMXRT1187xxxxx ||\
                 MCUX_HW_DEVICE_ID_MIMXRT1182xxxxx || MCUX_HW_DEVICE_ID_MIMXRT1181xxxxx

config MCUX_HAS_COMPONENT_driver.netc_imx95
    bool
    default y if MCUX_HW_DEVICE_ID_MIMX9596xxxxQ || MCUX_HW_DEVICE_ID_MIMX9596xxxxN || MCUX_HW_DEVICE_ID_MIMX9596xxxxL

config MCUX_HAS_COMPONENT_driver.netc
    bool
    default y if MCUX_HW_IP_DriverType_NETC

config MCUX_COMPONENT_driver.netc_rt1180
    bool
    depends on MCUX_HW_DEVICE_ID_MIMXRT1189xxxxx || MCUX_HW_DEVICE_ID_MIMXRT1187xxxxx ||\
               MCUX_HW_DEVICE_ID_MIMXRT1182xxxxx || MCUX_HW_DEVICE_ID_MIMXRT1181xxxxx

config MCUX_COMPONENT_driver.netc_imx95
    bool
    depends on MCUX_HW_DEVICE_ID_MIMX9596xxxxQ || MCUX_HW_DEVICE_ID_MIMX9596xxxxN || MCUX_HW_DEVICE_ID_MIMX9596xxxxL

config MCUX_COMPONENT_driver.netc
    bool "netc"
    select MCUX_COMPONENT_driver.common
    select MCUX_COMPONENT_driver.netc_rt1180 if MCUX_HAS_COMPONENT_driver.netc_rt1180
    select MCUX_COMPONENT_driver.netc_imx95 if MCUX_HAS_COMPONENT_driver.netc_imx95
    depends on MCUX_HAS_COMPONENT_driver.netc

config MCUX_COMPONENT_driver.netc_switch
    bool "netc switch"
    default y
    depends on MCUX_COMPONENT_driver.netc
    depends on MCUX_HAS_COMPONENT_driver.netc_rt1180

config MCUX_COMPONENT_driver.netc_phywrapper
    bool "netc phy wrapper"
    default y
    depends on MCUX_COMPONENT_driver.netc
    depends on MCUX_HAS_COMPONENT_driver.netc_imx95

config MCUX_COMPONENT_driver.netc_msg
    bool "netc VSI-PSI message"
    depends on MCUX_COMPONENT_driver.netc
```

## mcux/mcux-sdk-ng/drivers/nfc/Kconfig
```kconfig
# Copyright 2024 NXP
#
# SPDX-License-Identifier: BSD-3-Clause

config MCUX_HAS_COMPONENT_driver.nfc
    bool
    default y if MCUX_HW_IP_DriverType_RFIDNFC

config MCUX_COMPONENT_driver.nfc
    bool "nfc"
    select MCUX_COMPONENT_driver.common
    depends on MCUX_HAS_COMPONENT_driver.nfc
```

## mcux/mcux-sdk-ng/drivers/ocotp/Kconfig
```kconfig
# Copyright 2024 NXP
#
# SPDX-License-Identifier: BSD-3-Clause

config MCUX_HAS_COMPONENT_driver.ocotp
    bool
    default y if MCUX_HW_IP_DriverType_OCOTP

config MCUX_COMPONENT_driver.ocotp
    bool "ocotp"
    select MCUX_COMPONENT_driver.common
    depends on MCUX_HAS_COMPONENT_driver.ocotp
```

## mcux/mcux-sdk-ng/drivers/opamp/Kconfig
```kconfig
# Copyright 2024 NXP
#
# SPDX-License-Identifier: BSD-3-Clause

config MCUX_HAS_COMPONENT_driver.opamp
    bool
    default y if MCUX_HW_IP_DriverType_OPAMP

config MCUX_COMPONENT_driver.opamp
    bool "opamp"
    select MCUX_COMPONENT_driver.common
    depends on MCUX_HAS_COMPONENT_driver.opamp
```

## mcux/mcux-sdk-ng/drivers/opamp_fast/Kconfig
```kconfig
# Copyright 2024 NXP
#
# SPDX-License-Identifier: BSD-3-Clause

config MCUX_HAS_COMPONENT_driver.opamp_fast
    bool
    default y if MCUX_HW_IP_DriverType_OPAMP_FAST

config MCUX_COMPONENT_driver.opamp_fast
    bool "opamp"
    select MCUX_COMPONENT_driver.common
    depends on MCUX_HAS_COMPONENT_driver.opamp_fast
```

## mcux/mcux-sdk-ng/drivers/ostimer/Kconfig
```kconfig
# Copyright 2024 NXP
#
# SPDX-License-Identifier: BSD-3-Clause

config MCUX_HAS_COMPONENT_driver.ostimer
    bool
    default y if MCUX_HW_IP_DriverType_OSTIMER

config MCUX_COMPONENT_driver.ostimer
    bool "ostimer"
    select MCUX_COMPONENT_driver.common
    depends on MCUX_HAS_COMPONENT_driver.ostimer
```

## mcux/mcux-sdk-ng/drivers/pdb/Kconfig
```kconfig
# Copyright 2024 NXP
#
# SPDX-License-Identifier: BSD-3-Clause

config MCUX_HAS_COMPONENT_driver.pdb
    bool
    default y if MCUX_HW_IP_DriverType_PDB

config MCUX_COMPONENT_driver.pdb
    bool "pdb"
    select MCUX_COMPONENT_driver.common
    depends on MCUX_HAS_COMPONENT_driver.pdb
```

## mcux/mcux-sdk-ng/drivers/pdm/Kconfig
```kconfig
# Copyright 2024 NXP
#
# SPDX-License-Identifier: BSD-3-Clause

config MCUX_HAS_COMPONENT_driver.pdm_edma
    bool
    default y if MCUX_HAS_COMPONENT_driver.pdm && (MCUX_HAS_COMPONENT_driver.dma3 || MCUX_HAS_COMPONENT_driver.edma || MCUX_HAS_COMPONENT_driver.edma4)

config MCUX_HAS_COMPONENT_driver.pdm_sdma
    bool
    default y if MCUX_HAS_COMPONENT_driver.pdm && MCUX_HAS_COMPONENT_driver.sdma

config MCUX_HAS_COMPONENT_driver.pdm
    bool
    default y if MCUX_HW_IP_DriverType_PDM

config MCUX_COMPONENT_driver.pdm_edma
    bool "pdm_edma"
    select MCUX_COMPONENT_driver.pdm
    select MCUX_COMPONENT_driver.dma3 if MCUX_HAS_COMPONENT_driver.dma3
    select MCUX_COMPONENT_driver.edma if MCUX_HAS_COMPONENT_driver.edma
    select MCUX_COMPONENT_driver.edma4 if MCUX_HAS_COMPONENT_driver.edma4
    depends on MCUX_HAS_COMPONENT_driver.pdm_edma

config MCUX_COMPONENT_driver.pdm_sdma
    bool "pdm_sdma"
    select MCUX_COMPONENT_driver.pdm
    select MCUX_COMPONENT_driver.sdma
    depends on MCUX_HAS_COMPONENT_driver.pdm_sdma

config MCUX_COMPONENT_driver.pdm
    bool "pdm"
    select MCUX_COMPONENT_driver.common
    depends on MCUX_HAS_COMPONENT_driver.pdm
```

## mcux/mcux-sdk-ng/drivers/pint/Kconfig
```kconfig
# Copyright 2024 NXP
#
# SPDX-License-Identifier: BSD-3-Clause

config MCUX_HAS_COMPONENT_driver.pint
    bool
    default y if MCUX_HW_IP_DriverType_PINT

config MCUX_COMPONENT_driver.pint
    bool "pint"
    select MCUX_COMPONENT_driver.common
    depends on MCUX_HAS_COMPONENT_driver.pint
```

## mcux/mcux-sdk-ng/drivers/plu/Kconfig
```kconfig
# Copyright 2024 NXP
#
# SPDX-License-Identifier: BSD-3-Clause

config MCUX_HAS_COMPONENT_driver.plu
    bool
    default y if MCUX_HW_IP_DriverType_PLU

config MCUX_COMPONENT_driver.plu
    bool "plu"
    select MCUX_COMPONENT_driver.common
    depends on MCUX_HAS_COMPONENT_driver.plu
```

## mcux/mcux-sdk-ng/drivers/pmc/Kconfig
```kconfig
# Copyright 2024 NXP
#
# SPDX-License-Identifier: BSD-3-Clause

config MCUX_HAS_COMPONENT_driver.pmc
    bool
    default y if MCUX_HW_IP_DriverType_PMC

config MCUX_COMPONENT_driver.pmc
    bool "pmc"
    select MCUX_COMPONENT_driver.common
    depends on MCUX_HAS_COMPONENT_driver.pmc
```

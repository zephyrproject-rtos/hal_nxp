## mcux/mcux-sdk-ng/drivers/flexram/Kconfig
```kconfig
# Copyright 2024 NXP
#
# SPDX-License-Identifier: BSD-3-Clause

config MCUX_HAS_COMPONENT_driver.flexram
    bool
    default y if MCUX_HW_IP_DriverType_FLEXRAM

config MCUX_COMPONENT_driver.flexram
    bool "flexram"
    select MCUX_COMPONENT_driver.common
    select MCUX_COMPONENT_driver.flexram_allocate
    depends on MCUX_HAS_COMPONENT_driver.flexram
```

## mcux/mcux-sdk-ng/drivers/flexspi/Kconfig
```kconfig
# Copyright 2024 NXP
#
# SPDX-License-Identifier: BSD-3-Clause

config MCUX_HAS_COMPONENT_driver.flexspi_dma
    bool
    default y if MCUX_HAS_COMPONENT_driver.flexspi && MCUX_HAS_COMPONENT_driver.lpc_dma

config MCUX_HAS_COMPONENT_driver.flexspi_edma
    bool
    default y if MCUX_HAS_COMPONENT_driver.flexspi && (MCUX_HAS_COMPONENT_driver.edma || MCUX_HAS_COMPONENT_driver.edma4)

config MCUX_HAS_COMPONENT_driver.flexspi
    bool
    default y if MCUX_HW_IP_DriverType_FLEXSPI

config MCUX_COMPONENT_driver.flexspi_dma
    bool "flexspi_dma"
    select MCUX_COMPONENT_driver.flexspi
    select MCUX_COMPONENT_driver.lpc_dma
    depends on MCUX_HAS_COMPONENT_driver.flexspi_dma

config MCUX_COMPONENT_driver.flexspi_edma
    bool "flexspi_edma"
    select MCUX_COMPONENT_driver.flexspi
    select MCUX_COMPONENT_driver.edma if MCUX_HAS_COMPONENT_driver.edma
    select MCUX_COMPONENT_driver.edma4 if MCUX_HAS_COMPONENT_driver.edma4
    depends on MCUX_HAS_COMPONENT_driver.flexspi_edma

config MCUX_COMPONENT_driver.flexspi
    bool "flexspi"
    select MCUX_COMPONENT_driver.common
    depends on MCUX_HAS_COMPONENT_driver.flexspi

orsource "./*/Kconfig"
```

## mcux/mcux-sdk-ng/drivers/flexspi/flexspi_dma3/Kconfig
```kconfig
# Copyright 2024 NXP
#
# SPDX-License-Identifier: BSD-3-Clause

config MCUX_HAS_COMPONENT_driver.flexspi_dma3
    bool
    default y if MCUX_HAS_COMPONENT_driver.flexspi && (MCUX_HAS_COMPONENT_driver.dma3 || MCUX_HAS_COMPONENT_driver.edma4)

config MCUX_COMPONENT_driver.flexspi_dma3
    bool "flexspi_dma3"
    select MCUX_COMPONENT_driver.flexspi
    select MCUX_COMPONENT_driver.dma3 if MCUX_HAS_COMPONENT_driver.dma3
    select MCUX_COMPONENT_driver.edma4 if MCUX_HAS_COMPONENT_driver.edma4
    depends on MCUX_HAS_COMPONENT_driver.flexspi_dma3
```

## mcux/mcux-sdk-ng/drivers/flexspi_flr/Kconfig
```kconfig
# Copyright 2024 NXP
#
# SPDX-License-Identifier: BSD-3-Clause

config MCUX_HAS_COMPONENT_driver.flexspi_flr
    bool
    default y if MCUX_HW_IP_DriverType_FLEXSPI_SLV

config MCUX_COMPONENT_driver.flexspi_flr
    bool "flexspi_flr"
    select MCUX_COMPONENT_driver.common
    depends on MCUX_HAS_COMPONENT_driver.flexspi_flr
```

## mcux/mcux-sdk-ng/drivers/fmeas/Kconfig
```kconfig
# Copyright 2024 NXP
#
# SPDX-License-Identifier: BSD-3-Clause

config MCUX_HAS_COMPONENT_driver.fmeas
    bool
    default y if MCUX_HW_IP_DriverType_ASYNC_SYSCON_FREQME || MCUX_HW_IP_DriverType_SYSCON_FREQME || MCUX_HW_IP_DriverType_MCO_FREQME

config MCUX_COMPONENT_driver.fmeas
    bool "fmeas"
    select MCUX_COMPONENT_driver.common
    depends on MCUX_HAS_COMPONENT_driver.fmeas
```

## mcux/mcux-sdk-ng/drivers/fract_pll/Kconfig
```kconfig
# Copyright 2024 NXP
#
# SPDX-License-Identifier: BSD-3-Clause

config MCUX_HAS_COMPONENT_driver.fract_pll
    bool
    default y if MCUX_HW_IP_DriverType_FRACT_PLL

config MCUX_COMPONENT_driver.fract_pll
    bool "fract_pll"
    select MCUX_COMPONENT_driver.common
    depends on MCUX_HAS_COMPONENT_driver.fract_pll
```

## mcux/mcux-sdk-ng/drivers/gdet/Kconfig
```kconfig
# Copyright 2024 NXP
#
# SPDX-License-Identifier: BSD-3-Clause

config MCUX_HAS_COMPONENT_driver.gdet
    bool
    default y if MCUX_HW_IP_DriverType_GDET

config MCUX_COMPONENT_driver.gdet
    bool "gdet"
    select MCUX_COMPONENT_driver.common
    depends on MCUX_HAS_COMPONENT_driver.gdet
```

## mcux/mcux-sdk-ng/drivers/glikey/Kconfig
```kconfig
# Copyright 2024 NXP
#
# SPDX-License-Identifier: BSD-3-Clause

config MCUX_HAS_COMPONENT_driver.glikey
    bool
    default y if MCUX_HW_IP_DriverType_GLIKEY

config MCUX_COMPONENT_driver.glikey
    bool "glikey"
    select MCUX_COMPONENT_driver.common
    depends on MCUX_HAS_COMPONENT_driver.glikey
```

## mcux/mcux-sdk-ng/drivers/gpc_1/Kconfig
```kconfig
# Copyright 2024 NXP
#
# SPDX-License-Identifier: BSD-3-Clause

config MCUX_HAS_COMPONENT_driver.gpc_1
    bool
    default y if MCUX_HW_IP_DriverType_GPC_1

config MCUX_COMPONENT_driver.gpc_1
    bool "gpc_1"
    select MCUX_COMPONENT_driver.common
    depends on MCUX_HAS_COMPONENT_driver.gpc_1
```

## mcux/mcux-sdk-ng/drivers/gpc_2/Kconfig
```kconfig
# Copyright 2024 NXP
#
# SPDX-License-Identifier: BSD-3-Clause

config MCUX_HAS_COMPONENT_driver.gpc_2
    bool
    default y if MCUX_HW_IP_DriverType_GPC_2

config MCUX_COMPONENT_driver.gpc_2
    bool "gpc_2"
    select MCUX_COMPONENT_driver.common
    depends on MCUX_HAS_COMPONENT_driver.gpc_2
```

## mcux/mcux-sdk-ng/drivers/gpio/Kconfig
```kconfig
# Copyright 2024 NXP
#
# SPDX-License-Identifier: BSD-3-Clause

config MCUX_HAS_COMPONENT_driver.gpio
    bool
    default y if MCUX_HW_IP_DriverType_GPIO

config MCUX_COMPONENT_driver.gpio
    bool "gpio"
    select MCUX_COMPONENT_driver.common
    depends on MCUX_HAS_COMPONENT_driver.gpio
```

## mcux/mcux-sdk-ng/drivers/gpio_1/Kconfig
```kconfig
# Copyright 2024 NXP
#
# SPDX-License-Identifier: BSD-3-Clause

config MCUX_HAS_COMPONENT_driver.gpio_1
    bool
    default y if MCUX_HW_IP_DriverType_GPIO_1

config MCUX_COMPONENT_driver.gpio_1
    bool "gpio_1"
    select MCUX_COMPONENT_driver.common
    depends on MCUX_HAS_COMPONENT_driver.gpio_1
```

## mcux/mcux-sdk-ng/drivers/gpt/Kconfig
```kconfig
# Copyright 2024 NXP
#
# SPDX-License-Identifier: BSD-3-Clause

config MCUX_HAS_COMPONENT_driver.gpt
    bool
    default y if MCUX_HW_IP_DriverType_GPT

config MCUX_COMPONENT_driver.gpt
    bool "gpt"
    select MCUX_COMPONENT_driver.common
    depends on MCUX_HAS_COMPONENT_driver.gpt
```

## mcux/mcux-sdk-ng/drivers/hscmp/Kconfig
```kconfig
# Copyright 2024 NXP
#
# SPDX-License-Identifier: BSD-3-Clause

config MCUX_HAS_COMPONENT_driver.hscmp
    bool
    default y if MCUX_HW_IP_DriverType_HSCMP

config MCUX_COMPONENT_driver.hscmp
    bool "hscmp"
    select MCUX_COMPONENT_driver.common
    depends on MCUX_HAS_COMPONENT_driver.hscmp
```

## mcux/mcux-sdk-ng/drivers/i2c/Kconfig
```kconfig
# Copyright 2024 NXP
#
# SPDX-License-Identifier: BSD-3-Clause

config MCUX_HAS_COMPONENT_driver.i2c_dma
    bool
    default y if MCUX_HAS_COMPONENT_driver.i2c && MCUX_HAS_COMPONENT_driver.dma

config MCUX_HAS_COMPONENT_driver.i2c_edma
    bool
    default y if MCUX_HAS_COMPONENT_driver.i2c && MCUX_HAS_COMPONENT_driver.edma

config MCUX_HAS_COMPONENT_driver.i2c
    bool
    default y if MCUX_HW_IP_DriverType_I2C

config MCUX_COMPONENT_driver.i2c_dma
    bool "i2c_dma"
    select MCUX_COMPONENT_driver.i2c
    select MCUX_COMPONENT_driver.dma
    depends on MCUX_HAS_COMPONENT_driver.i2c_dma

config MCUX_COMPONENT_driver.i2c_edma
    bool "i2c_edma"
    select MCUX_COMPONENT_driver.i2c
    select MCUX_COMPONENT_driver.edma
    depends on MCUX_HAS_COMPONENT_driver.i2c_edma

config MCUX_COMPONENT_driver.i2c
    bool "i2c"
    select MCUX_COMPONENT_driver.common
    depends on MCUX_HAS_COMPONENT_driver.i2c
```

## mcux/mcux-sdk-ng/drivers/iap/Kconfig
```kconfig
# Copyright 2024 NXP
#
# SPDX-License-Identifier: BSD-3-Clause

config MCUX_HAS_COMPONENT_driver.iap
    bool
    default y if MCUX_HW_IP_DriverType_IAP

config MCUX_COMPONENT_driver.iap
    bool "iap"
    select MCUX_COMPONENT_driver.common
    depends on MCUX_HAS_COMPONENT_driver.iap
```

## mcux/mcux-sdk-ng/drivers/iap1/Kconfig
```kconfig
# Copyright 2024 NXP
#
# SPDX-License-Identifier: BSD-3-Clause

config MCUX_HAS_COMPONENT_driver.iap1
    bool
    default y if MCUX_HW_IP_DriverType_IAP_1

config MCUX_COMPONENT_driver.iap1
    bool "iap1"
    select MCUX_COMPONENT_driver.common
    depends on MCUX_HAS_COMPONENT_driver.iap1
```

## mcux/mcux-sdk-ng/drivers/iee/Kconfig
```kconfig
# Copyright 2024 NXP
#
# SPDX-License-Identifier: BSD-3-Clause

config MCUX_HAS_COMPONENT_driver.iee
    bool
    default y if MCUX_HW_IP_DriverType_IEE

config MCUX_COMPONENT_driver.iee
    bool "iee"
    select MCUX_COMPONENT_driver.common
    depends on MCUX_HAS_COMPONENT_driver.iee
```

## mcux/mcux-sdk-ng/drivers/iee_apc/Kconfig
```kconfig
# Copyright 2024 NXP
#
# SPDX-License-Identifier: BSD-3-Clause

config MCUX_HAS_COMPONENT_driver.iee_apc
    bool
    default y if MCUX_HW_IP_DriverType_IEE_APC

config MCUX_COMPONENT_driver.iee_apc
    bool "iee_apc"
    select MCUX_COMPONENT_driver.common
    depends on MCUX_HAS_COMPONENT_driver.iee_apc
```

## mcux/mcux-sdk-ng/drivers/ii2c/Kconfig
```kconfig
# Copyright 2024 NXP
#
# SPDX-License-Identifier: BSD-3-Clause

config MCUX_HAS_COMPONENT_driver.ii2c
    bool
    default y if MCUX_HW_IP_DriverType_II2C

config MCUX_COMPONENT_driver.ii2c
    bool "ii2c"
    depends on MCUX_HAS_COMPONENT_driver.ii2c
```

## mcux/mcux-sdk-ng/drivers/imu/Kconfig
```kconfig
# Copyright 2024 NXP
#
# SPDX-License-Identifier: BSD-3-Clause

config MCUX_HAS_COMPONENT_driver.imu
    bool
    default y if MCUX_HW_IP_DriverType_CNS_CIU1_IMU || MCUX_HW_IP_DriverType_CNS_CIU2_IMU || MCUX_HW_IP_DriverType_IMU

config MCUX_COMPONENT_driver.imu
    bool "imu"
    select MCUX_COMPONENT_driver.common
    depends on MCUX_HAS_COMPONENT_driver.imu
```

## mcux/mcux-sdk-ng/drivers/inputmux/Kconfig
```kconfig
# Copyright 2024 NXP
#
# SPDX-License-Identifier: BSD-3-Clause

config MCUX_HAS_COMPONENT_driver.inputmux
    bool
    default y if MCUX_HW_IP_DriverType_INPUTMUX

config MCUX_COMPONENT_driver.inputmux
    bool "inputmux"
    select MCUX_COMPONENT_driver.common
    select MCUX_COMPONENT_driver.inputmux_connections
    depends on MCUX_HAS_COMPONENT_driver.inputmux
```

## mcux/mcux-sdk-ng/drivers/intc/Kconfig
```kconfig
# Copyright 2024 NXP
#
# SPDX-License-Identifier: BSD-3-Clause

config MCUX_HAS_COMPONENT_driver.intc
    bool
    default y if MCUX_HW_IP_DriverType_INTC

config MCUX_COMPONENT_driver.intc
    bool "intc"
    select MCUX_COMPONENT_driver.common
    depends on MCUX_HAS_COMPONENT_driver.intc
```

## mcux/mcux-sdk-ng/drivers/intmux/Kconfig
```kconfig
# Copyright 2024 NXP
#
# SPDX-License-Identifier: BSD-3-Clause

config MCUX_HAS_COMPONENT_driver.intmux
    bool
    default y if MCUX_HW_IP_DriverType_INTMUX

config MCUX_COMPONENT_driver.intmux
    bool "intmux"
    select MCUX_COMPONENT_driver.common
    depends on MCUX_HAS_COMPONENT_driver.intmux
```

## mcux/mcux-sdk-ng/drivers/iped/Kconfig
```kconfig
# Copyright 2024 NXP
#
# SPDX-License-Identifier: BSD-3-Clause

config MCUX_HAS_COMPONENT_driver.iped
    bool
    default y if MCUX_HW_IP_DriverType_FLEXSPI_IPED

config MCUX_COMPONENT_driver.iped
    bool "iped"
    select MCUX_COMPONENT_driver.common
    select MCUX_COMPONENT_component.els_pkc
    select MCUX_COMPONENT_driver.romapi_flash
    select MCUX_COMPONENT_driver.romapi_mem_interface
    depends on MCUX_HAS_COMPONENT_driver.iped
```

## mcux/mcux-sdk-ng/drivers/qn_flash/Kconfig
```kconfig
# Copyright 2024 NXP
#
# SPDX-License-Identifier: BSD-3-Clause

config MCUX_COMPONENT_driver.qn_flash_dma
    bool "qn_flash_dma"
    select MCUX_COMPONENT_driver.lpc_dma
    depends on MCUX_HAS_COMPONENT_driver.lpc_dma && MCUX_HW_QNXXX #TODO: Update with QN908XA/B/C

config MCUX_COMPONENT_driver.qn_flash
    bool "qn_flash"
    select MCUX_COMPONENT_driver.common
    depends on MCUX_HW_QNXXX #TODO: Update with QN908XA/B/C
```

## mcux/mcux-sdk-ng/drivers/qn_fsp/Kconfig
```kconfig
# Copyright 2024 NXP
#
# SPDX-License-Identifier: BSD-3-Clause

config MCUX_COMPONENT_driver.qn_fsp
    bool "qn_fsp"
    select MCUX_COMPONENT_driver.common
    depends on MCUX_HW_QNXXX #TODO: Update with QN908XA/B/C
```

## mcux/mcux-sdk-ng/drivers/qn_rng/Kconfig
```kconfig
# Copyright 2024 NXP
#
# SPDX-License-Identifier: BSD-3-Clause

config MCUX_COMPONENT_driver.qn_rng
    bool "qn_rng"
    select MCUX_COMPONENT_driver.common
    depends on MCUX_HW_QNXXX #TODO: Update with QN908XA/B/C
```

## mcux/mcux-sdk-ng/drivers/qn_rtc/Kconfig
```kconfig
# Copyright 2024 NXP
#
# SPDX-License-Identifier: BSD-3-Clause

config MCUX_COMPONENT_driver.qn_rtc
    bool "qn_rtc"
    select MCUX_COMPONENT_driver.common
    depends on MCUX_HW_QNXXX #TODO: Update with QN908XA/B/C
```

## mcux/mcux-sdk-ng/drivers/qn_syscon/Kconfig
```kconfig
# Copyright 2024 NXP
#
# SPDX-License-Identifier: BSD-3-Clause

config MCUX_COMPONENT_driver.qn_syscon
    bool "qn_syscon"
    select MCUX_COMPONENT_driver.common
    depends on MCUX_HW_QNXXX #TODO: Update with QN908XA/B/C
```

## mcux/mcux-sdk-ng/drivers/qn_wdt/Kconfig
```kconfig
# Copyright 2024 NXP
#
# SPDX-License-Identifier: BSD-3-Clause

config MCUX_COMPONENT_driver.qn_wdt
    bool "qn_wdt"
    select MCUX_COMPONENT_driver.common
    depends on MCUX_HW_QNXXX #TODO: Update with QN908XA/B/C
```

## mcux/mcux-sdk-ng/drivers/qsci/Kconfig
```kconfig
# Copyright 2024 NXP
#
# SPDX-License-Identifier: BSD-3-Clause

config MCUX_HAS_COMPONENT_driver.qsci_dma
    bool
    default y if MCUX_HAS_COMPONENT_driver.qsci && MCUX_HAS_COMPONENT_driver.dsc_dma

config MCUX_HAS_COMPONENT_driver.qsci_edma
    bool
    default y if MCUX_HAS_COMPONENT_driver.qsci && MCUX_HAS_COMPONENT_driver.dsc_edma

config MCUX_HAS_COMPONENT_driver.qsci
    bool
    default y if MCUX_HW_IP_DriverType_QSCI

config MCUX_COMPONENT_driver.qsci_dma
    bool "qsci_dma"
    select MCUX_COMPONENT_driver.qsci
    select MCUX_COMPONENT_driver.dsc_dma
    depends on MCUX_HAS_COMPONENT_driver.qsci_dma

config MCUX_COMPONENT_driver.qsci_edma
    bool "qsci_edma"
    select MCUX_COMPONENT_driver.qsci
    select MCUX_COMPONENT_driver.dsc_edma
    depends on MCUX_HAS_COMPONENT_driver.qsci_edma

config MCUX_COMPONENT_driver.qsci
    bool "qsci"
    select MCUX_COMPONENT_driver.common
    depends on MCUX_HAS_COMPONENT_driver.qsci
```

## mcux/mcux-sdk-ng/drivers/qspi/Kconfig
```kconfig
# Copyright 2024 NXP
#
# SPDX-License-Identifier: BSD-3-Clause

config MCUX_HAS_COMPONENT_driver.qspi_edma
    bool
    default y if MCUX_HAS_COMPONENT_driver.qspi && MCUX_HAS_COMPONENT_driver.edma

config MCUX_HAS_COMPONENT_driver.qspi
    bool
    default y if MCUX_HW_IP_DriverType_QUADSPI

config MCUX_COMPONENT_driver.qspi_edma
    bool "qspi_edma"
    select MCUX_COMPONENT_driver.qspi
    select MCUX_COMPONENT_driver.edma
    depends on MCUX_HAS_COMPONENT_driver.qspi_edma

config MCUX_COMPONENT_driver.qspi
    bool "qspi"
    select MCUX_COMPONENT_driver.common
    depends on MCUX_HAS_COMPONENT_driver.qspi
```

## mcux/mcux-sdk-ng/drivers/qtmr_1/Kconfig
```kconfig
# Copyright 2024 NXP
#
# SPDX-License-Identifier: BSD-3-Clause

config MCUX_HAS_COMPONENT_driver.qtmr_1
    bool
    default y if MCUX_HW_IP_DriverType_TMR_1

config MCUX_COMPONENT_driver.qtmr_1
    bool "qtmr_1"
    select MCUX_COMPONENT_driver.common
    depends on MCUX_HAS_COMPONENT_driver.qtmr_1
```

## mcux/mcux-sdk-ng/drivers/qtmr_2/Kconfig
```kconfig
# Copyright 2024 NXP
#
# SPDX-License-Identifier: BSD-3-Clause

config MCUX_HAS_COMPONENT_driver.qtmr_2
    bool
    default y if MCUX_HW_IP_DriverType_TMR_2

config MCUX_COMPONENT_driver.qtmr_2
    bool "qtmr_2"
    select MCUX_COMPONENT_driver.common
    depends on MCUX_HAS_COMPONENT_driver.qtmr_2
```

## mcux/mcux-sdk-ng/drivers/queued_spi/Kconfig
```kconfig
# Copyright 2024 NXP
#
# SPDX-License-Identifier: BSD-3-Clause

config MCUX_HAS_COMPONENT_driver.queued_spi_dma
    bool
    default y if MCUX_HAS_COMPONENT_driver.queued_spi && MCUX_HAS_COMPONENT_driver.dsc_dma

config MCUX_HAS_COMPONENT_driver.queued_spi_edma
    bool
    default y if MCUX_HAS_COMPONENT_driver.queued_spi && MCUX_HAS_COMPONENT_driver.dsc_edma

config MCUX_HAS_COMPONENT_driver.queued_spi
    bool
    default y if MCUX_HW_IP_DriverType_QUEUED_SPI

config MCUX_COMPONENT_driver.queued_spi_dma
    bool "queued_spi_dma"
    select MCUX_COMPONENT_driver.queued_spi
    select MCUX_COMPONENT_driver.dsc_dma
    depends on MCUX_HAS_COMPONENT_driver.queued_spi_dma

config MCUX_COMPONENT_driver.queued_spi_edma
    bool "queued_spi_edma"
    select MCUX_COMPONENT_driver.queued_spi
    select MCUX_COMPONENT_driver.dsc_edma
    depends on MCUX_HAS_COMPONENT_driver.queued_spi_edma

config MCUX_COMPONENT_driver.queued_spi
    bool "queued_spi"
    select MCUX_COMPONENT_driver.common
    depends on MCUX_HAS_COMPONENT_driver.queued_spi
```

## mcux/mcux-sdk-ng/drivers/rdc/Kconfig
```kconfig
# Copyright 2024 NXP
#
# SPDX-License-Identifier: BSD-3-Clause

config MCUX_HAS_COMPONENT_driver.rdc
    bool
    default y if MCUX_HW_IP_DriverType_RDC

config MCUX_COMPONENT_driver.rdc
    bool "rdc"
    select MCUX_COMPONENT_driver.common
    depends on MCUX_HAS_COMPONENT_driver.rdc
```

## mcux/mcux-sdk-ng/drivers/rdc_sema42/Kconfig
```kconfig
# Copyright 2024 NXP
#
# SPDX-License-Identifier: BSD-3-Clause

config MCUX_HAS_COMPONENT_driver.rdc_sema42
    bool
    default y if MCUX_HW_IP_DriverType_RDC_SEMAPHORE

config MCUX_COMPONENT_driver.rdc_sema42
    bool "rdc_sema42"
    select MCUX_COMPONENT_driver.common
    depends on MCUX_HAS_COMPONENT_driver.rdc_sema42
```

## mcux/mcux-sdk-ng/drivers/rgpio/Kconfig
```kconfig
# Copyright 2024 NXP
#
# SPDX-License-Identifier: BSD-3-Clause

config MCUX_HAS_COMPONENT_driver.rgpio
    bool
    default y if MCUX_HW_IP_DriverType_RGPIO

config MCUX_COMPONENT_driver.rgpio
    bool "rgpio"
    select MCUX_COMPONENT_driver.common
    depends on MCUX_HAS_COMPONENT_driver.rgpio
```

## mcux/mcux-sdk-ng/drivers/rng/Kconfig
```kconfig
# Copyright 2024 NXP
#
# SPDX-License-Identifier: BSD-3-Clause

config MCUX_HAS_COMPONENT_driver.rng
    bool
    default y if MCUX_HW_IP_DriverType_RNG

config MCUX_COMPONENT_driver.rng
    bool "rng"
    select MCUX_COMPONENT_driver.common
    depends on MCUX_HAS_COMPONENT_driver.rng
```

## mcux/mcux-sdk-ng/drivers/rnga/Kconfig
```kconfig
# Copyright 2024 NXP
#
# SPDX-License-Identifier: BSD-3-Clause

config MCUX_HAS_COMPONENT_driver.rnga
    bool
    default y if MCUX_HW_IP_DriverType_RNGA

config MCUX_COMPONENT_driver.rnga
    bool "rnga"
    select MCUX_COMPONENT_driver.common
    depends on MCUX_HAS_COMPONENT_driver.rnga
```

## mcux/mcux-sdk-ng/drivers/rtc/Kconfig
```kconfig
# Copyright 2024 NXP
#
# SPDX-License-Identifier: BSD-3-Clause

config MCUX_HAS_COMPONENT_driver.rtc
    bool
    default y if MCUX_HW_IP_DriverType_SRTC

config MCUX_COMPONENT_driver.rtc
    bool "rtc"
    select MCUX_COMPONENT_driver.common
    depends on MCUX_HAS_COMPONENT_driver.rtc
```

## mcux/mcux-sdk-ng/drivers/rtd_cmc/Kconfig
```kconfig
# Copyright 2024 NXP
#
# SPDX-License-Identifier: BSD-3-Clause

config MCUX_HAS_COMPONENT_driver.rtd_cmc
    bool
    default y if MCUX_HW_IP_DriverType_RTD_CMC

config MCUX_COMPONENT_driver.rtd_cmc
    bool "rtd_cmc"
    select MCUX_COMPONENT_driver.common
    depends on MCUX_HAS_COMPONENT_driver.rtd_cmc
```

## mcux/mcux-sdk-ng/drivers/rtwdog/Kconfig
```kconfig
# Copyright 2024 NXP
#
# SPDX-License-Identifier: BSD-3-Clause

config MCUX_HAS_COMPONENT_driver.rtwdog
    bool
    default y if MCUX_HW_IP_DriverType_RTWDOG

config MCUX_COMPONENT_driver.rtwdog
    bool "rtwdog"
    select MCUX_COMPONENT_driver.common
    depends on MCUX_HAS_COMPONENT_driver.rtwdog
```

## mcux/mcux-sdk-ng/drivers/s3mu/Kconfig
```kconfig
# Copyright 2024 NXP
#
# SPDX-License-Identifier: BSD-3-Clause

config MCUX_HAS_COMPONENT_driver.s3mu
    bool
    default y if MCUX_HW_IP_DriverType_S3MU

config MCUX_COMPONENT_driver.s3mu
    bool "s3mu"
    depends on MCUX_HAS_COMPONENT_driver.s3mu
```

## mcux/mcux-sdk-ng/drivers/sai/Kconfig
```kconfig
# Copyright 2024 NXP
#
# SPDX-License-Identifier: BSD-3-Clause

config MCUX_HAS_COMPONENT_driver.sai_dma
    bool
    default y if MCUX_HAS_COMPONENT_driver.sai && MCUX_HAS_COMPONENT_driver.dma

config MCUX_HAS_COMPONENT_driver.sai_edma
    bool
    default y if MCUX_HAS_COMPONENT_driver.sai && (MCUX_HAS_COMPONENT_driver.dma3 || MCUX_HAS_COMPONENT_driver.edma || MCUX_HAS_COMPONENT_driver.edma4)

config MCUX_HAS_COMPONENT_driver.sai_sdma
    bool
    default y if MCUX_HAS_COMPONENT_driver.sai && MCUX_HAS_COMPONENT_driver.sdma

config MCUX_HAS_COMPONENT_driver.sai
    bool
    default y if MCUX_HW_IP_DriverType_SAI

config MCUX_COMPONENT_driver.sai_dma
    bool "sai_dma"
    select MCUX_COMPONENT_driver.sai
    select MCUX_COMPONENT_driver.dma
    depends on MCUX_HAS_COMPONENT_driver.sai_dma

config MCUX_COMPONENT_driver.sai_edma
    bool "sai_edma"
    select MCUX_COMPONENT_driver.sai
    select MCUX_COMPONENT_driver.dma3 if MCUX_HAS_COMPONENT_driver.dma3
    select MCUX_COMPONENT_driver.edma if MCUX_HAS_COMPONENT_driver.edma
    select MCUX_COMPONENT_driver.edma4 if MCUX_HAS_COMPONENT_driver.edma4
    depends on MCUX_HAS_COMPONENT_driver.sai_edma

config MCUX_COMPONENT_driver.sai_sdma
    bool "sai_sdma"
    select MCUX_COMPONENT_driver.sai
    select MCUX_COMPONENT_driver.sdma
    depends on MCUX_HAS_COMPONENT_driver.sai_sdma

config MCUX_COMPONENT_driver.sai
    bool "sai"
    select MCUX_COMPONENT_driver.common
    depends on MCUX_HAS_COMPONENT_driver.sai
```

## mcux/mcux-sdk-ng/drivers/sar_adc/Kconfig
```kconfig
# Copyright 2024 NXP
#
# SPDX-License-Identifier: BSD-3-Clause

config MCUX_HAS_COMPONENT_driver.sar_adc
    bool
    default y if MCUX_HW_IP_DriverType_SAR_ADC

config MCUX_COMPONENT_driver.sar_adc
    bool "sar_adc"
    select MCUX_COMPONENT_driver.common
    depends on MCUX_HAS_COMPONENT_driver.sar_adc
```

## mcux/mcux-sdk-ng/drivers/sctimer/Kconfig
```kconfig
# Copyright 2024 NXP
#
# SPDX-License-Identifier: BSD-3-Clause

config MCUX_HAS_COMPONENT_driver.sctimer
    bool
    default y if MCUX_HW_IP_DriverType_SCTIMER

config MCUX_COMPONENT_driver.sctimer
    bool "sctimer"
    select MCUX_COMPONENT_driver.common
    depends on MCUX_HAS_COMPONENT_driver.sctimer
```

## mcux/mcux-sdk-ng/drivers/sdif/Kconfig
```kconfig
# Copyright 2024 NXP
#
# SPDX-License-Identifier: BSD-3-Clause

config MCUX_HAS_COMPONENT_driver.sdif
    bool
    default y if MCUX_HW_IP_DriverType_SDIF

config MCUX_COMPONENT_driver.sdif
    bool "sdif"
    select MCUX_COMPONENT_driver.common
    depends on MCUX_HAS_COMPONENT_driver.sdif
```

## mcux/mcux-sdk-ng/drivers/sdu/Kconfig
```kconfig
# Copyright 2024 NXP
#
# SPDX-License-Identifier: BSD-3-Clause

config MCUX_HAS_COMPONENT_driver.sdu
    bool
    default y if MCUX_HW_IP_DriverType_CNS_SDU_FBR_CARD || MCUX_HW_IP_DriverType_CNS_SDU_FN0_CARD || MCUX_HW_IP_DriverType_CNS_SDU_FN_CARD

config MCUX_COMPONENT_driver.sdu
    bool "sdu"
    select MCUX_COMPONENT_driver.common
    depends on MCUX_HAS_COMPONENT_driver.sdu
```

## mcux/mcux-sdk-ng/drivers/casper/Kconfig
```kconfig
# Copyright 2024 NXP
#
# SPDX-License-Identifier: BSD-3-Clause

config MCUX_HAS_COMPONENT_driver.casper
    bool
    default y if MCUX_HW_IP_DriverType_CASPER

config MCUX_COMPONENT_driver.casper
    bool "casper"
    select MCUX_COMPONENT_driver.common
    depends on MCUX_HAS_COMPONENT_driver.casper
```

## mcux/mcux-sdk-ng/drivers/ccm32k/Kconfig
```kconfig
# Copyright 2024 NXP
#
# SPDX-License-Identifier: BSD-3-Clause

config MCUX_HAS_COMPONENT_driver.ccm32k
    bool
    default y if MCUX_HW_IP_DriverType_CCM32K

config MCUX_COMPONENT_driver.ccm32k
    bool "ccm32k"
    select MCUX_COMPONENT_driver.common
    depends on MCUX_HAS_COMPONENT_driver.ccm32k
```

## mcux/mcux-sdk-ng/drivers/ce/Kconfig
```kconfig
# Copyright 2024 NXP
#
# SPDX-License-Identifier: BSD-3-Clause

config MCUX_HAS_COMPONENT_driver.ce
    bool
    default y if MCUX_HW_IP_DriverType_CE

config MCUX_COMPONENT_driver.ce
    bool "Compute Engine"
    select MCUX_COMPONENT_driver.common
    depends on MCUX_HAS_COMPONENT_driver.ce
```

## mcux/mcux-sdk-ng/drivers/ci_pi/Kconfig
```kconfig
# Copyright 2024 NXP
#
# SPDX-License-Identifier: BSD-3-Clause

config MCUX_HAS_COMPONENT_driver.ci_pi
    bool
    default y if MCUX_HW_IP_DriverType_CI_PI_CSR

config MCUX_COMPONENT_driver.ci_pi
    bool "ci_pi"
    select MCUX_COMPONENT_driver.common
    depends on MCUX_HAS_COMPONENT_driver.ci_pi
```

## mcux/mcux-sdk-ng/drivers/cic_irb/Kconfig
```kconfig
# Copyright 2024 NXP
#
# SPDX-License-Identifier: BSD-3-Clause

config MCUX_HAS_COMPONENT_driver.cic_irb
    bool
    default y if MCUX_HW_IP_DriverType_IRB

config MCUX_COMPONENT_driver.cic_irb
    bool "cic_irb"
    select MCUX_COMPONENT_driver.common
    depends on MCUX_HAS_COMPONENT_driver.cic_irb
```

## mcux/mcux-sdk-ng/drivers/cmc/Kconfig
```kconfig
# Copyright 2024 NXP
#
# SPDX-License-Identifier: BSD-3-Clause

config MCUX_HAS_COMPONENT_driver.cmc
    bool
    default y if MCUX_HW_IP_DriverType_CMC

config MCUX_COMPONENT_driver.cmc
    bool "cmc"
    select MCUX_COMPONENT_driver.common
    depends on MCUX_HAS_COMPONENT_driver.cmc
```

## mcux/mcux-sdk-ng/drivers/cns_adc/Kconfig
```kconfig
# Copyright 2024 NXP
#
# SPDX-License-Identifier: BSD-3-Clause

config MCUX_HAS_COMPONENT_driver.cns_adc
    bool
    default y if MCUX_HW_IP_DriverType_CNS_ADC

config MCUX_COMPONENT_driver.cns_adc
    bool "cns_adc"
    select MCUX_COMPONENT_driver.common
    depends on MCUX_HAS_COMPONENT_driver.cns_adc
```

## mcux/mcux-sdk-ng/drivers/common/Kconfig
```kconfig
# Copyright 2024 NXP
#
# SPDX-License-Identifier: BSD-3-Clause

config MCUX_COMPONENT_driver.common
    bool "common"
```

## mcux/mcux-sdk-ng/drivers/cop/Kconfig
```kconfig
# Copyright 2024 NXP
#
# SPDX-License-Identifier: BSD-3-Clause

config MCUX_HAS_COMPONENT_driver.cop
    bool
    default y if MCUX_HW_IP_DriverType_SIM_COP

config MCUX_COMPONENT_driver.cop
    bool "cop"
    select MCUX_COMPONENT_driver.common
    depends on MCUX_HAS_COMPONENT_driver.cop
```

## mcux/mcux-sdk-ng/drivers/ctimer/Kconfig
```kconfig
# Copyright 2024 NXP
#
# SPDX-License-Identifier: BSD-3-Clause

config MCUX_HAS_COMPONENT_driver.ctimer
    bool
    default y if MCUX_HW_IP_DriverType_CTIMER

config MCUX_COMPONENT_driver.ctimer
    bool "ctimer"
    select MCUX_COMPONENT_driver.common
    depends on MCUX_HAS_COMPONENT_driver.ctimer
```

## mcux/mcux-sdk-ng/drivers/dac/Kconfig
```kconfig
# Copyright 2024 NXP
#
# SPDX-License-Identifier: BSD-3-Clause

config MCUX_HAS_COMPONENT_driver.dac
    bool
    default y if MCUX_HW_IP_DriverType_DAC

config MCUX_COMPONENT_driver.dac
    bool "dac"
    select MCUX_COMPONENT_driver.common
    depends on MCUX_HAS_COMPONENT_driver.dac
```

## mcux/mcux-sdk-ng/drivers/dac12/Kconfig
```kconfig
# Copyright 2024 NXP
#
# SPDX-License-Identifier: BSD-3-Clause

config MCUX_HAS_COMPONENT_driver.dac12
    bool
    default y if MCUX_HW_IP_DriverType_DAC12

config MCUX_COMPONENT_driver.dac12
    bool "dac12"
    select MCUX_COMPONENT_driver.common
    depends on MCUX_HAS_COMPONENT_driver.dac12
```

## mcux/mcux-sdk-ng/drivers/dac14/Kconfig
```kconfig
# Copyright 2024 NXP
#
# SPDX-License-Identifier: BSD-3-Clause

config MCUX_HAS_COMPONENT_driver.dac14
    bool
    default y if MCUX_HW_IP_DriverType_HPDAC

config MCUX_COMPONENT_driver.dac14
    bool "dac14"
    select MCUX_COMPONENT_driver.common
    depends on MCUX_HAS_COMPONENT_driver.dac14
```

## mcux/mcux-sdk-ng/drivers/dac32/Kconfig
```kconfig
# Copyright 2024 NXP
#
# SPDX-License-Identifier: BSD-3-Clause

config MCUX_HAS_COMPONENT_driver.dac32
    bool
    default y if MCUX_HW_IP_DriverType_DAC32

config MCUX_COMPONENT_driver.dac32
    bool "dac32"
    select MCUX_COMPONENT_driver.common
    depends on MCUX_HAS_COMPONENT_driver.dac32
```

## mcux/mcux-sdk-ng/drivers/dcdc_1/Kconfig
```kconfig
# Copyright 2024 NXP
#
# SPDX-License-Identifier: BSD-3-Clause

config MCUX_HAS_COMPONENT_driver.dcdc_1
    bool
    default y if MCUX_HW_IP_DriverType_DCDC_1

config MCUX_COMPONENT_driver.dcdc_1
    bool "dcdc_1"
    select MCUX_COMPONENT_driver.common
    depends on MCUX_HAS_COMPONENT_driver.dcdc_1
```

## mcux/mcux-sdk-ng/drivers/dma3/Kconfig
```kconfig
# Copyright 2024 NXP
#
# SPDX-License-Identifier: BSD-3-Clause

config MCUX_HAS_COMPONENT_driver.ad_dma3
    bool
    default y if MCUX_HW_IP_DriverType_AD_DMA3

config MCUX_HAS_COMPONENT_driver.dma3
    bool
    default y if MCUX_HW_IP_DriverType_DMA3

config MCUX_COMPONENT_driver.ad_dma3
    bool "ad_dma3"
    depends on MCUX_HAS_COMPONENT_driver.ad_dma3

config MCUX_COMPONENT_driver.dma3
    bool "dma3"
    depends on MCUX_HAS_COMPONENT_driver.dma3
```

## mcux/mcux-sdk-ng/drivers/dmamux/Kconfig
```kconfig
# Copyright 2024 NXP
#
# SPDX-License-Identifier: BSD-3-Clause

config MCUX_HAS_COMPONENT_driver.dmamux
    bool
    default y if MCUX_HW_IP_DriverType_DMAMUX || MCUX_HW_IP_DriverType_DMAMUX32

config MCUX_COMPONENT_driver.dmamux
    bool "dmamux"
    select MCUX_COMPONENT_driver.common
    depends on MCUX_HAS_COMPONENT_driver.dmamux
```

## mcux/mcux-sdk-ng/drivers/dmic/Kconfig
```kconfig
# Copyright 2024 NXP
#
# SPDX-License-Identifier: BSD-3-Clause

config MCUX_HAS_COMPONENT_driver.dmic
    bool
    default y if MCUX_HW_IP_DriverType_DMIC

config MCUX_HAS_COMPONENT_driver.dmic_dma
    bool
    default y if MCUX_HAS_COMPONENT_driver.dmic && MCUX_HAS_COMPONENT_driver.lpc_dma

config MCUX_COMPONENT_driver.dmic_dma
    bool "dmic_dma"
    select MCUX_COMPONENT_driver.dmic
    select MCUX_COMPONENT_driver.lpc_dma
    depends on MCUX_HAS_COMPONENT_driver.dmic_dma

config MCUX_COMPONENT_driver.dmic_hwvad
    bool "dmic_hwvad"
    select MCUX_COMPONENT_driver.dmic
    depends on MCUX_HAS_COMPONENT_driver.dmic

config MCUX_COMPONENT_driver.dmic
    bool "dmic"
    select MCUX_COMPONENT_driver.common
    depends on MCUX_HAS_COMPONENT_driver.dmic
```

## mcux/mcux-sdk-ng/drivers/dpr/Kconfig
```kconfig
# Copyright 2024 NXP
#
# SPDX-License-Identifier: BSD-3-Clause

config MCUX_HAS_COMPONENT_driver.dpr
    bool
    default y if MCUX_HW_IP_DriverType_DPR

config MCUX_COMPONENT_driver.dpr
    bool "dpr"
    select MCUX_COMPONENT_driver.common
    depends on MCUX_HAS_COMPONENT_driver.dpr
```

## mcux/mcux-sdk-ng/drivers/dpu/Kconfig
```kconfig
# Copyright 2024 NXP
#
# SPDX-License-Identifier: BSD-3-Clause

config MCUX_HAS_COMPONENT_driver.dpu
    bool
    default y if MCUX_HW_IP_DriverType_DPU

config MCUX_COMPONENT_driver.dpu
    bool "dpu"
    select MCUX_COMPONENT_driver.common
    depends on MCUX_HAS_COMPONENT_driver.dpu
```

## mcux/mcux-sdk-ng/drivers/dpu_irqsteer/Kconfig
```kconfig
# Copyright 2024 NXP
#
# SPDX-License-Identifier: BSD-3-Clause

config MCUX_HAS_COMPONENT_driver.dpu_irqsteer
    bool
    default y if MCUX_HW_IP_DriverType_DPU_IRQSTEER

config MCUX_COMPONENT_driver.dpu_irqsteer
    bool "dpu_irqsteer"
    select MCUX_COMPONENT_driver.common
    depends on MCUX_HAS_COMPONENT_driver.dpu_irqsteer
```

## mcux/mcux-sdk-ng/drivers/dryice/Kconfig
```kconfig
# Copyright 2024 NXP
#
# SPDX-License-Identifier: BSD-3-Clause

config MCUX_HAS_COMPONENT_driver.dryice
    bool
    default y if MCUX_HW_IP_DriverType_DRY

config MCUX_COMPONENT_driver.dryice
    bool "dryice"
    select MCUX_COMPONENT_driver.common
    depends on MCUX_HAS_COMPONENT_driver.dryice
```

## mcux/mcux-sdk-ng/drivers/dsc_cadc/Kconfig
```kconfig
# Copyright 2024 NXP
#
# SPDX-License-Identifier: BSD-3-Clause

config MCUX_HAS_COMPONENT_driver.dsc_cadc
    bool
    default y if MCUX_HW_IP_DriverType_DSC_CADC

config MCUX_COMPONENT_driver.dsc_cadc
    bool "dsc_cadc"
    select MCUX_COMPONENT_driver.common
    depends on MCUX_HAS_COMPONENT_driver.dsc_cadc
```

## mcux/mcux-sdk-ng/drivers/dsc_cmp/Kconfig
```kconfig
# Copyright 2024 NXP
#
# SPDX-License-Identifier: BSD-3-Clause

config MCUX_HAS_COMPONENT_driver.dsc_cmp
    bool
    default y if MCUX_HW_IP_DriverType_DSC_CMP

config MCUX_COMPONENT_driver.dsc_cmp
    bool "dsc_cmp"
    select MCUX_COMPONENT_driver.common
    depends on MCUX_HAS_COMPONENT_driver.dsc_cmp
```

## mcux/mcux-sdk-ng/drivers/dsc_cop/Kconfig
```kconfig
# Copyright 2024 NXP
#
# SPDX-License-Identifier: BSD-3-Clause

config MCUX_HAS_COMPONENT_driver.dsc_cop
    bool
    default y if MCUX_HW_IP_DriverType_DSC_COP

config MCUX_COMPONENT_driver.dsc_cop
    bool "dsc_cop"
    select MCUX_COMPONENT_driver.common
    depends on MCUX_HAS_COMPONENT_driver.dsc_cop
```

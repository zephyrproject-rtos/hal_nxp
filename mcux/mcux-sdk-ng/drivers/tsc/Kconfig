## mcux/mcux-sdk-ng/drivers/tsc/Kconfig
```kconfig
# Copyright 2024 NXP
#
# SPDX-License-Identifier: BSD-3-Clause

config MCUX_HAS_COMPONENT_driver.tsc
    bool
    default y if MCUX_HW_IP_DriverType_TSC

config MCUX_COMPONENT_driver.tsc
    bool "tsc"
    select MCUX_COMPONENT_driver.common
    depends on MCUX_HAS_COMPONENT_driver.tsc
```

## mcux/mcux-sdk-ng/drivers/tsens/Kconfig
```kconfig
# Copyright 2024 NXP
#
# SPDX-License-Identifier: BSD-3-Clause

config MCUX_HAS_COMPONENT_driver.tsens
    bool
    default y if MCUX_HW_IP_DriverType_TSEN

config MCUX_COMPONENT_driver.tsens
    bool "tsens"
    select MCUX_COMPONENT_driver.common
    depends on MCUX_HAS_COMPONENT_driver.tsens
```

## mcux/mcux-sdk-ng/drivers/tsi/Kconfig
```kconfig
# Copyright 2024 NXP
#
# SPDX-License-Identifier: BSD-3-Clause

rsource "./tsi_v6/Kconfig"
rsource "./tsi_v5/Kconfig"
rsource "./tsi_v4/Kconfig"
rsource "./tsi_v2/Kconfig"
```

## mcux/mcux-sdk-ng/drivers/tsi/tsi_v2/Kconfig
```kconfig
# Copyright 2024 NXP
#
# SPDX-License-Identifier: BSD-3-Clause

config MCUX_HAS_COMPONENT_driver.tsi_v2
    bool
    default y if MCUX_HW_IP_DriverType_TSI_V2

config MCUX_COMPONENT_driver.tsi_v2
    bool "tsi_v2"
    select MCUX_COMPONENT_driver.common
    depends on MCUX_HAS_COMPONENT_driver.tsi_v2
```

## mcux/mcux-sdk-ng/drivers/tsi/tsi_v6/Kconfig
```kconfig
# Copyright 2024 NXP
#
# SPDX-License-Identifier: BSD-3-Clause

config MCUX_HAS_COMPONENT_driver.tsi_v6
    bool
    default y if MCUX_HW_IP_DriverType_TSI_V6

config MCUX_COMPONENT_driver.tsi_v6
    bool "tsi_v6"
    select MCUX_COMPONENT_driver.common
    depends on MCUX_HAS_COMPONENT_driver.tsi_v6
```

## mcux/mcux-sdk-ng/drivers/tstmr/Kconfig
```kconfig
# Copyright 2024 NXP
#
# SPDX-License-Identifier: BSD-3-Clause

config MCUX_HAS_COMPONENT_driver.tstmr
    bool
    default y if MCUX_HW_IP_DriverType_TSTMR

config MCUX_COMPONENT_driver.tstmr
    bool "tstmr"
    select MCUX_COMPONENT_driver.common
    depends on MCUX_HAS_COMPONENT_driver.tstmr
```

## mcux/mcux-sdk-ng/drivers/uart/Kconfig
```kconfig
# Copyright 2024 NXP
#
# SPDX-License-Identifier: BSD-3-Clause

config MCUX_HAS_COMPONENT_driver.uart_dma
    bool
    default y if MCUX_HAS_COMPONENT_driver.uart && MCUX_HAS_COMPONENT_driver.dma

config MCUX_HAS_COMPONENT_driver.uart_edma
    bool
    default y if MCUX_HAS_COMPONENT_driver.uart && (MCUX_HAS_COMPONENT_driver.dma3 || MCUX_HAS_COMPONENT_driver.edma || MCUX_HAS_COMPONENT_driver.edma4)

config MCUX_HAS_COMPONENT_driver.uart
    bool
    default y if MCUX_HW_IP_DriverType_UART || MCUX_HW_IP_DriverType_UART_ISO7816

config MCUX_COMPONENT_driver.uart_dma
    bool "uart_dma"
    select MCUX_COMPONENT_driver.uart
    select MCUX_COMPONENT_driver.dma
    depends on MCUX_HAS_COMPONENT_driver.uart_dma

config MCUX_COMPONENT_driver.uart_edma
    bool "uart_edma"
    select MCUX_COMPONENT_driver.uart
    select MCUX_COMPONENT_driver.dma3 if MCUX_HAS_COMPONENT_driver.dma3
    select MCUX_COMPONENT_driver.edma if MCUX_HAS_COMPONENT_driver.edma
    select MCUX_COMPONENT_driver.edma4 if MCUX_HAS_COMPONENT_driver.edma4
    depends on MCUX_HAS_COMPONENT_driver.uart_edma

config MCUX_COMPONENT_driver.uart
    bool "uart"
    select MCUX_COMPONENT_driver.common
    depends on MCUX_HAS_COMPONENT_driver.uart
```

## mcux/mcux-sdk-ng/drivers/usdhc/Kconfig
```kconfig
# Copyright 2024 NXP
#
# SPDX-License-Identifier: BSD-3-Clause

config MCUX_HAS_COMPONENT_driver.usdhc
    bool
    default y if MCUX_HW_IP_DriverType_USDHC

config MCUX_COMPONENT_driver.usdhc
    bool "usdhc"
    select MCUX_COMPONENT_driver.common
    depends on MCUX_HAS_COMPONENT_driver.usdhc
```

## mcux/mcux-sdk-ng/drivers/vbat/Kconfig
```kconfig
# Copyright 2024 NXP
#
# SPDX-License-Identifier: BSD-3-Clause

config MCUX_HAS_COMPONENT_driver.vbat
    bool
    default y if MCUX_HW_IP_DriverType_VBAT

config MCUX_COMPONENT_driver.vbat
    bool "vbat"
    select MCUX_COMPONENT_driver.common
    depends on MCUX_HAS_COMPONENT_driver.vbat
```

## mcux/mcux-sdk-ng/drivers/vref/Kconfig
```kconfig
# Copyright 2024 NXP
#
# SPDX-License-Identifier: BSD-3-Clause

config MCUX_HAS_COMPONENT_driver.vref
    bool
    default y if MCUX_HW_IP_DriverType_VREF

config MCUX_COMPONENT_driver.vref
    bool "vref"
    select MCUX_COMPONENT_driver.common
    depends on MCUX_HAS_COMPONENT_driver.vref
```

## mcux/mcux-sdk-ng/drivers/wdog/Kconfig
```kconfig
# Copyright 2024 NXP
#
# SPDX-License-Identifier: BSD-3-Clause

config MCUX_HAS_COMPONENT_driver.wdog
    bool
    default y if MCUX_HW_IP_DriverType_WDOG

config MCUX_COMPONENT_driver.wdog
    bool "wdog"
    select MCUX_COMPONENT_driver.common
    depends on MCUX_HAS_COMPONENT_driver.wdog
```

## mcux/mcux-sdk-ng/drivers/wdog32/Kconfig
```kconfig
# Copyright 2024 NXP
#
# SPDX-License-Identifier: BSD-3-Clause

config MCUX_HAS_COMPONENT_driver.wdog32
    bool
    default y if MCUX_HW_IP_DriverType_WDOG32

config MCUX_COMPONENT_driver.wdog32
    bool "wdog32"
    select MCUX_COMPONENT_driver.common
    depends on MCUX_HAS_COMPONENT_driver.wdog32
```

## mcux/mcux-sdk-ng/drivers/wdog8/Kconfig
```kconfig
# Copyright 2024 NXP
#
# SPDX-License-Identifier: BSD-3-Clause

config MCUX_HAS_COMPONENT_driver.wdog8
    bool
    default y if MCUX_HW_IP_DriverType_WDOG8

config MCUX_COMPONENT_driver.wdog8
    bool "wdog8"
    select MCUX_COMPONENT_driver.common
    depends on MCUX_HAS_COMPONENT_driver.wdog8
```

## mcux/mcux-sdk-ng/drivers/wdt/Kconfig
```kconfig
# Copyright 2024 NXP
#
# SPDX-License-Identifier: BSD-3-Clause

config MCUX_HAS_COMPONENT_driver.wdt
    bool
    default y if MCUX_HW_IP_DriverType_WDT

config MCUX_COMPONENT_driver.wdt
    bool "wdt"
    select MCUX_COMPONENT_driver.common
    depends on MCUX_HAS_COMPONENT_driver.wdt
```

## mcux/mcux-sdk-ng/drivers/wkt/Kconfig
```kconfig
# Copyright 2024 NXP
#
# SPDX-License-Identifier: BSD-3-Clause

config MCUX_HAS_COMPONENT_driver.wkt
    bool
    default y if MCUX_HW_IP_DriverType_WKT

config MCUX_COMPONENT_driver.wkt
    bool "wkt"
    select MCUX_COMPONENT_driver.common
    depends on MCUX_HAS_COMPONENT_driver.wkt
```

## mcux/mcux-sdk-ng/drivers/wuu/Kconfig
```kconfig
# Copyright 2024 NXP
#
# SPDX-License-Identifier: BSD-3-Clause

config MCUX_HAS_COMPONENT_driver.wuu
    bool
    default y if MCUX_HW_IP_DriverType_WUU

config MCUX_COMPONENT_driver.wuu
    bool "wuu"
    select MCUX_COMPONENT_driver.common
    depends on MCUX_HAS_COMPONENT_driver.wuu
```

## mcux/mcux-sdk-ng/drivers/wwdt/Kconfig
```kconfig
# Copyright 2024 NXP
#
# SPDX-License-Identifier: BSD-3-Clause

config MCUX_HAS_COMPONENT_driver.wwdt
    bool
    default y if MCUX_HW_IP_DriverType_WWDT

config MCUX_COMPONENT_driver.wwdt
    bool "wwdt"
    select MCUX_COMPONENT_driver.common
    depends on MCUX_HAS_COMPONENT_driver.wwdt
```

## mcux/mcux-sdk-ng/drivers/xbar/Kconfig
```kconfig
# Copyright 2024 NXP
#
# SPDX-License-Identifier: BSD-3-Clause

config MCUX_HAS_COMPONENT_driver.xbar
    bool
    default y if MCUX_HW_IP_DriverType_XBAR

config MCUX_COMPONENT_driver.xbar
    bool "xbar"
    select MCUX_COMPONENT_driver.common
    depends on MCUX_HAS_COMPONENT_driver.xbar
```

## mcux/mcux-sdk-ng/drivers/xbar_1/Kconfig
```kconfig
# Copyright 2024 NXP
#
# SPDX-License-Identifier: BSD-3-Clause

config MCUX_HAS_COMPONENT_driver.xbar_1
    bool
    default y if MCUX_HW_IP_DriverType_XBAR_DSC

config MCUX_COMPONENT_driver.xbar_1
    bool "xbar_1"
    select MCUX_COMPONENT_driver.common
    depends on MCUX_HAS_COMPONENT_driver.xbar_1
```

## mcux/mcux-sdk-ng/drivers/xbarb/Kconfig
```kconfig
# Copyright 2024 NXP
#
# SPDX-License-Identifier: BSD-3-Clause

config MCUX_HAS_COMPONENT_driver.xbarb
    bool
    default y if MCUX_HW_IP_DriverType_XBARB

config MCUX_COMPONENT_driver.xbarb
    bool "xbarb"
    select MCUX_COMPONENT_driver.common
    depends on MCUX_HAS_COMPONENT_driver.xbarb
```

## mcux/mcux-sdk-ng/drivers/xrdc/Kconfig
```kconfig
# Copyright 2024 NXP
#
# SPDX-License-Identifier: BSD-3-Clause

config MCUX_HAS_COMPONENT_driver.xrdc
    bool
    default y if MCUX_HW_IP_DriverType_XRDC

config MCUX_COMPONENT_driver.xrdc
    bool "xrdc"
    select MCUX_COMPONENT_driver.common
    depends on MCUX_HAS_COMPONENT_driver.xrdc
```

## mcux/mcux-sdk-ng/drivers/xspi/Kconfig
```kconfig
# Copyright 2024 NXP
#
# SPDX-License-Identifier: BSD-3-Clause

config MCUX_HAS_COMPONENT_driver.xspi_edma
    bool
    default y if MCUX_HAS_COMPONENT_driver.xspi && (MCUX_HAS_COMPONENT_driver.dma3 || MCUX_HAS_COMPONENT_driver.edma || MCUX_HAS_COMPONENT_driver.edma4)

config MCUX_HAS_COMPONENT_driver.xspi
    bool
    default y if MCUX_HW_IP_DriverType_XSPI

config MCUX_COMPONENT_driver.xspi_edma
    bool "xspi_edma"
    select MCUX_COMPONENT_driver.xspi
    select MCUX_COMPONENT_driver.dma3 if MCUX_HAS_COMPONENT_driver.dma3
    select MCUX_COMPONENT_driver.edma if MCUX_HAS_COMPONENT_driver.edma
    select MCUX_COMPONENT_driver.edma4 if MCUX_HAS_COMPONENT_driver.edma4
    depends on MCUX_HAS_COMPONENT_driver.xspi_edma

config MCUX_COMPONENT_driver.xspi
    bool "xspi"
    select MCUX_COMPONENT_driver.common
    depends on MCUX_HAS_COMPONENT_driver.xspi
```

## mcux/mcux-sdk-ng/drivers/semc/Kconfig
```kconfig
# Copyright 2024 NXP
#
# SPDX-License-Identifier: BSD-3-Clause

config MCUX_HAS_COMPONENT_driver.semc
    bool
    default y if MCUX_HW_IP_DriverType_SEMC

config MCUX_COMPONENT_driver.semc
    bool "semc"
    select MCUX_COMPONENT_driver.common
    depends on MCUX_HAS_COMPONENT_driver.semc
```

## mcux/mcux-sdk-ng/drivers/sha/Kconfig
```kconfig
# Copyright 2024 NXP
#
# SPDX-License-Identifier: BSD-3-Clause

config MCUX_HAS_COMPONENT_driver.sha
    bool
    default y if MCUX_HW_IP_DriverType_SHA

config MCUX_COMPONENT_driver.sha
    bool "sha"
    select MCUX_COMPONENT_driver.common
    depends on MCUX_HAS_COMPONENT_driver.sha
```

## mcux/mcux-sdk-ng/drivers/slcd/Kconfig
```kconfig
# Copyright 2024 NXP
#
# SPDX-License-Identifier: BSD-3-Clause

config MCUX_HAS_COMPONENT_driver.slcd
    bool
    default y if MCUX_HW_IP_DriverType_SLCD

config MCUX_COMPONENT_driver.slcd
    bool "slcd"
    select MCUX_COMPONENT_driver.common
    depends on MCUX_HAS_COMPONENT_driver.slcd
```

## mcux/mcux-sdk-ng/drivers/smartcard/Kconfig
```kconfig
# Copyright 2024 NXP
#
# SPDX-License-Identifier: BSD-3-Clause

config MCUX_HAS_COMPONENT_driver.smartcard_emvsim
    bool
    default y if MCUX_HW_IP_DriverType_EMVSIM

config MCUX_HAS_COMPONENT_driver.smartcard_phy_emvsim
    bool
    default y if MCUX_HW_IP_DriverType_EMVSIM

config MCUX_HAS_COMPONENT_driver.smartcard_phy_gpio
    bool
    default y if (MCUX_HW_IP_DriverType_TPM || MCUX_HW_IP_DriverType_FTM) && MCUX_HW_IP_DriverType_GPIO && MCUX_HAS_COMPONENT_driver.smartcard_uart

config MCUX_HAS_COMPONENT_driver.smartcard_phy_tda8035
    bool
    default y if (MCUX_HAS_COMPONENT_driver.smartcard_uart && MCUX_HW_IP_DriverType_FTM && MCUX_HW_IP_DriverType_GPIO) || MCUX_HAS_COMPONENT_driver.smartcard_emvsim

config MCUX_HAS_COMPONENT_driver.smartcard_phy_usim
    bool
    default y if MCUX_HW_IP_DriverType_USIM

config MCUX_HAS_COMPONENT_driver.smartcard_uart
    bool
    default y if (MCUX_HW_IP_DriverType_UART_ISO7816 && MCUX_HW_IP_DriverType_PIT)

config MCUX_HAS_COMPONENT_driver.smartcard_usim
    bool
    default y if MCUX_HW_IP_DriverType_USIM

config MCUX_COMPONENT_driver.smartcard_emvsim
    bool "smartcard_emvsim"
    select MCUX_COMPONENT_driver.common
    depends on MCUX_HAS_COMPONENT_driver.smartcard_emvsim

config MCUX_COMPONENT_driver.smartcard_phy_emvsim
    bool "smartcard_phy_emvsim"
    select MCUX_COMPONENT_driver.smartcard_emvsim
    select MCUX_COMPONENT_driver.common
    depends on MCUX_HAS_COMPONENT_driver.smartcard_phy_emvsim

config MCUX_COMPONENT_driver.smartcard_phy_gpio
    bool "smartcard_phy_gpio"
    select MCUX_COMPONENT_driver.smartcard_uart
    select MCUX_COMPONENT_driver.common
    depends on MCUX_HAS_COMPONENT_driver.smartcard_phy_gpio

config MCUX_COMPONENT_driver.smartcard_phy_tda8035
    bool "smartcard_phy_tda8035"
    select MCUX_COMPONENT_driver.common
    depends on MCUX_HAS_COMPONENT_driver.smartcard_phy_tda8035

config MCUX_COMPONENT_driver.smartcard_phy_usim
    bool "smartcard_phy_usim"
    select MCUX_COMPONENT_driver.smartcard_usim
    select MCUX_COMPONENT_driver.common
    depends on MCUX_HAS_COMPONENT_driver.smartcard_phy_usim

config MCUX_COMPONENT_driver.smartcard_uart
    bool "smartcard_uart"
    select MCUX_COMPONENT_driver.common
    depends on MCUX_HAS_COMPONENT_driver.smartcard_uart

config MCUX_COMPONENT_driver.smartcard_usim
    bool "smartcard_usim"
    select MCUX_COMPONENT_driver.common
    depends on MCUX_HAS_COMPONENT_driver.smartcard_usim
```

## mcux/mcux-sdk-ng/drivers/smc/Kconfig
```kconfig
# Copyright 2024 NXP
#
# SPDX-License-Identifier: BSD-3-Clause

config MCUX_HAS_COMPONENT_driver.smc
    bool
    default y if MCUX_HW_IP_DriverType_SMC

config MCUX_COMPONENT_driver.smc
    bool "smc"
    select MCUX_COMPONENT_driver.common
    depends on MCUX_HAS_COMPONENT_driver.smc
```

## mcux/mcux-sdk-ng/drivers/snvs_hp/Kconfig
```kconfig
# Copyright 2024 NXP
#
# SPDX-License-Identifier: BSD-3-Clause

config MCUX_HAS_COMPONENT_driver.snvs_hp
    bool
    default y if MCUX_HW_IP_DriverType_SNVS

config MCUX_COMPONENT_driver.snvs_hp
    bool "snvs_hp"
    select MCUX_COMPONENT_driver.common
    depends on MCUX_HAS_COMPONENT_driver.snvs_hp
```

## mcux/mcux-sdk-ng/drivers/snvs_lp/Kconfig
```kconfig
# Copyright 2024 NXP
#
# SPDX-License-Identifier: BSD-3-Clause

config MCUX_HAS_COMPONENT_driver.snvs_lp
    bool
    default y if MCUX_HW_IP_DriverType_SNVS

config MCUX_COMPONENT_driver.snvs_lp
    bool "snvs_lp"
    select MCUX_COMPONENT_driver.common
    depends on MCUX_HAS_COMPONENT_driver.snvs_lp
```

## mcux/mcux-sdk-ng/drivers/software_i2s/Kconfig
```kconfig
# Copyright 2024 NXP
#
# SPDX-License-Identifier: BSD-3-Clause

config MCUX_COMPONENT_driver.software_i2s
    bool "software_i2s"
    select MCUX_COMPONENT_driver.flexcomm_spi
    select MCUX_COMPONENT_driver.sctimer
    depends on MCUX_HAS_COMPONENT_driver.flexcomm_spi && MCUX_HAS_COMPONENT_driver.sctimer
```

## mcux/mcux-sdk-ng/drivers/spdif/Kconfig
```kconfig
# Copyright 2024 NXP
#
# SPDX-License-Identifier: BSD-3-Clause

config MCUX_HAS_COMPONENT_driver.spdif
    bool
    default y if MCUX_HW_IP_DriverType_SPDIF

config MCUX_COMPONENT_driver.spdif_edma
    bool "spdif_edma"
    select MCUX_COMPONENT_driver.spdif

config MCUX_COMPONENT_driver.spdif
    bool "spdif"
    select MCUX_COMPONENT_driver.common
    depends on MCUX_HAS_COMPONENT_driver.spdif
```

## mcux/mcux-sdk-ng/drivers/spi/Kconfig
```kconfig
# Copyright 2024 NXP
#
# SPDX-License-Identifier: BSD-3-Clause

config MCUX_HAS_COMPONENT_driver.spi_dma
    bool
    default y if MCUX_HAS_COMPONENT_driver.spi && MCUX_HAS_COMPONENT_driver.dma

config MCUX_HAS_COMPONENT_driver.spi
    bool
    default y if MCUX_HW_IP_DriverType_SPI

config MCUX_COMPONENT_driver.spi_dma
    bool "spi_dma"
    select MCUX_COMPONENT_driver.spi
    select MCUX_COMPONENT_driver.dma
    depends on MCUX_HAS_COMPONENT_driver.spi_dma

config MCUX_COMPONENT_driver.spi
    bool "spi"
    select MCUX_COMPONENT_driver.common
    depends on MCUX_HAS_COMPONENT_driver.spi
```

## mcux/mcux-sdk-ng/drivers/spifi/Kconfig
```kconfig
# Copyright 2024 NXP
#
# SPDX-License-Identifier: BSD-3-Clause

config MCUX_HAS_COMPONENT_driver.spifi_dma
    bool
    default y if MCUX_HAS_COMPONENT_driver.spifi && MCUX_HAS_COMPONENT_driver.lpc_dma

config MCUX_HAS_COMPONENT_driver.spifi
    bool
    default y if MCUX_HW_IP_DriverType_SPIFI

config MCUX_COMPONENT_driver.spifi_dma
    bool "spifi_dma"
    select MCUX_COMPONENT_driver.spifi
    select MCUX_COMPONENT_driver.lpc_dma
    depends on MCUX_HAS_COMPONENT_driver.spifi_dma

config MCUX_COMPONENT_driver.spifi
    bool "spifi"
    select MCUX_COMPONENT_driver.common
    depends on MCUX_HAS_COMPONENT_driver.spifi
```

## mcux/mcux-sdk-ng/drivers/spm/Kconfig
```kconfig
# Copyright 2024 NXP
#
# SPDX-License-Identifier: BSD-3-Clause

config MCUX_HAS_COMPONENT_driver.spm
    bool
    default y if MCUX_HW_IP_DriverType_SPM

config MCUX_COMPONENT_driver.spm
    bool "spm"
    select MCUX_COMPONENT_driver.common
    depends on MCUX_HAS_COMPONENT_driver.spm
```

## mcux/mcux-sdk-ng/drivers/src1/Kconfig
```kconfig
# Copyright 2024 NXP
#
# SPDX-License-Identifier: BSD-3-Clause

config MCUX_HAS_COMPONENT_driver.src1
    bool
    default y if MCUX_HW_IP_DriverType_SRC_1

config MCUX_COMPONENT_driver.src1
    bool "src1"
    select MCUX_COMPONENT_driver.common
    depends on MCUX_HAS_COMPONENT_driver.src1
```

## mcux/mcux-sdk-ng/drivers/ssarc/Kconfig
```kconfig
# Copyright 2024 NXP
#
# SPDX-License-Identifier: BSD-3-Clause

config MCUX_HAS_COMPONENT_driver.ssarc
    bool
    default y if MCUX_HW_IP_DriverType_SSARC_HP || MCUX_HW_IP_DriverType_SSARC_LP

config MCUX_COMPONENT_driver.ssarc
    bool "ssarc"
    select MCUX_COMPONENT_driver.common
    depends on MCUX_HAS_COMPONENT_driver.ssarc
```

## mcux/mcux-sdk-ng/drivers/swm/Kconfig
```kconfig
# Copyright 2024 NXP
#
# SPDX-License-Identifier: BSD-3-Clause

config MCUX_HAS_COMPONENT_driver.swm
    bool
    default y if MCUX_HW_IP_DriverType_SWM

config MCUX_COMPONENT_driver.swm
    bool "swm"
    select MCUX_COMPONENT_driver.common
    select MCUX_COMPONENT_driver.swm_connections
    depends on MCUX_HAS_COMPONENT_driver.swm
```

## mcux/mcux-sdk-ng/drivers/syscon/Kconfig
```kconfig
# Copyright 2024 NXP
#
# SPDX-License-Identifier: BSD-3-Clause

config MCUX_HAS_COMPONENT_driver.syscon
    bool
    default y if MCUX_HW_IP_DriverType_SYSCON

config MCUX_COMPONENT_driver.syscon
    bool "syscon"
    select MCUX_COMPONENT_driver.common
    select MCUX_COMPONENT_driver.syscon_connections
    depends on MCUX_HAS_COMPONENT_driver.syscon
```

## mcux/mcux-sdk-ng/drivers/sysmpu/Kconfig
```kconfig
# Copyright 2024 NXP
#
# SPDX-License-Identifier: BSD-3-Clause

config MCUX_HAS_COMPONENT_driver.sysmpu
    bool
    default y if MCUX_HW_IP_DriverType_SYSMPU

config MCUX_COMPONENT_driver.sysmpu
    bool "sysmpu"
    select MCUX_COMPONENT_driver.common
    depends on MCUX_HAS_COMPONENT_driver.sysmpu
```

## mcux/mcux-sdk-ng/drivers/syspm/Kconfig
```kconfig
# Copyright 2024 NXP
#
# SPDX-License-Identifier: BSD-3-Clause

config MCUX_HAS_COMPONENT_driver.syspm
    bool
    default y if MCUX_HW_IP_DriverType_SYSPM

config MCUX_COMPONENT_driver.syspm
    bool "syspm"
    select MCUX_COMPONENT_driver.common
    depends on MCUX_HAS_COMPONENT_driver.syspm
```

## mcux/mcux-sdk-ng/drivers/tempmon/Kconfig
```kconfig
# Copyright 2024 NXP
#
# SPDX-License-Identifier: BSD-3-Clause

config MCUX_HAS_COMPONENT_driver.tempmon
    bool
    default y if MCUX_HW_IP_DriverType_TEMPMON

config MCUX_COMPONENT_driver.tempmon
    bool "tempmon"
    select MCUX_COMPONENT_driver.common
    depends on MCUX_HAS_COMPONENT_driver.tempmon
```

## mcux/mcux-sdk-ng/drivers/tempsensor/Kconfig
```kconfig
# Copyright 2024 NXP
#
# SPDX-License-Identifier: BSD-3-Clause

config MCUX_HAS_COMPONENT_driver.tempsensor
    bool
    default y if MCUX_HW_IP_DriverType_TMPSNS

config MCUX_COMPONENT_driver.tempsensor
    bool "tempsensor"
    select MCUX_COMPONENT_driver.common
    depends on MCUX_HAS_COMPONENT_driver.tempsensor
```

## mcux/mcux-sdk-ng/drivers/tmu_1/Kconfig
```kconfig
# Copyright 2024 NXP
#
# SPDX-License-Identifier: BSD-3-Clause

config MCUX_HAS_COMPONENT_driver.tmu_1
    bool
    default y if MCUX_HW_IP_DriverType_TMU_1

config MCUX_COMPONENT_driver.tmu_1
    bool "tmu_1"
    select MCUX_COMPONENT_driver.common
    depends on MCUX_HAS_COMPONENT_driver.tmu_1
```

## mcux/mcux-sdk-ng/drivers/tmu_2/Kconfig
```kconfig
# Copyright 2024 NXP
#
# SPDX-License-Identifier: BSD-3-Clause

config MCUX_HAS_COMPONENT_driver.tmu_2
    bool
    default y if MCUX_HW_IP_DriverType_TMU_2

config MCUX_COMPONENT_driver.tmu_2
    bool "tmu_2"
    select MCUX_COMPONENT_driver.common
    depends on MCUX_HAS_COMPONENT_driver.tmu_2
```

## mcux/mcux-sdk-ng/drivers/tmu_3/Kconfig
```kconfig
# Copyright 2024 NXP
#
# SPDX-License-Identifier: BSD-3-Clause

config MCUX_HAS_COMPONENT_driver.tmu_3
    bool
    default y if MCUX_HW_IP_DriverType_TMU_3

config MCUX_COMPONENT_driver.tmu_3
    bool "tmu_3"
    select MCUX_COMPONENT_driver.common
    depends on MCUX_HAS_COMPONENT_driver.tmu_3
```

## mcux/mcux-sdk-ng/drivers/tpm/Kconfig
```kconfig
# Copyright 2024 NXP
#
# SPDX-License-Identifier: BSD-3-Clause

config MCUX_HAS_COMPONENT_driver.tpm
    bool
    default y if MCUX_HW_IP_DriverType_TPM

config MCUX_COMPONENT_driver.tpm
    bool "tpm"
    select MCUX_COMPONENT_driver.common
    depends on MCUX_HAS_COMPONENT_driver.tpm
```

## mcux/mcux-sdk-ng/drivers/trng/Kconfig
```kconfig
# Copyright 2024 NXP
#
# SPDX-License-Identifier: BSD-3-Clause

config MCUX_HAS_COMPONENT_driver.trng
    bool
    default y if MCUX_HW_IP_DriverType_TRNG

config MCUX_COMPONENT_driver.trng
    bool "trng"
    select MCUX_COMPONENT_driver.common
    depends on MCUX_HAS_COMPONENT_driver.trng
```

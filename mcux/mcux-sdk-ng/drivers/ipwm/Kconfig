## mcux/mcux-sdk-ng/drivers/ipwm/Kconfig
```kconfig
# Copyright 2024 NXP
#
# SPDX-License-Identifier: BSD-3-Clause

config MCUX_HAS_COMPONENT_driver.ipwm
    bool
    default y if MCUX_HW_IP_DriverType_IPWM

config MCUX_COMPONENT_driver.ipwm
    bool "ipwm"
    depends on MCUX_HAS_COMPONENT_driver.ipwm
```

## mcux/mcux-sdk-ng/drivers/irqsteer/Kconfig
```kconfig
# Copyright 2024 NXP
#
# SPDX-License-Identifier: BSD-3-Clause

config MCUX_HAS_COMPONENT_driver.irqsteer
    bool
    default y if MCUX_HW_IP_DriverType_IRQSTEER

config MCUX_COMPONENT_driver.irqsteer
    bool "irqsteer"
    select MCUX_COMPONENT_driver.common
    depends on MCUX_HAS_COMPONENT_driver.irqsteer
```

## mcux/mcux-sdk-ng/drivers/irqsteer_1/Kconfig
```kconfig
# Copyright 2024 NXP
#
# SPDX-License-Identifier: BSD-3-Clause

config MCUX_HAS_COMPONENT_driver.irqsteer_1
    bool
    default y if MCUX_HW_IP_DriverType_IRQSTEER_1

config MCUX_COMPONENT_driver.irqsteer_1
    bool "irqsteer_1"
    select MCUX_COMPONENT_driver.common
    imply MCUX_COMPONENT_driver.irqsteer_1_soc
    depends on MCUX_HAS_COMPONENT_driver.irqsteer_1
```

## mcux/mcux-sdk-ng/drivers/irtc/Kconfig
```kconfig
# Copyright 2024 NXP
#
# SPDX-License-Identifier: BSD-3-Clause

config MCUX_HAS_COMPONENT_driver.irtc
    bool
    default y if MCUX_HW_IP_DriverType_RTC_V2

config MCUX_COMPONENT_driver.irtc
    bool "irtc"
    select MCUX_COMPONENT_driver.common
    depends on MCUX_HAS_COMPONENT_driver.irtc
```

## mcux/mcux-sdk-ng/drivers/isi/Kconfig
```kconfig
# Copyright 2024 NXP
#
# SPDX-License-Identifier: BSD-3-Clause

config MCUX_HAS_COMPONENT_driver.isi
    bool
    default y if MCUX_HW_IP_DriverType_ISI

config MCUX_COMPONENT_driver.isi
    bool "isi"
    select MCUX_COMPONENT_driver.common
    depends on MCUX_HAS_COMPONENT_driver.isi
```

## mcux/mcux-sdk-ng/drivers/itrc_1/Kconfig
```kconfig
# Copyright 2024 NXP
#
# SPDX-License-Identifier: BSD-3-Clause

config MCUX_HAS_COMPONENT_driver.itrc_1
    bool
    default y if MCUX_HW_IP_DriverType_RW_ITRC

config MCUX_COMPONENT_driver.itrc_1
    bool "itrc_1"
    select MCUX_COMPONENT_driver.common
    depends on MCUX_HAS_COMPONENT_driver.itrc_1
```

## mcux/mcux-sdk-ng/drivers/iuart/Kconfig
```kconfig
# Copyright 2024 NXP
#
# SPDX-License-Identifier: BSD-3-Clause

config MCUX_HAS_COMPONENT_driver.iuart_sdma
    bool
    default y if MCUX_HAS_COMPONENT_driver.iuart && MCUX_HAS_COMPONENT_driver.sdma

config MCUX_HAS_COMPONENT_driver.iuart
    bool
    default y if MCUX_HW_IP_DriverType_IUART

config MCUX_COMPONENT_driver.iuart_sdma
    bool "iuart_sdma"
    select MCUX_COMPONENT_driver.iuart
    select MCUX_COMPONENT_driver.sdma
    depends on MCUX_HAS_COMPONENT_driver.iuart_sdma

config MCUX_COMPONENT_driver.iuart
    bool "iuart"
    depends on MCUX_HAS_COMPONENT_driver.iuart
```

## mcux/mcux-sdk-ng/drivers/jn_cmp/Kconfig
```kconfig
# Copyright 2024 NXP
#
# SPDX-License-Identifier: BSD-3-Clause

config MCUX_HAS_COMPONENT_driver.jn_cmp
    bool
    default y if MCUX_HW_IP_DriverType_JN_CMP

config MCUX_COMPONENT_driver.jn_cmp
    bool "jn_cmp"
    select MCUX_COMPONENT_driver.common
    depends on MCUX_HAS_COMPONENT_driver.jn_cmp
```

## mcux/mcux-sdk-ng/drivers/jn_flash/Kconfig
```kconfig
# Copyright 2024 NXP
#
# SPDX-License-Identifier: BSD-3-Clause

config MCUX_HAS_COMPONENT_driver.jn_flash
    bool
    default y if MCUX_HW_IP_DriverType_JN_FLASH

config MCUX_COMPONENT_driver.jn_flash
    bool "jn_flash"
    select MCUX_COMPONENT_driver.common
    depends on MCUX_HAS_COMPONENT_driver.jn_flash
```

## mcux/mcux-sdk-ng/drivers/jn_pwm/Kconfig
```kconfig
# Copyright 2024 NXP
#
# SPDX-License-Identifier: BSD-3-Clause

config MCUX_HAS_COMPONENT_driver.jn_pwm
    bool
    default y if MCUX_HW_IP_DriverType_JN_PWM

config MCUX_COMPONENT_driver.jn_pwm
    bool "jn_pwm"
    select MCUX_COMPONENT_driver.common
    depends on MCUX_HAS_COMPONENT_driver.jn_pwm
```

## mcux/mcux-sdk-ng/drivers/jn_rng/Kconfig
```kconfig
# Copyright 2024 NXP
#
# SPDX-License-Identifier: BSD-3-Clause

config MCUX_HAS_COMPONENT_driver.jn_rng
    bool
    default y if MCUX_HW_IP_DriverType_JN_RNG

config MCUX_COMPONENT_driver.jn_rng
    bool "jn_rng"
    select MCUX_COMPONENT_driver.common
    depends on MCUX_HAS_COMPONENT_driver.jn_rng
```

## mcux/mcux-sdk-ng/drivers/jpegdec/Kconfig
```kconfig
# Copyright 2024 NXP
#
# SPDX-License-Identifier: BSD-3-Clause

config MCUX_HAS_COMPONENT_driver.jpegdec
    bool
    default y if MCUX_HW_IP_DriverType_JPEGDEC

config MCUX_COMPONENT_driver.jpegdec
    bool "jpegdec"
    select MCUX_COMPONENT_driver.common
    depends on MCUX_HAS_COMPONENT_driver.jpegdec
```

## mcux/mcux-sdk-ng/drivers/key_manager/Kconfig
```kconfig
# Copyright 2024 NXP
#
# SPDX-License-Identifier: BSD-3-Clause

config MCUX_HAS_COMPONENT_driver.key_manager
    bool
    default y if MCUX_HW_IP_DriverType_KEY_MANAGER

config MCUX_COMPONENT_driver.key_manager
    bool "key_manager"
    select MCUX_COMPONENT_driver.common
    depends on MCUX_HAS_COMPONENT_driver.key_manager
```

## mcux/mcux-sdk-ng/drivers/kpp/Kconfig
```kconfig
# Copyright 2024 NXP
#
# SPDX-License-Identifier: BSD-3-Clause

config MCUX_HAS_COMPONENT_driver.kpp
    bool
    default y if MCUX_HW_IP_DriverType_KPP

config MCUX_COMPONENT_driver.kpp
    bool "kpp"
    select MCUX_COMPONENT_driver.common
    depends on MCUX_HAS_COMPONENT_driver.kpp
```

## mcux/mcux-sdk-ng/drivers/lcdic/Kconfig
```kconfig
# Copyright 2024 NXP
#
# SPDX-License-Identifier: BSD-3-Clause

config MCUX_HAS_COMPONENT_driver.lcdic_dma
    bool
    default y if MCUX_HAS_COMPONENT_driver.lcdic && MCUX_HAS_COMPONENT_driver.lpc_dma

config MCUX_HAS_COMPONENT_driver.lcdic
    bool
    default y if MCUX_HW_IP_DriverType_LCDIC

config MCUX_COMPONENT_driver.lcdic_dma
    bool "lcdic_dma"
    select MCUX_COMPONENT_driver.lcdic
    select MCUX_COMPONENT_driver.lpc_dma
    depends on MCUX_HAS_COMPONENT_driver.lcdic_dma

config MCUX_COMPONENT_driver.lcdic
    bool "lcdic"
    select MCUX_COMPONENT_driver.common
    depends on MCUX_HAS_COMPONENT_driver.lcdic
```

## mcux/mcux-sdk-ng/drivers/lcdif/Kconfig
```kconfig
# Copyright 2024 NXP
#
# SPDX-License-Identifier: BSD-3-Clause

config MCUX_HAS_COMPONENT_driver.lcdif
    bool
    default y if MCUX_HW_IP_DriverType_LCDIF

config MCUX_COMPONENT_driver.lcdif
    bool "lcdif"
    select MCUX_COMPONENT_driver.common
    depends on MCUX_HAS_COMPONENT_driver.lcdif
```

## mcux/mcux-sdk-ng/drivers/lin/Kconfig
```kconfig
# Copyright 2024 NXP
#
# SPDX-License-Identifier: BSD-3-Clause

config MCUX_HAS_COMPONENT_driver.lin_stack
    bool
    default y if MCUX_HW_IP_DriverType_LPUART

config MCUX_HAS_COMPONENT_driver.lin
    bool
    default y if MCUX_HW_IP_DriverType_LPUART

config MCUX_COMPONENT_driver.lin_stack
    bool "lin_stack"
    select MCUX_COMPONENT_driver.common
    depends on MCUX_HAS_COMPONENT_driver.lin_stack

config MCUX_COMPONENT_driver.lin
    bool "lin"
    select MCUX_COMPONENT_driver.common
    depends on MCUX_HAS_COMPONENT_driver.lin
```

## mcux/mcux-sdk-ng/drivers/llwu/Kconfig
```kconfig
# Copyright 2024 NXP
#
# SPDX-License-Identifier: BSD-3-Clause

config MCUX_HAS_COMPONENT_driver.llwu
    bool
    default y if MCUX_HW_IP_DriverType_LLWU

config MCUX_COMPONENT_driver.llwu
    bool "llwu"
    select MCUX_COMPONENT_driver.common
    depends on MCUX_HAS_COMPONENT_driver.llwu
```

## mcux/mcux-sdk-ng/drivers/lpadc/Kconfig
```kconfig
# Copyright 2024 NXP
#
# SPDX-License-Identifier: BSD-3-Clause

config MCUX_HAS_COMPONENT_driver.lpadc
    bool
    default y if MCUX_HW_IP_DriverType_LPADC

config MCUX_COMPONENT_driver.lpadc
    bool "lpadc"
    select MCUX_COMPONENT_driver.common
    depends on MCUX_HAS_COMPONENT_driver.lpadc
```

## mcux/mcux-sdk-ng/drivers/lpc_acomp/Kconfig
```kconfig
# Copyright 2024 NXP
#
# SPDX-License-Identifier: BSD-3-Clause

config MCUX_HAS_COMPONENT_driver.lpc_acomp
    bool
    default y if MCUX_HW_IP_DriverType_ACOMP

config MCUX_COMPONENT_driver.lpc_acomp
    bool "lpc_acomp"
    select MCUX_COMPONENT_driver.common
    depends on MCUX_HAS_COMPONENT_driver.lpc_acomp
```

## mcux/mcux-sdk-ng/drivers/lpc_crc/Kconfig
```kconfig
# Copyright 2024 NXP
#
# SPDX-License-Identifier: BSD-3-Clause

config MCUX_HAS_COMPONENT_driver.lpc_crc
    bool
    default y if MCUX_HW_IP_DriverType_MCO_CRC

config MCUX_COMPONENT_driver.lpc_crc
    bool "lpc_crc"
    select MCUX_COMPONENT_driver.common
    depends on MCUX_HAS_COMPONENT_driver.lpc_crc
```

## mcux/mcux-sdk-ng/drivers/lpc_dac/Kconfig
```kconfig
# Copyright 2024 NXP
#
# SPDX-License-Identifier: BSD-3-Clause

config MCUX_HAS_COMPONENT_driver.lpc_dac
    bool
    default y if MCUX_HW_IP_DriverType_DAC10

config MCUX_COMPONENT_driver.lpc_dac
    bool "lpc_dac"
    select MCUX_COMPONENT_driver.common
    depends on MCUX_HAS_COMPONENT_driver.lpc_dac
```

## mcux/mcux-sdk-ng/drivers/lpc_enet/Kconfig
```kconfig
# Copyright 2024 NXP
#
# SPDX-License-Identifier: BSD-3-Clause

config MCUX_HAS_COMPONENT_driver.lpc_enet
    bool
    default y if MCUX_HW_IP_DriverType_LPC_ENET

config MCUX_COMPONENT_driver.lpc_enet
    bool "lpc_enet"
    select MCUX_COMPONENT_driver.common
    depends on MCUX_HAS_COMPONENT_driver.lpc_enet
```

## mcux/mcux-sdk-ng/drivers/lpc_freqme/Kconfig
```kconfig
# Copyright 2024 NXP
#
# SPDX-License-Identifier: BSD-3-Clause

config MCUX_HAS_COMPONENT_driver.lpc_freqme
    bool
    default y if MCUX_HW_IP_DriverType_FREQME

config MCUX_COMPONENT_driver.lpc_freqme
    bool "lpc_freqme"
    select MCUX_COMPONENT_driver.common
    depends on MCUX_HAS_COMPONENT_driver.lpc_freqme
```

## mcux/mcux-sdk-ng/drivers/lpc_gpio/Kconfig
```kconfig
# Copyright 2024 NXP
#
# SPDX-License-Identifier: BSD-3-Clause

config MCUX_HAS_COMPONENT_driver.lpc_gpio
    bool
    default y if MCUX_HW_IP_DriverType_GPIO_PORT

config MCUX_COMPONENT_driver.lpc_gpio
    bool "lpc_gpio"
    select MCUX_COMPONENT_driver.common
    depends on MCUX_HAS_COMPONENT_driver.lpc_gpio
```

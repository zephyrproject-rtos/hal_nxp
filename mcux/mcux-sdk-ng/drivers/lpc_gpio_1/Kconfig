## mcux/mcux-sdk-ng/drivers/lpc_gpio_1/Kconfig
```kconfig
# Copyright 2024 NXP
#
# SPDX-License-Identifier: BSD-3-Clause

config MCUX_HAS_COMPONENT_driver.lpc_gpio_1
    bool
    default y if MCUX_HW_IP_DriverType_LPC_GPIO

config MCUX_COMPONENT_driver.lpc_gpio_1
    bool "lpc_gpio_1"
    select MCUX_COMPONENT_driver.common
    depends on MCUX_HAS_COMPONENT_driver.lpc_gpio_1
```

## mcux/mcux-sdk-ng/drivers/lpc_i2c/Kconfig
```kconfig
# Copyright 2024 NXP
#
# SPDX-License-Identifier: BSD-3-Clause

config MCUX_HAS_COMPONENT_driver.lpc_i2c_dma
    bool
    default y if MCUX_HAS_COMPONENT_driver.lpc_i2c && MCUX_HAS_COMPONENT_driver.lpc_dma

config MCUX_HAS_COMPONENT_driver.lpc_i2c
    bool
    default y if MCUX_HW_IP_DriverType_I2C_SERIALIF

config MCUX_COMPONENT_driver.lpc_i2c_dma
    bool "lpc_i2c_dma"
    select MCUX_COMPONENT_driver.lpc_i2c
    select MCUX_COMPONENT_driver.lpc_dma
    depends on MCUX_HAS_COMPONENT_driver.lpc_i2c_dma

config MCUX_COMPONENT_driver.lpc_i2c
    bool "lpc_i2c"
    select MCUX_COMPONENT_driver.common
    depends on MCUX_HAS_COMPONENT_driver.lpc_i2c
```

## mcux/mcux-sdk-ng/drivers/lpc_iocon/Kconfig
```kconfig
# Copyright 2024 NXP
#
# SPDX-License-Identifier: BSD-3-Clause

config MCUX_HAS_COMPONENT_driver.lpc_iocon
    bool
    default y if MCUX_HW_IP_DriverType_IOCON

config MCUX_COMPONENT_driver.lpc_iocon
    bool "lpc_iocon"
    select MCUX_COMPONENT_driver.common
    depends on MCUX_HAS_COMPONENT_driver.lpc_iocon
```

## mcux/mcux-sdk-ng/drivers/lpc_iocon_lite/Kconfig
```kconfig
# Copyright 2024 NXP
#
# SPDX-License-Identifier: BSD-3-Clause

config MCUX_HAS_COMPONENT_driver.lpc_iocon_lite
    bool
    default y if MCUX_HW_IP_DriverType_IOCON_LITE

config MCUX_COMPONENT_driver.lpc_iocon_lite
    bool "lpc_iocon_lite"
    select MCUX_COMPONENT_driver.common
    depends on MCUX_HAS_COMPONENT_driver.lpc_iocon_lite
```

## mcux/mcux-sdk-ng/drivers/lpc_lcdc/Kconfig
```kconfig
# Copyright 2024 NXP
#
# SPDX-License-Identifier: BSD-3-Clause

config MCUX_HAS_COMPONENT_driver.lpc_lcdc
    bool
    default y if MCUX_HW_IP_DriverType_LCD

config MCUX_COMPONENT_driver.lpc_lcdc
    bool "lpc_lcdc"
    select MCUX_COMPONENT_driver.common
    depends on MCUX_HAS_COMPONENT_driver.lpc_lcdc
```

## mcux/mcux-sdk-ng/drivers/lpc_minispi/Kconfig
```kconfig
# Copyright 2024 NXP
#
# SPDX-License-Identifier: BSD-3-Clause

config MCUX_HAS_COMPONENT_driver.lpc_minispi
    bool
    default y if MCUX_HW_IP_DriverType_MINI_SPI

config MCUX_COMPONENT_driver.lpc_minispi
    bool "lpc_minispi"
    select MCUX_COMPONENT_driver.common
    depends on MCUX_HAS_COMPONENT_driver.lpc_minispi
```

## mcux/mcux-sdk-ng/drivers/lpc_miniusart/Kconfig
```kconfig
# Copyright 2024 NXP
#
# SPDX-License-Identifier: BSD-3-Clause

config MCUX_HAS_COMPONENT_driver.lpc_miniusart
    bool
    default y if MCUX_HW_IP_DriverType_MINI_USART

config MCUX_COMPONENT_driver.lpc_miniusart
    bool "lpc_miniusart"
    select MCUX_COMPONENT_driver.common
    depends on MCUX_HAS_COMPONENT_driver.lpc_miniusart
```

## mcux/mcux-sdk-ng/drivers/lpc_rit/Kconfig
```kconfig
# Copyright 2024 NXP
#
# SPDX-License-Identifier: BSD-3-Clause

config MCUX_HAS_COMPONENT_driver.rit
    bool
    default y if MCUX_HW_IP_DriverType_RIT

config MCUX_COMPONENT_driver.rit
    bool "rit"
    select MCUX_COMPONENT_driver.common
    depends on MCUX_HAS_COMPONENT_driver.rit
```

## mcux/mcux-sdk-ng/drivers/lpc_rtc/Kconfig
```kconfig
# Copyright 2024 NXP
#
# SPDX-License-Identifier: BSD-3-Clause

config MCUX_HAS_COMPONENT_driver.lpc_rtc
    bool
    default y if MCUX_HW_IP_DriverType_RTC_LITE

config MCUX_COMPONENT_driver.lpc_rtc
    bool "lpc_rtc"
    select MCUX_COMPONENT_driver.common
    depends on MCUX_HAS_COMPONENT_driver.lpc_rtc
```

## mcux/mcux-sdk-ng/drivers/lpc_vspi/Kconfig
```kconfig
# Copyright 2024 NXP
#
# SPDX-License-Identifier: BSD-3-Clause

config MCUX_HAS_COMPONENT_driver.vspi_dma
    bool
    default y if MCUX_HAS_COMPONENT_driver.vspi && MCUX_HAS_COMPONENT_driver.lpc_dma

config MCUX_HAS_COMPONENT_driver.vspi
    bool
    default y if MCUX_HW_IP_DriverType_SPI

config MCUX_COMPONENT_driver.vspi_dma
    bool "vspi_dma"
    select MCUX_COMPONENT_driver.vspi
    select MCUX_COMPONENT_driver.lpc_dma
    depends on MCUX_HAS_COMPONENT_driver.vspi_dma

config MCUX_COMPONENT_driver.vspi
    bool "vspi"
    select MCUX_COMPONENT_driver.common
    depends on MCUX_HAS_COMPONENT_driver.vspi
```

## mcux/mcux-sdk-ng/drivers/lpc_vusart/Kconfig
```kconfig
# Copyright 2024 NXP
#
# SPDX-License-Identifier: BSD-3-Clause

config MCUX_HAS_COMPONENT_driver.vusart_dma
    bool
    default y if MCUX_HAS_COMPONENT_driver.vusart && MCUX_HAS_COMPONENT_driver.lpc_dma

config MCUX_HAS_COMPONENT_driver.vusart
    bool
    default y if MCUX_HW_IP_DriverType_USART

config MCUX_COMPONENT_driver.vusart_dma
    bool "vusart_dma"
    select MCUX_COMPONENT_driver.vusart
    select MCUX_COMPONENT_driver.lpc_dma
    depends on MCUX_HAS_COMPONENT_driver.vusart_dma

config MCUX_COMPONENT_driver.vusart
    bool "vusart"
    select MCUX_COMPONENT_driver.common
    depends on MCUX_HAS_COMPONENT_driver.vusart
```

## mcux/mcux-sdk-ng/drivers/lpcmp/Kconfig
```kconfig
# Copyright 2024 NXP
#
# SPDX-License-Identifier: BSD-3-Clause

config MCUX_HAS_COMPONENT_driver.lpcmp
    bool
    default y if MCUX_HW_IP_DriverType_LPCMP

config MCUX_COMPONENT_driver.lpcmp
    bool "lpcmp"
    select MCUX_COMPONENT_driver.common
    depends on MCUX_HAS_COMPONENT_driver.lpcmp
```

## mcux/mcux-sdk-ng/drivers/lpflexcomm/Kconfig
```kconfig
# Copyright 2024 NXP
#
# SPDX-License-Identifier: BSD-3-Clause

config MCUX_HAS_COMPONENT_driver.lpflexcomm
    bool
    default y if MCUX_HW_IP_DriverType_LPFLEXCOMM

config MCUX_COMPONENT_driver.lpflexcomm
    bool "lpflexcomm"
    select MCUX_COMPONENT_driver.common
    depends on MCUX_HAS_COMPONENT_driver.lpflexcomm

rsource "./lpuart/Kconfig"
rsource "./lpspi/Kconfig"
rsource "./lpi2c/Kconfig"
```

## mcux/mcux-sdk-ng/drivers/lpflexcomm/lpi2c/Kconfig
```kconfig
# Copyright 2024 NXP
#
# SPDX-License-Identifier: BSD-3-Clause

config MCUX_HAS_COMPONENT_driver.lpflexcomm_lpi2c_edma
    bool
    default y if MCUX_HAS_COMPONENT_driver.lpflexcomm_lpi2c && MCUX_HAS_COMPONENT_driver.edma4

config MCUX_HAS_COMPONENT_driver.lpflexcomm_lpi2c
    bool
    default y if MCUX_HW_IP_DriverType_LPFLEXCOMM_LPI2C

config MCUX_COMPONENT_driver.lpflexcomm_lpi2c
    bool "lpflexcomm_lpi2c"
    select MCUX_COMPONENT_driver.lpflexcomm
    depends on MCUX_HAS_COMPONENT_driver.lpflexcomm_lpi2c

config MCUX_COMPONENT_driver.lpflexcomm_lpi2c_edma
    bool "lpflexcomm_lpi2c_edma"
    select MCUX_COMPONENT_driver.lpflexcomm_lpi2c
    select MCUX_COMPONENT_driver.edma4
    depends on MCUX_HAS_COMPONENT_driver.lpflexcomm_lpi2c_edma
```

## mcux/mcux-sdk-ng/drivers/lpflexcomm/lpspi/Kconfig
```kconfig
# Copyright 2024 NXP
#
# SPDX-License-Identifier: BSD-3-Clause

config MCUX_HAS_COMPONENT_driver.lpflexcomm_lpspi_edma
    bool
    default y if MCUX_HAS_COMPONENT_driver.lpflexcomm_lpspi && MCUX_HAS_COMPONENT_driver.edma4

config MCUX_HAS_COMPONENT_driver.lpflexcomm_lpspi
    bool
    default y if MCUX_HW_IP_DriverType_LPFLEXCOMM_LPSPI

config MCUX_COMPONENT_driver.lpflexcomm_lpspi
    bool "lpflexcomm_lpspi"
    select MCUX_COMPONENT_driver.lpflexcomm
    depends on MCUX_HAS_COMPONENT_driver.lpflexcomm_lpspi

config MCUX_COMPONENT_driver.lpflexcomm_lpspi_edma
    bool "lpflexcomm_lpspi_edma"
    select MCUX_COMPONENT_driver.lpflexcomm_lpspi
    select MCUX_COMPONENT_driver.edma4
    depends on MCUX_HAS_COMPONENT_driver.lpflexcomm_lpspi_edma
```

## mcux/mcux-sdk-ng/drivers/lpflexcomm/lpuart/Kconfig
```kconfig
# Copyright 2024 NXP
#
# SPDX-License-Identifier: BSD-3-Clause

config MCUX_HAS_COMPONENT_driver.lpflexcomm_lpuart_edma
    bool
    default y if MCUX_HAS_COMPONENT_driver.lpflexcomm_lpuart && MCUX_HAS_COMPONENT_driver.edma4

config MCUX_HAS_COMPONENT_driver.lpflexcomm_lpuart
    bool
    default y if MCUX_HW_IP_DriverType_LPFLEXCOMM_LPUART

config MCUX_COMPONENT_driver.lpflexcomm_lpuart
    bool "lpflexcomm_lpuart"
    select MCUX_COMPONENT_driver.lpflexcomm
    depends on MCUX_HAS_COMPONENT_driver.lpflexcomm_lpuart

config MCUX_COMPONENT_driver.lpflexcomm_lpuart_edma
    bool "lpflexcomm_lpuart_edma"
    select MCUX_COMPONENT_driver.lpflexcomm_lpuart
    select MCUX_COMPONENT_driver.edma4
    depends on MCUX_HAS_COMPONENT_driver.lpflexcomm_lpuart_edma
```

## mcux/mcux-sdk-ng/drivers/lpi2c/Kconfig
```kconfig
# Copyright 2024 NXP
#
# SPDX-License-Identifier: BSD-3-Clause

config MCUX_HAS_COMPONENT_driver.lpi2c_edma
    bool
    default y if MCUX_HAS_COMPONENT_driver.lpi2c && (MCUX_HAS_COMPONENT_driver.dma3 || MCUX_HAS_COMPONENT_driver.edma || MCUX_HAS_COMPONENT_driver.edma4)

config MCUX_HAS_COMPONENT_driver.lpi2c
    bool
    default y if MCUX_HW_IP_DriverType_LPI2C

config MCUX_COMPONENT_driver.lpi2c_edma
    bool "lpi2c_edma"
    select MCUX_COMPONENT_driver.lpi2c
    select MCUX_COMPONENT_driver.dma3 if MCUX_HAS_COMPONENT_driver.dma3
    select MCUX_COMPONENT_driver.edma if MCUX_HAS_COMPONENT_driver.edma
    select MCUX_COMPONENT_driver.edma4 if MCUX_HAS_COMPONENT_driver.edma4
    depends on MCUX_HAS_COMPONENT_driver.lpi2c_edma

config MCUX_COMPONENT_driver.lpi2c
    bool "lpi2c"
    select MCUX_COMPONENT_driver.common
    depends on MCUX_HAS_COMPONENT_driver.lpi2c
```

## mcux/mcux-sdk-ng/drivers/lpit/Kconfig
```kconfig
# Copyright 2024 NXP
#
# SPDX-License-Identifier: BSD-3-Clause

config MCUX_HAS_COMPONENT_driver.lpit
    bool
    default y if MCUX_HW_IP_DriverType_LPIT

config MCUX_COMPONENT_driver.lpit
    bool "lpit"
    select MCUX_COMPONENT_driver.common
    depends on MCUX_HAS_COMPONENT_driver.lpit
```

## mcux/mcux-sdk-ng/drivers/lpsci/Kconfig
```kconfig
# Copyright 2024 NXP
#
# SPDX-License-Identifier: BSD-3-Clause

config MCUX_HAS_COMPONENT_driver.lpsci_dma
    bool
    default y if MCUX_HAS_COMPONENT_driver.lpsci && MCUX_HAS_COMPONENT_driver.dma

config MCUX_HAS_COMPONENT_driver.lpsci
    bool
    default y if MCUX_HW_IP_DriverType_LPSCI

config MCUX_COMPONENT_driver.lpsci_dma
    bool "lpsci_dma"
    select MCUX_COMPONENT_driver.lpsci
    select MCUX_COMPONENT_driver.dma
    depends on MCUX_HAS_COMPONENT_driver.lpsci_dma

config MCUX_COMPONENT_driver.lpsci
    bool "lpsci"
    select MCUX_COMPONENT_driver.common
    depends on MCUX_HAS_COMPONENT_driver.lpsci
```

## mcux/mcux-sdk-ng/drivers/lpspi/Kconfig
```kconfig
# Copyright 2024 NXP
#
# SPDX-License-Identifier: BSD-3-Clause

config MCUX_HAS_COMPONENT_driver.lpspi_edma
    bool
    default y if MCUX_HAS_COMPONENT_driver.lpspi && (MCUX_HAS_COMPONENT_driver.dma3 || MCUX_HAS_COMPONENT_driver.edma || MCUX_HAS_COMPONENT_driver.edma4)

config MCUX_HAS_COMPONENT_driver.lpspi
    bool
    default y if MCUX_HW_IP_DriverType_LPSPI

config MCUX_COMPONENT_driver.lpspi_edma
    bool "lpspi_edma"
    select MCUX_COMPONENT_driver.lpspi
    select MCUX_COMPONENT_driver.dma3 if MCUX_HAS_COMPONENT_driver.dma3
    select MCUX_COMPONENT_driver.edma if MCUX_HAS_COMPONENT_driver.edma
    select MCUX_COMPONENT_driver.edma4 if MCUX_HAS_COMPONENT_driver.edma4
    depends on MCUX_HAS_COMPONENT_driver.lpspi_edma

config MCUX_COMPONENT_driver.lpspi
    bool "lpspi"
    select MCUX_COMPONENT_driver.common
    depends on MCUX_HAS_COMPONENT_driver.lpspi
```

## mcux/mcux-sdk-ng/drivers/ltc/Kconfig
```kconfig
# Copyright 2024 NXP
#
# SPDX-License-Identifier: BSD-3-Clause

config MCUX_HAS_COMPONENT_driver.ltc_edma
    bool
    default y if MCUX_HAS_COMPONENT_driver.ltc && MCUX_HAS_COMPONENT_driver.edma

config MCUX_HAS_COMPONENT_driver.ltc
    bool
    default y if MCUX_HW_IP_DriverType_LTC

config MCUX_COMPONENT_driver.ltc_dpa
    bool "ltc_dpa"
    select MCUX_COMPONENT_driver.ltc
    depends on MCUX_HAS_COMPONENT_driver.ltc

config MCUX_COMPONENT_driver.ltc_edma
    bool "ltc_edma"
    select MCUX_COMPONENT_driver.ltc
    select MCUX_COMPONENT_driver.edma
    depends on MCUX_HAS_COMPONENT_driver.ltc_edma

config MCUX_COMPONENT_driver.ltc
    bool "ltc"
    select MCUX_COMPONENT_driver.common
    depends on MCUX_HAS_COMPONENT_driver.ltc
```

## mcux/mcux-sdk-ng/drivers/mailbox/Kconfig
```kconfig
# Copyright 2024 NXP
#
# SPDX-License-Identifier: BSD-3-Clause

config MCUX_HAS_COMPONENT_driver.mailbox
    bool
    default y if MCUX_HW_IP_DriverType_MAILBOX

config MCUX_COMPONENT_driver.mailbox
    bool "mailbox"
    select MCUX_COMPONENT_driver.common
    depends on MCUX_HAS_COMPONENT_driver.mailbox
```

## mcux/mcux-sdk-ng/drivers/mau/Kconfig
```kconfig
# Copyright 2024 NXP
#
# SPDX-License-Identifier: BSD-3-Clause

config MCUX_HAS_COMPONENT_driver.mau
    bool
    default y if MCUX_HW_IP_DriverType_MAU

config MCUX_COMPONENT_driver.mau
    bool "mau"
    select MCUX_COMPONENT_driver.common
    depends on MCUX_HAS_COMPONENT_driver.mau
```

## mcux/mcux-sdk-ng/drivers/mcx_enet/Kconfig
```kconfig
# Copyright 2024 NXP
#
# SPDX-License-Identifier: BSD-3-Clause

config MCUX_HAS_COMPONENT_driver.mcx_enet
    bool
    default y if MCUX_HW_IP_DriverType_MCX_ENET

config MCUX_COMPONENT_driver.mcx_enet
    bool "mcx_enet"
    select MCUX_COMPONENT_driver.common
    depends on MCUX_HAS_COMPONENT_driver.mcx_enet
```

## mcux/mcux-sdk-ng/drivers/mcx_spc/Kconfig
```kconfig
# Copyright 2024 NXP
#
# SPDX-License-Identifier: BSD-3-Clause

config MCUX_HAS_COMPONENT_driver.mcx_spc
    bool
    default y if MCUX_HW_IP_DriverType_MCX_SPC

config MCUX_COMPONENT_driver.mcx_spc
    bool "mcx_spc"
    select MCUX_COMPONENT_driver.common
    depends on MCUX_HAS_COMPONENT_driver.mcx_spc
```

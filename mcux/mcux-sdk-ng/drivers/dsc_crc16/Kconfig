## mcux/mcux-sdk-ng/drivers/dsc_crc16/Kconfig
```kconfig
# Copyright 2024 NXP
#
# SPDX-License-Identifier: BSD-3-Clause

config MCUX_HAS_COMPONENT_driver.dsc_crc16
    bool
    default y if MCUX_HW_IP_DriverType_DSC_CRC16

config MCUX_COMPONENT_driver.dsc_crc16
    bool "dsc_crc16"
    select MCUX_COMPONENT_driver.common
    depends on MCUX_HAS_COMPONENT_driver.dsc_crc16
```

## mcux/mcux-sdk-ng/drivers/dsc_dma/Kconfig
```kconfig
# Copyright 2024 NXP
#
# SPDX-License-Identifier: BSD-3-Clause

config MCUX_HAS_COMPONENT_driver.dsc_dma
    bool
    default y if MCUX_HW_IP_DriverType_DSC_DMA

config MCUX_COMPONENT_driver.dsc_dma
    bool "dsc_dma"
    select MCUX_COMPONENT_driver.common
    depends on MCUX_HAS_COMPONENT_driver.dsc_dma
```

## mcux/mcux-sdk-ng/drivers/dsc_ewm/Kconfig
```kconfig
# Copyright 2024 NXP
#
# SPDX-License-Identifier: BSD-3-Clause

config MCUX_HAS_COMPONENT_driver.dsc_ewm
    bool
    default y if MCUX_HW_IP_DriverType_DSC_EWM

config MCUX_COMPONENT_driver.dsc_ewm
    bool "dsc_ewm"
    select MCUX_COMPONENT_driver.common
    depends on MCUX_HAS_COMPONENT_driver.dsc_ewm
```

## mcux/mcux-sdk-ng/drivers/dsc_flash/Kconfig
```kconfig
# Copyright 2024 NXP
#
# SPDX-License-Identifier: BSD-3-Clause

config MCUX_HAS_COMPONENT_driver.dsc_flash
    bool
    default y if (MCUX_HW_IP_DriverType_DSC_FTFE || MCUX_HW_IP_DriverType_DSC_FTFA || MCUX_HW_IP_DriverType_DSC_FTFL)  \
      && !(MCUX_HAS_COMPONENT_driver.dsc_flash_romapi)

config MCUX_COMPONENT_driver.dsc_flash
    bool "dsc_flash"
    select MCUX_COMPONENT_driver.common
    depends on MCUX_HAS_COMPONENT_driver.dsc_flash
```

## mcux/mcux-sdk-ng/drivers/dsc_gpio/Kconfig
```kconfig
# Copyright 2024 NXP
#
# SPDX-License-Identifier: BSD-3-Clause

config MCUX_HAS_COMPONENT_driver.dsc_gpio
    bool
    default y if MCUX_HW_IP_DriverType_DSC_GPIO

config MCUX_COMPONENT_driver.dsc_gpio
    bool "dsc_gpio"
    select MCUX_COMPONENT_driver.common
    depends on MCUX_HAS_COMPONENT_driver.dsc_gpio
```

## mcux/mcux-sdk-ng/drivers/dsc_i2c/Kconfig
```kconfig
# Copyright 2024 NXP
#
# SPDX-License-Identifier: BSD-3-Clause

config MCUX_HAS_COMPONENT_driver.dsc_i2c_dma
    bool
    default y if MCUX_HAS_COMPONENT_driver.dsc_i2c && MCUX_HAS_COMPONENT_driver.dsc_dma

config MCUX_HAS_COMPONENT_driver.dsc_i2c_edma
    bool
    default y if MCUX_HAS_COMPONENT_driver.dsc_i2c && MCUX_HAS_COMPONENT_driver.dsc_edma

config MCUX_HAS_COMPONENT_driver.dsc_i2c
    bool
    default y if MCUX_HW_IP_DriverType_DSC_I2C

config MCUX_COMPONENT_driver.dsc_i2c_dma
    bool "dsc_i2c_dma"
    select MCUX_COMPONENT_driver.dsc_i2c
    select MCUX_COMPONENT_driver.dsc_dma
    depends on MCUX_HAS_COMPONENT_driver.dsc_i2c_dma

config MCUX_COMPONENT_driver.dsc_i2c_edma
    bool "dsc_i2c_edma"
    select MCUX_COMPONENT_driver.dsc_i2c
    select MCUX_COMPONENT_driver.dsc_edma
    depends on MCUX_HAS_COMPONENT_driver.dsc_i2c_edma

config MCUX_COMPONENT_driver.dsc_i2c
    bool "dsc_i2c"
    select MCUX_COMPONENT_driver.common
    depends on MCUX_HAS_COMPONENT_driver.dsc_i2c
```

## mcux/mcux-sdk-ng/drivers/dsc_lpi2c/Kconfig
```kconfig
# Copyright 2024 NXP
#
# SPDX-License-Identifier: BSD-3-Clause

config MCUX_HAS_COMPONENT_driver.dsc_lpi2c_edma
    bool
    default y if MCUX_HAS_COMPONENT_driver.dsc_lpi2c && MCUX_HAS_COMPONENT_driver.dsc_edma

config MCUX_HAS_COMPONENT_driver.dsc_lpi2c
    bool
    default y if MCUX_HW_IP_DriverType_DSC_LPI2C

config MCUX_COMPONENT_driver.dsc_lpi2c_edma
    bool "dsc_lpi2c_edma"
    select MCUX_COMPONENT_driver.dsc_lpi2c
    select MCUX_COMPONENT_driver.dsc_edma
    depends on MCUX_HAS_COMPONENT_driver.dsc_lpi2c_edma

config MCUX_COMPONENT_driver.dsc_lpi2c
    bool "dsc_lpi2c"
    select MCUX_COMPONENT_driver.common
    depends on MCUX_HAS_COMPONENT_driver.dsc_lpi2c
```

## mcux/mcux-sdk-ng/drivers/dsc_opamp/Kconfig
```kconfig
# Copyright 2024 NXP
#
# SPDX-License-Identifier: BSD-3-Clause

config MCUX_HAS_COMPONENT_driver.dsc_opamp
    bool
    default y if MCUX_HW_IP_DriverType_DSC_OPAMP

config MCUX_COMPONENT_driver.dsc_opamp
    bool "dsc_opamp"
    select MCUX_COMPONENT_driver.common
    depends on MCUX_HAS_COMPONENT_driver.dsc_opamp
```

## mcux/mcux-sdk-ng/drivers/dsc_opamp_1/Kconfig
```kconfig
# Copyright 2024 NXP
#
# SPDX-License-Identifier: BSD-3-Clause

config MCUX_HAS_COMPONENT_driver.dsc_opamp_1
    bool
    default y if MCUX_HW_IP_DriverType_DSC_OPAMP

config MCUX_COMPONENT_driver.dsc_opamp_1
    bool "dsc_opamp_1"
    select MCUX_COMPONENT_driver.common
    depends on MCUX_HAS_COMPONENT_driver.dsc_opamp_1
```

## mcux/mcux-sdk-ng/drivers/dsc_pdb/Kconfig
```kconfig
# Copyright 2024 NXP
#
# SPDX-License-Identifier: BSD-3-Clause

config MCUX_HAS_COMPONENT_driver.dsc_pdb
    bool
    default y if MCUX_HW_IP_DriverType_DSC_PDB

config MCUX_COMPONENT_driver.dsc_pdb
    bool "dsc_pdb"
    select MCUX_COMPONENT_driver.common
    depends on MCUX_HAS_COMPONENT_driver.dsc_pdb
```

## mcux/mcux-sdk-ng/drivers/dsc_pmc/Kconfig
```kconfig
# Copyright 2024 NXP
#
# SPDX-License-Identifier: BSD-3-Clause

config MCUX_HAS_COMPONENT_driver.dsc_pmc
    bool
    default y if MCUX_HW_IP_DriverType_DSC_PMC

config MCUX_COMPONENT_driver.dsc_pmc
    bool "dsc_pmc"
    select MCUX_COMPONENT_driver.common
    depends on MCUX_HAS_COMPONENT_driver.dsc_pmc
```

## mcux/mcux-sdk-ng/drivers/dsc_pwm/Kconfig
```kconfig
# Copyright 2024 NXP
#
# SPDX-License-Identifier: BSD-3-Clause

config MCUX_HAS_COMPONENT_driver.dsc_pwm
    bool
    default y if MCUX_HW_IP_DriverType_DSC_PWM

config MCUX_COMPONENT_driver.dsc_pwm
    bool "dsc_pwm"
    select MCUX_COMPONENT_driver.common
    depends on MCUX_HAS_COMPONENT_driver.dsc_pwm
```

## mcux/mcux-sdk-ng/drivers/dsc_qdc/Kconfig
```kconfig
# Copyright 2024 NXP
#
# SPDX-License-Identifier: BSD-3-Clause

config MCUX_HAS_COMPONENT_driver.dsc_qdc
    bool
    default y if MCUX_HW_IP_DriverType_DSC_QDC

config MCUX_COMPONENT_driver.dsc_qdc
    bool "dsc_qdc"
    select MCUX_COMPONENT_driver.common
    depends on MCUX_HAS_COMPONENT_driver.dsc_qdc
```

## mcux/mcux-sdk-ng/drivers/dsc_qtmr/Kconfig
```kconfig
# Copyright 2024 NXP
#
# SPDX-License-Identifier: BSD-3-Clause

config MCUX_HAS_COMPONENT_driver.dsc_qtmr
    bool
    default y if MCUX_HW_IP_DriverType_DSC_TMR

config MCUX_COMPONENT_driver.dsc_qtmr
    bool "dsc_qtmr"
    select MCUX_COMPONENT_driver.common
    depends on MCUX_HAS_COMPONENT_driver.dsc_qtmr
```

## mcux/mcux-sdk-ng/drivers/dsc_sim/Kconfig
```kconfig
# Copyright 2024 NXP
#
# SPDX-License-Identifier: BSD-3-Clause

config MCUX_HAS_COMPONENT_driver.dsc_sim
    bool
    default y if MCUX_HW_IP_DriverType_DSC_SIM

config MCUX_COMPONENT_driver.dsc_sim
    bool "dsc_sim"
    select MCUX_COMPONENT_driver.common
    depends on MCUX_HAS_COMPONENT_driver.dsc_sim
```

## mcux/mcux-sdk-ng/drivers/dsc_xbara/Kconfig
```kconfig
# Copyright 2024 NXP
#
# SPDX-License-Identifier: BSD-3-Clause

config MCUX_HAS_COMPONENT_driver.dsc_xbara
    bool
    default y if MCUX_HW_IP_DriverType_DSC_XBARA

config MCUX_COMPONENT_driver.dsc_xbara
    bool "dsc_xbara"
    select MCUX_COMPONENT_driver.common
    depends on MCUX_HAS_COMPONENT_driver.dsc_xbara
```

## mcux/mcux-sdk-ng/drivers/dsc_xbarb/Kconfig
```kconfig
# Copyright 2024 NXP
#
# SPDX-License-Identifier: BSD-3-Clause

config MCUX_HAS_COMPONENT_driver.dsc_xbarb
    bool
    default y if MCUX_HW_IP_DriverType_DSC_XBARB

config MCUX_COMPONENT_driver.dsc_xbarb
    bool "dsc_xbarb"
    select MCUX_COMPONENT_driver.common
    depends on MCUX_HAS_COMPONENT_driver.dsc_xbarb
```

## mcux/mcux-sdk-ng/drivers/dspi/Kconfig
```kconfig
# Copyright 2024 NXP
#
# SPDX-License-Identifier: BSD-3-Clause

config MCUX_HAS_COMPONENT_driver.dspi_dma
    bool
    default y if MCUX_HAS_COMPONENT_driver.dspi && MCUX_HAS_COMPONENT_driver.dma

config MCUX_HAS_COMPONENT_driver.dspi_edma
    bool
    default y if MCUX_HAS_COMPONENT_driver.dspi && MCUX_HAS_COMPONENT_driver.edma

config MCUX_HAS_COMPONENT_driver.dspi
    bool
    default y if MCUX_HW_IP_DriverType_DSPI

config MCUX_COMPONENT_driver.dspi_dma
    bool "dspi_dma"
    select MCUX_COMPONENT_driver.dspi
    select MCUX_COMPONENT_driver.dma
    depends on MCUX_HAS_COMPONENT_driver.dspi_dma

config MCUX_COMPONENT_driver.dspi_edma
    bool "dspi_edma"
    select MCUX_COMPONENT_driver.dspi
    select MCUX_COMPONENT_driver.edma
    depends on MCUX_HAS_COMPONENT_driver.dspi_edma

config MCUX_COMPONENT_driver.dspi
    bool "dspi"
    select MCUX_COMPONENT_driver.common
    depends on MCUX_HAS_COMPONENT_driver.dspi
```

## mcux/mcux-sdk-ng/drivers/easrc/Kconfig
```kconfig
# Copyright 2024 NXP
#
# SPDX-License-Identifier: BSD-3-Clause

config MCUX_HAS_COMPONENT_driver.easrc_sdma
    bool
    default y if MCUX_HAS_COMPONENT_driver.easrc && MCUX_HAS_COMPONENT_driver.sdma

config MCUX_HAS_COMPONENT_driver.easrc
    bool
    default y if MCUX_HW_IP_DriverType_EASRC

config MCUX_COMPONENT_driver.easrc_sdma
    bool "easrc_sdma"
    select MCUX_COMPONENT_driver.easrc
    select MCUX_COMPONENT_driver.sdma
    depends on MCUX_HAS_COMPONENT_driver.easrc_sdma

config MCUX_COMPONENT_driver.easrc
    bool "easrc"
    select MCUX_COMPONENT_driver.common
    depends on MCUX_HAS_COMPONENT_driver.easrc
```

## mcux/mcux-sdk-ng/drivers/ecspi/Kconfig
```kconfig
# Copyright 2024 NXP
#
# SPDX-License-Identifier: BSD-3-Clause

config MCUX_HAS_COMPONENT_driver.ecspi_sdma
    bool
    default y if MCUX_HAS_COMPONENT_driver.ecspi && MCUX_HAS_COMPONENT_driver.sdma

config MCUX_HAS_COMPONENT_driver.ecspi
    bool
    default y if MCUX_HW_IP_DriverType_ECSPI

config MCUX_COMPONENT_driver.ecspi_sdma
    bool "ecspi_sdma"
    select MCUX_COMPONENT_driver.ecspi
    select MCUX_COMPONENT_driver.sdma
    depends on MCUX_HAS_COMPONENT_driver.ecspi_sdma

config MCUX_COMPONENT_driver.ecspi
    bool "ecspi"
    select MCUX_COMPONENT_driver.common
    depends on MCUX_HAS_COMPONENT_driver.ecspi
```

## mcux/mcux-sdk-ng/drivers/edma/Kconfig
```kconfig
# Copyright 2024 NXP
#
# SPDX-License-Identifier: BSD-3-Clause

config MCUX_HAS_COMPONENT_driver.edma
    bool
    default y if MCUX_HW_IP_DriverType_EDMA

config MCUX_COMPONENT_driver.edma
    bool "edma"
    select MCUX_COMPONENT_driver.common
    select MCUX_COMPONENT_driver.dmamux
    depends on MCUX_HAS_COMPONENT_driver.edma
```

## mcux/mcux-sdk-ng/drivers/edma4/Kconfig
```kconfig
# Copyright 2024 NXP
#
# SPDX-License-Identifier: BSD-3-Clause

config MCUX_HAS_COMPONENT_driver.edma4
    bool
    default y if MCUX_HW_IP_DriverType_EDMA3 || MCUX_HW_IP_DriverType_EDMA4

config MCUX_COMPONENT_driver.edma4
    bool "edma4"
    depends on MCUX_HAS_COMPONENT_driver.edma4
    select MCUX_COMPONENT_driver.edma_soc
```

## mcux/mcux-sdk-ng/drivers/eim/Kconfig
```kconfig
# Copyright 2024 NXP
#
# SPDX-License-Identifier: BSD-3-Clause

config MCUX_HAS_COMPONENT_driver.eim
    bool
    default y if MCUX_HW_IP_DriverType_EIM

config MCUX_COMPONENT_driver.eim
    bool "eim"
    select MCUX_COMPONENT_driver.common
    depends on MCUX_HAS_COMPONENT_driver.eim
```

## mcux/mcux-sdk-ng/drivers/elcdif/Kconfig
```kconfig
# Copyright 2024 NXP
#
# SPDX-License-Identifier: BSD-3-Clause

config MCUX_HAS_COMPONENT_driver.elcdif
    bool
    default y if MCUX_HW_IP_DriverType_ELCDIF

config MCUX_COMPONENT_driver.elcdif
    bool "elcdif"
    select MCUX_COMPONENT_driver.common
    depends on MCUX_HAS_COMPONENT_driver.elcdif
```

## mcux/mcux-sdk-ng/drivers/elemu/Kconfig
```kconfig
# Copyright 2024 NXP
#
# SPDX-License-Identifier: BSD-3-Clause

config MCUX_HAS_COMPONENT_driver.elemu
    bool
    default y if MCUX_HW_IP_DriverType_ELEMU

config MCUX_COMPONENT_driver.elemu
    bool "elemu"
    depends on MCUX_HAS_COMPONENT_driver.elemu
```

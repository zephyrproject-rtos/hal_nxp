## mcux/mcux-sdk-ng/drivers/pmc0/Kconfig
```kconfig
# Copyright 2024 NXP
#
# SPDX-License-Identifier: BSD-3-Clause

config MCUX_HAS_COMPONENT_driver.pmc0
    bool
    default y if MCUX_HW_IP_DriverType_PMC0

config MCUX_COMPONENT_driver.pmc0
    bool "pmc0"
    select MCUX_COMPONENT_driver.common
    depends on MCUX_HAS_COMPONENT_driver.pmc0
```

## mcux/mcux-sdk-ng/drivers/pmu/Kconfig
```kconfig
# Copyright 2024 NXP
#
# SPDX-License-Identifier: BSD-3-Clause

config MCUX_HAS_COMPONENT_driver.pmu
    bool
    default y if MCUX_HW_IP_DriverType_PMU

config MCUX_COMPONENT_driver.pmu
    bool "pmu"
    select MCUX_COMPONENT_driver.common
    depends on MCUX_HAS_COMPONENT_driver.pmu
```

## mcux/mcux-sdk-ng/drivers/pn76/Kconfig
```kconfig
# Copyright 2024 NXP
#
# SPDX-License-Identifier: BSD-3-Clause

rsource "./wdt/Kconfig"
rsource "./spi/Kconfig"
rsource "./rng/Kconfig"
rsource "./pn_wrapper/Kconfig"
rsource "./lpuart/Kconfig"
rsource "./i2c/Kconfig"
rsource "./hostif/pnev76fama/Kconfig"
rsource "./hostif/pnev7642fama/Kconfig"
rsource "./gpt/Kconfig"
rsource "./gpdma/Kconfig"
rsource "./gpadc/Kconfig"
rsource "./crc_wrapper/Kconfig"
rsource "./crc/Kconfig"
```

## mcux/mcux-sdk-ng/drivers/pn76/crc/Kconfig
```kconfig
# Copyright 2024 NXP
#
# SPDX-License-Identifier: BSD-3-Clause

config MCUX_HAS_COMPONENT_driver.pn76_crc
    bool
    default y if MCUX_HW_IP_DriverType_PN_CRC

config MCUX_COMPONENT_driver.pn76_crc
    bool "pn76_crc"
    select MCUX_COMPONENT_driver.common
    depends on MCUX_HAS_COMPONENT_driver.pn76_crc
```

## mcux/mcux-sdk-ng/drivers/pn76/crc_wrapper/Kconfig
```kconfig
# Copyright 2024 NXP
#
# SPDX-License-Identifier: BSD-3-Clause

config MCUX_HAS_COMPONENT_driver.crc_wrapper
    bool
    default y if MCUX_HW_IP_DriverType_PN_CRC

config MCUX_COMPONENT_driver.crc_wrapper
    bool "crc_wrapper"
    select MCUX_COMPONENT_driver.common
    depends on MCUX_HAS_COMPONENT_driver.crc_wrapper
```

## mcux/mcux-sdk-ng/drivers/pn76/gpadc/Kconfig
```kconfig
# Copyright 2024 NXP
#
# SPDX-License-Identifier: BSD-3-Clause

config MCUX_HAS_COMPONENT_driver.gpadc
    bool
    default y if MCUX_HW_IP_DriverType_GPADC

config MCUX_COMPONENT_driver.gpadc
    bool "gpadc"
    select MCUX_COMPONENT_driver.common
    select MCUX_COMPONENT_driver.pn_wrapper
    select MCUX_COMPONENT_driver.hal_intfs
    depends on MCUX_HAS_COMPONENT_driver.gpadc
```

## mcux/mcux-sdk-ng/drivers/pn76/gpt/Kconfig
```kconfig
# Copyright 2024 NXP
#
# SPDX-License-Identifier: BSD-3-Clause

config MCUX_HAS_COMPONENT_driver.pn76_gpt
    bool
    default y if MCUX_HW_IP_DriverType_PN_TIMERS

config MCUX_COMPONENT_driver.pn76_gpt
    bool "pn76_gpt"
    select MCUX_COMPONENT_driver.common
    depends on MCUX_HAS_COMPONENT_driver.pn76_gpt
```

## mcux/mcux-sdk-ng/drivers/pn76/hostif/pnev7642fama/Kconfig
```kconfig
# Copyright 2024 NXP
#
# SPDX-License-Identifier: BSD-3-Clause

config MCUX_HAS_COMPONENT_driver.pn76_pnev7642fama_hostif
    bool
    default y if MCUX_HW_IP_DriverType_HOSTIF

config MCUX_COMPONENT_driver.pn76_pnev7642fama_hostif
    bool "pn76_pnev7642fama_hostif"
    select MCUX_COMPONENT_driver.common
    depends on MCUX_HAS_COMPONENT_driver.pn76_pnev7642fama_hostif
```

## mcux/mcux-sdk-ng/drivers/pn76/hostif/pnev76fama/Kconfig
```kconfig
# Copyright 2024 NXP
#
# SPDX-License-Identifier: BSD-3-Clause

config MCUX_HAS_COMPONENT_driver.hostif
    bool
    default y if MCUX_HW_IP_DriverType_HOSTIF

config MCUX_COMPONENT_driver.hostif
    bool "hostif"
    select MCUX_COMPONENT_driver.common
    depends on MCUX_HAS_COMPONENT_driver.hostif
```

## mcux/mcux-sdk-ng/drivers/pn76/i2c/Kconfig
```kconfig
# Copyright 2024 NXP
#
# SPDX-License-Identifier: BSD-3-Clause

config MCUX_HAS_COMPONENT_driver.i2c_gpdma
    bool
    default y if MCUX_HAS_COMPONENT_driver.pn76_i2c && MCUX_HAS_COMPONENT_driver.gpdma

config MCUX_HAS_COMPONENT_driver.pn76_i2c
    bool
    default y if MCUX_HW_IP_DriverType_PN_I2C

config MCUX_COMPONENT_driver.i2c_gpdma
    bool "i2c_gpdma"
    select MCUX_COMPONENT_driver.pn76_i2c
    select MCUX_COMPONENT_driver.gpdma
    depends on MCUX_HAS_COMPONENT_driver.i2c_gpdma

config MCUX_COMPONENT_driver.pn76_i2c
    bool "pn76_i2c"
    select MCUX_COMPONENT_driver.common
    depends on MCUX_HAS_COMPONENT_driver.pn76_i2c
```

## mcux/mcux-sdk-ng/drivers/pn76/lpuart/Kconfig
```kconfig
# Copyright 2024 NXP
#
# SPDX-License-Identifier: BSD-3-Clause

config MCUX_HAS_COMPONENT_driver.lpuart_gpdma
    bool
    default y if MCUX_HAS_COMPONENT_driver.pn76_lpuart && MCUX_HAS_COMPONENT_driver.gpdma

config MCUX_HAS_COMPONENT_driver.pn76_lpuart
    bool
    default y if MCUX_HW_IP_DriverType_PN_LPUART

config MCUX_COMPONENT_driver.lpuart_gpdma
    bool "lpuart_gpdma"
    select MCUX_COMPONENT_driver.pn76_lpuart
    select MCUX_COMPONENT_driver.gpdma
    depends on MCUX_HAS_COMPONENT_driver.lpuart_gpdma

config MCUX_COMPONENT_driver.pn76_lpuart
    bool "pn76_lpuart"
    select MCUX_COMPONENT_driver.common
    select MCUX_COMPONENT_driver.hal_intfs
    depends on MCUX_HAS_COMPONENT_driver.pn76_lpuart
```

## mcux/mcux-sdk-ng/drivers/pn76/pn_wrapper/Kconfig
```kconfig
# Copyright 2024 NXP
#
# SPDX-License-Identifier: BSD-3-Clause

config MCUX_COMPONENT_driver.pn_wrapper
    bool "pn_wrapper"
    select MCUX_COMPONENT_driver.hal_intfs
    depends on MCUX_HW_PN76  #TODO: Update with the PN7642 devices name
```

## mcux/mcux-sdk-ng/drivers/pn76/rng/Kconfig
```kconfig
# Copyright 2024 NXP
#
# SPDX-License-Identifier: BSD-3-Clause

config MCUX_HAS_COMPONENT_driver.pn76_rng
    bool
    default y if MCUX_HW_IP_DriverType_PN_RNG

config MCUX_COMPONENT_driver.pn76_rng
    bool "pn76_rng"
    select MCUX_COMPONENT_driver.common
    select MCUX_COMPONENT_driver.hal_intfs
    depends on MCUX_HAS_COMPONENT_driver.pn76_rng
```

## mcux/mcux-sdk-ng/drivers/pn76/spi/Kconfig
```kconfig
# Copyright 2024 NXP
#
# SPDX-License-Identifier: BSD-3-Clause

config MCUX_HAS_COMPONENT_driver.spi_gpdma
    bool
    default y if MCUX_HAS_COMPONENT_driver.pn_spi && MCUX_HAS_COMPONENT_driver.gpdma

config MCUX_HAS_COMPONENT_driver.pn_spi
    bool
    default y if MCUX_HW_IP_DriverType_PN_SPI

config MCUX_COMPONENT_driver.spi_gpdma
    bool "spi_gpdma"
    select MCUX_COMPONENT_driver.gpdma
    select MCUX_COMPONENT_driver.pn_spi
    depends on MCUX_HAS_COMPONENT_driver.spi_gpdma

config MCUX_COMPONENT_driver.pn_spi
    bool "pn_spi"
    select MCUX_COMPONENT_driver.common
    depends on MCUX_HAS_COMPONENT_driver.pn_spi
```

## mcux/mcux-sdk-ng/drivers/pngdec/Kconfig
```kconfig
# Copyright 2024 NXP
#
# SPDX-License-Identifier: BSD-3-Clause

config MCUX_HAS_COMPONENT_driver.pngdec
    bool
    default y if MCUX_HW_IP_DriverType_PNGDEC

config MCUX_COMPONENT_driver.pngdec
    bool "pngdec"
    select MCUX_COMPONENT_driver.common
    depends on MCUX_HAS_COMPONENT_driver.pngdec
```

## mcux/mcux-sdk-ng/drivers/port/Kconfig
```kconfig
# Copyright 2024 NXP
#
# SPDX-License-Identifier: BSD-3-Clause

config MCUX_HAS_COMPONENT_driver.port
    bool
    default y if MCUX_HW_IP_DriverType_PORT

config MCUX_COMPONENT_driver.port
    bool "port"
    select MCUX_COMPONENT_driver.common
    depends on MCUX_HAS_COMPONENT_driver.port
```

## mcux/mcux-sdk-ng/drivers/powerquad/Kconfig
```kconfig
# Copyright 2024 NXP
#
# SPDX-License-Identifier: BSD-3-Clause

config MCUX_HAS_COMPONENT_driver.powerquad
    bool
    default y if MCUX_HW_IP_DriverType_POWERQUAD || MCUX_HW_IP_DriverType_LPC_POWERQUAD

config MCUX_HAS_COMPONENT_driver.powerquad_cmsis
    bool
    default y if MCUX_HW_IP_DriverType_LPC_POWERQUAD || MCUX_HW_IP_DriverType_POWERQUAD

config MCUX_COMPONENT_driver.powerquad
    bool "powerquad"
    select MCUX_COMPONENT_driver.common
    depends on MCUX_HAS_COMPONENT_driver.powerquad

config MCUX_COMPONENT_driver.powerquad_cmsis
    bool "powerquad_cmsis"
    select MCUX_COMPONENT_driver.powerquad
    select MCUX_COMPONENT_CMSIS_DSP_Include
    depends on MCUX_HAS_COMPONENT_driver.powerquad_cmsis
```

## mcux/mcux-sdk-ng/drivers/prg/Kconfig
```kconfig
# Copyright 2024 NXP
#
# SPDX-License-Identifier: BSD-3-Clause

config MCUX_HAS_COMPONENT_driver.prg
    bool
    default y if MCUX_HW_IP_DriverType_PRG

config MCUX_COMPONENT_driver.prg
    bool "prg"
    select MCUX_COMPONENT_driver.common
    depends on MCUX_HAS_COMPONENT_driver.prg
```

## mcux/mcux-sdk-ng/drivers/prince/Kconfig
```kconfig
# Copyright 2024 NXP
#
# SPDX-License-Identifier: BSD-3-Clause

config MCUX_HAS_COMPONENT_driver.prince
    bool
    default y if MCUX_HW_IP_DriverType_PRINCE

config MCUX_COMPONENT_driver.prince
    bool "prince"
    select MCUX_COMPONENT_driver.common
    depends on MCUX_HAS_COMPONENT_driver.prince
```

## mcux/mcux-sdk-ng/drivers/puf/Kconfig
```kconfig
# Copyright 2024 NXP
#
# SPDX-License-Identifier: BSD-3-Clause

config MCUX_HAS_COMPONENT_driver.puf
    bool
    default y if MCUX_HW_IP_DriverType_PUF || MCUX_HW_IP_DriverType_LPC_PUF

config MCUX_COMPONENT_driver.puf
    bool "puf"
    select MCUX_COMPONENT_driver.common
    depends on MCUX_HAS_COMPONENT_driver.puf
```

## mcux/mcux-sdk-ng/drivers/puf_v3/Kconfig
```kconfig
# Copyright 2024 NXP
#
# SPDX-License-Identifier: BSD-3-Clause

config MCUX_HAS_COMPONENT_driver.puf_v3
    bool
    default y if MCUX_HW_IP_DriverType_PUFV3

config MCUX_COMPONENT_driver.puf_v3
    bool "puf_v3"
    select MCUX_COMPONENT_driver.common
    depends on MCUX_HAS_COMPONENT_driver.puf_v3
```

## mcux/mcux-sdk-ng/drivers/pwm/Kconfig
```kconfig
# Copyright 2024 NXP
#
# SPDX-License-Identifier: BSD-3-Clause

config MCUX_HAS_COMPONENT_driver.pwm
    bool
    default y if MCUX_HW_IP_DriverType_PWM

config MCUX_COMPONENT_driver.pwm
    bool "pwm"
    select MCUX_COMPONENT_driver.common
    depends on MCUX_HAS_COMPONENT_driver.pwm
```

## mcux/mcux-sdk-ng/drivers/pwt/Kconfig
```kconfig
# Copyright 2024 NXP
#
# SPDX-License-Identifier: BSD-3-Clause

config MCUX_HAS_COMPONENT_driver.pwt
    bool
    default y if MCUX_HW_IP_DriverType_PWT

config MCUX_COMPONENT_driver.pwt
    bool "pwt"
    select MCUX_COMPONENT_driver.common
    depends on MCUX_HAS_COMPONENT_driver.pwt
```

## mcux/mcux-sdk-ng/drivers/pxp/Kconfig
```kconfig
# Copyright 2024 NXP
#
# SPDX-License-Identifier: BSD-3-Clause

config MCUX_HAS_COMPONENT_driver.pxp
    bool
    default y if MCUX_HW_IP_DriverType_PXP

config MCUX_COMPONENT_driver.pxp
    bool "pxp"
    select MCUX_COMPONENT_driver.common
    depends on MCUX_HAS_COMPONENT_driver.pxp
```

## mcux/mcux-sdk-ng/drivers/qdc/Kconfig
```kconfig
# Copyright 2024 NXP
#
# SPDX-License-Identifier: BSD-3-Clause

config MCUX_HAS_COMPONENT_driver.qdc
    bool
    default y if MCUX_HW_IP_DriverType_QDC

config MCUX_COMPONENT_driver.qdc
    bool "qdc"
    select MCUX_COMPONENT_driver.common
    depends on MCUX_HAS_COMPONENT_driver.qdc
```

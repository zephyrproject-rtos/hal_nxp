## mcux/mcux-sdk-ng/drivers/emc/Kconfig
```kconfig
# Copyright 2024 NXP
#
# SPDX-License-Identifier: BSD-3-Clause

config MCUX_HAS_COMPONENT_driver.emc
    bool
    default y if MCUX_HW_IP_DriverType_EMC

config MCUX_COMPONENT_driver.emc
    bool "emc"
    select MCUX_COMPONENT_driver.common
    depends on MCUX_HAS_COMPONENT_driver.emc
```

## mcux/mcux-sdk-ng/drivers/enc/Kconfig
```kconfig
# Copyright 2024 NXP
#
# SPDX-License-Identifier: BSD-3-Clause

config MCUX_HAS_COMPONENT_driver.enc
    bool
    default y if MCUX_HW_IP_DriverType_ENC

config MCUX_COMPONENT_driver.enc
    bool "enc"
    select MCUX_COMPONENT_driver.common
    depends on MCUX_HAS_COMPONENT_driver.enc
```

## mcux/mcux-sdk-ng/drivers/enet/Kconfig
```kconfig
# Copyright 2024 NXP
#
# SPDX-License-Identifier: BSD-3-Clause

config MCUX_HAS_COMPONENT_driver.enet
    bool
    default y if MCUX_HW_IP_DriverType_ENET

config MCUX_COMPONENT_driver.enet
    bool "enet"
    select MCUX_COMPONENT_driver.common
    depends on MCUX_HAS_COMPONENT_driver.enet
```

## mcux/mcux-sdk-ng/drivers/enet_qos/Kconfig
```kconfig
# Copyright 2024 NXP
#
# SPDX-License-Identifier: BSD-3-Clause

config MCUX_HAS_COMPONENT_driver.enet_qos
    bool
    default y if MCUX_HW_IP_DriverType_ENET_QOS

config MCUX_COMPONENT_driver.enet_qos
    bool "enet_qos"
    select MCUX_COMPONENT_driver.common
    depends on MCUX_HAS_COMPONENT_driver.enet_qos
```

## mcux/mcux-sdk-ng/drivers/erm/Kconfig
```kconfig
# Copyright 2024 NXP
#
# SPDX-License-Identifier: BSD-3-Clause

config MCUX_HAS_COMPONENT_driver.erm
    bool
    default y if MCUX_HW_IP_DriverType_ERM

config MCUX_COMPONENT_driver.erm
    bool "erm"
    select MCUX_COMPONENT_driver.common
    depends on MCUX_HAS_COMPONENT_driver.erm
```

## mcux/mcux-sdk-ng/drivers/esai/Kconfig
```kconfig
# Copyright 2024 NXP
#
# SPDX-License-Identifier: BSD-3-Clause

config MCUX_HAS_COMPONENT_driver.esai_edma
    bool
    default y if MCUX_HAS_COMPONENT_driver.esai && MCUX_HAS_COMPONENT_driver.dma3

config MCUX_HAS_COMPONENT_driver.esai
    bool
    default y if MCUX_HW_IP_DriverType_ESAI

config MCUX_COMPONENT_driver.esai_edma
    bool "esai_edma"
    select MCUX_COMPONENT_driver.esai
    select MCUX_COMPONENT_driver.dma3
    depends on MCUX_HAS_COMPONENT_driver.esai_edma

config MCUX_COMPONENT_driver.esai
    bool "esai"
    depends on MCUX_HAS_COMPONENT_driver.esai
```

## mcux/mcux-sdk-ng/drivers/ewm/Kconfig
```kconfig
# Copyright 2024 NXP
#
# SPDX-License-Identifier: BSD-3-Clause

config MCUX_HAS_COMPONENT_driver.ewm
    bool
    default y if MCUX_HW_IP_DriverType_EWM

config MCUX_COMPONENT_driver.ewm
    bool "ewm"
    select MCUX_COMPONENT_driver.common
    depends on MCUX_HAS_COMPONENT_driver.ewm
```

## mcux/mcux-sdk-ng/drivers/flash/Kconfig
```kconfig
# Copyright 2024 NXP
#
# SPDX-License-Identifier: BSD-3-Clause

config MCUX_HAS_COMPONENT_driver.flash
    bool
    default y if MCUX_HW_IP_DriverType_FTFE || MCUX_HW_IP_DriverType_FTFA || MCUX_HW_IP_DriverType_FTFL

config MCUX_COMPONENT_driver.flash
    bool "flash"
    select MCUX_COMPONENT_driver.common
    depends on MCUX_HAS_COMPONENT_driver.flash
```

## mcux/mcux-sdk-ng/drivers/flash_ftmr/Kconfig
```kconfig
# Copyright 2024 NXP
#
# SPDX-License-Identifier: BSD-3-Clause

config MCUX_HAS_COMPONENT_driver.flash_ftmr
    bool
    default y if MCUX_HW_IP_DriverType_FTMRH || MCUX_HW_IP_DriverType_FTMRE

config MCUX_COMPONENT_driver.flash_ftmr
    bool "flash_ftmr"
    select MCUX_COMPONENT_driver.common
    depends on MCUX_HAS_COMPONENT_driver.flash_ftmr
```

## mcux/mcux-sdk-ng/drivers/flash_k4/Kconfig
```kconfig
# Copyright 2024 NXP
#
# SPDX-License-Identifier: BSD-3-Clause

config MCUX_HAS_COMPONENT_driver.flash_k4
    bool
    default y if MCUX_HW_IP_DriverType_FLASH_K4

config MCUX_COMPONENT_driver.flash_k4
    bool "flash_k4"
    select MCUX_COMPONENT_driver.common
    depends on MCUX_HAS_COMPONENT_driver.flash_k4 || MCUX_HW_IP_DriverType_FMU
```

## mcux/mcux-sdk-ng/drivers/flash_k4_iap/Kconfig
```kconfig
# Copyright 2024 NXP
#
# SPDX-License-Identifier: BSD-3-Clause

config MCUX_HAS_COMPONENT_driver.flash_k4_iap
    bool
    default y if MCUX_HW_IP_DriverType_FLASH_K4_IAP

config MCUX_COMPONENT_driver.flash_k4_iap
    bool "flash_k4_iap"
    select MCUX_COMPONENT_driver.common
    depends on MCUX_HAS_COMPONENT_driver.flash_k4_iap
```

## mcux/mcux-sdk-ng/drivers/flashiap/Kconfig
```kconfig
# Copyright 2024 NXP
#
# SPDX-License-Identifier: BSD-3-Clause

config MCUX_HAS_COMPONENT_driver.flashiap
    bool
    default y if MCUX_HW_IP_DriverType_FLASHIAP

config MCUX_COMPONENT_driver.flashiap
    bool "flashiap"
    select MCUX_COMPONENT_driver.common
    depends on MCUX_HAS_COMPONENT_driver.flashiap
```

## mcux/mcux-sdk-ng/drivers/flexcan/Kconfig
```kconfig
# Copyright 2024 NXP
#
# SPDX-License-Identifier: BSD-3-Clause

config MCUX_HAS_COMPONENT_driver.flexcan_edma
    bool
    default y if MCUX_HAS_COMPONENT_driver.flexcan && (MCUX_HAS_COMPONENT_driver.dma3 || MCUX_HAS_COMPONENT_driver.edma || MCUX_HAS_COMPONENT_driver.edma4)

config MCUX_HAS_COMPONENT_driver.flexcan
    bool
    default y if MCUX_HW_IP_DriverType_FLEXCAN

config MCUX_COMPONENT_driver.flexcan_edma
    bool "flexcan_edma"
    select MCUX_COMPONENT_driver.flexcan
    select MCUX_COMPONENT_driver.dma3 if MCUX_HAS_COMPONENT_driver.dma3
    select MCUX_COMPONENT_driver.edma if MCUX_HAS_COMPONENT_driver.edma
    select MCUX_COMPONENT_driver.edma4 if MCUX_HAS_COMPONENT_driver.edma4
    depends on MCUX_HAS_COMPONENT_driver.flexcan_edma

config MCUX_COMPONENT_driver.flexcan
    bool "flexcan"
    select MCUX_COMPONENT_driver.common
    depends on MCUX_HAS_COMPONENT_driver.flexcan
```

## mcux/mcux-sdk-ng/drivers/flexcomm/Kconfig
```kconfig
# Copyright 2024 NXP
#
# SPDX-License-Identifier: BSD-3-Clause

config MCUX_HAS_COMPONENT_driver.flexcomm
    bool
    default y if MCUX_HW_IP_DriverType_FLEXCOMM

config MCUX_COMPONENT_driver.flexcomm
    bool "flexcomm"
    select MCUX_COMPONENT_driver.common
    depends on MCUX_HAS_COMPONENT_driver.flexcomm

rsource "./usart/Kconfig"
rsource "./spi/Kconfig"
rsource "./i2s/Kconfig"
rsource "./i2c/Kconfig"
```

## mcux/mcux-sdk-ng/drivers/flexcomm/i2c/Kconfig
```kconfig
# Copyright 2024 NXP
#
# SPDX-License-Identifier: BSD-3-Clause

config MCUX_HAS_COMPONENT_driver.flexcomm_i2c_dma
    bool
    default y if MCUX_HAS_COMPONENT_driver.flexcomm_i2c && MCUX_HAS_COMPONENT_driver.lpc_dma

config MCUX_HAS_COMPONENT_driver.flexcomm_i2c
    bool
    default y if MCUX_HW_IP_DriverType_FLEXCOMM_I2C

config MCUX_COMPONENT_driver.flexcomm_i2c_dma
    bool "flexcomm_i2c_dma"
    select MCUX_COMPONENT_driver.flexcomm_i2c
    select MCUX_COMPONENT_driver.lpc_dma
    depends on MCUX_HAS_COMPONENT_driver.flexcomm_i2c_dma

config MCUX_COMPONENT_driver.flexcomm_i2c
    bool "flexcomm_i2c"
    select MCUX_COMPONENT_driver.flexcomm
    select MCUX_COMPONENT_driver.common
    depends on MCUX_HAS_COMPONENT_driver.flexcomm_i2c
```

## mcux/mcux-sdk-ng/drivers/flexcomm/i2s/Kconfig
```kconfig
# Copyright 2024 NXP
#
# SPDX-License-Identifier: BSD-3-Clause

config MCUX_HAS_COMPONENT_driver.flexcomm_i2s_dma
    bool
    default y if MCUX_HAS_COMPONENT_driver.flexcomm_i2s && MCUX_HAS_COMPONENT_driver.lpc_dma

config MCUX_HAS_COMPONENT_driver.flexcomm_i2s
    bool
    default y if MCUX_HW_IP_DriverType_FLEXCOMM_I2S

config MCUX_COMPONENT_driver.flexcomm_i2s_dma
    bool "flexcomm_i2s_dma"
    select MCUX_COMPONENT_driver.flexcomm_i2s
    select MCUX_COMPONENT_driver.lpc_dma
    depends on MCUX_HAS_COMPONENT_driver.flexcomm_i2s_dma

config MCUX_COMPONENT_driver.flexcomm_i2s
    bool "flexcomm_i2s"
    select MCUX_COMPONENT_driver.flexcomm
    select MCUX_COMPONENT_driver.common
    depends on MCUX_HAS_COMPONENT_driver.flexcomm_i2s
```

## mcux/mcux-sdk-ng/drivers/flexcomm/spi/Kconfig
```kconfig
# Copyright 2024 NXP
#
# SPDX-License-Identifier: BSD-3-Clause

config MCUX_HAS_COMPONENT_driver.flexcomm_spi_dma
    bool
    default y if MCUX_HAS_COMPONENT_driver.flexcomm_spi && MCUX_HAS_COMPONENT_driver.lpc_dma

config MCUX_HAS_COMPONENT_driver.flexcomm_spi
    bool
    default y if MCUX_HW_IP_DriverType_FLEXCOMM_SPI

config MCUX_COMPONENT_driver.flexcomm_spi_dma
    bool "flexcomm_spi_dma"
    select MCUX_COMPONENT_driver.flexcomm_spi
    select MCUX_COMPONENT_driver.lpc_dma
    depends on MCUX_HAS_COMPONENT_driver.flexcomm_spi_dma

config MCUX_COMPONENT_driver.flexcomm_spi
    bool "flexcomm_spi"
    select MCUX_COMPONENT_driver.flexcomm
    select MCUX_COMPONENT_driver.common
    depends on MCUX_HAS_COMPONENT_driver.flexcomm_spi
```

## mcux/mcux-sdk-ng/drivers/flexcomm/usart/Kconfig
```kconfig
# Copyright 2024 NXP
#
# SPDX-License-Identifier: BSD-3-Clause

config MCUX_HAS_COMPONENT_driver.flexcomm_usart_dma
    bool
    default y if MCUX_HAS_COMPONENT_driver.flexcomm_usart && MCUX_HAS_COMPONENT_driver.lpc_dma

config MCUX_HAS_COMPONENT_driver.flexcomm_usart
    bool
    default y if MCUX_HW_IP_DriverType_FLEXCOMM_USART

config MCUX_COMPONENT_driver.flexcomm_usart_dma
    bool "flexcomm_usart_dma"
    select MCUX_COMPONENT_driver.flexcomm_usart
    select MCUX_COMPONENT_driver.lpc_dma
    depends on MCUX_HAS_COMPONENT_driver.flexcomm_usart_dma

config MCUX_COMPONENT_driver.flexcomm_usart
    bool "flexcomm_usart"
    select MCUX_COMPONENT_driver.flexcomm
    depends on MCUX_HAS_COMPONENT_driver.flexcomm_usart
```

## mcux/mcux-sdk-ng/drivers/flexio/Kconfig
```kconfig
# Copyright 2024 NXP
#
# SPDX-License-Identifier: BSD-3-Clause

config MCUX_HAS_COMPONENT_driver.flexio
    bool
    default y if MCUX_HW_IP_DriverType_FLEXIO

config MCUX_COMPONENT_driver.flexio
    bool "flexio"
    select MCUX_COMPONENT_driver.common
    depends on MCUX_HAS_COMPONENT_driver.flexio

rsource "./uart/Kconfig"
rsource "./spi/Kconfig"
rsource "./qspi/Kconfig"
rsource "./mculcd/Kconfig"
rsource "./i2s/Kconfig"
rsource "./i2c/Kconfig"
rsource "./camera/Kconfig"
```

## mcux/mcux-sdk-ng/drivers/flexio/camera/Kconfig
```kconfig
# Copyright 2024 NXP
#
# SPDX-License-Identifier: BSD-3-Clause

config MCUX_HAS_COMPONENT_driver.flexio_camera_edma
    bool
    default y if MCUX_HAS_COMPONENT_driver.flexio_camera && MCUX_HAS_COMPONENT_driver.edma

config MCUX_HAS_COMPONENT_driver.flexio_camera
    bool
    default y if MCUX_HW_IP_DriverType_FLEXIO

config MCUX_COMPONENT_driver.flexio_camera_edma
    bool "flexio_camera_edma"
    select MCUX_COMPONENT_driver.flexio_camera
    select MCUX_COMPONENT_driver.edma
    depends on MCUX_HAS_COMPONENT_driver.flexio_camera_edma

config MCUX_COMPONENT_driver.flexio_camera
    bool "flexio_camera"
    select MCUX_COMPONENT_driver.flexio
    depends on MCUX_HAS_COMPONENT_driver.flexio_camera
```

## mcux/mcux-sdk-ng/drivers/flexio/i2c/Kconfig
```kconfig
# Copyright 2024 NXP
#
# SPDX-License-Identifier: BSD-3-Clause

config MCUX_COMPONENT_driver.flexio_i2c_master
    bool "flexio_i2c_master"
    select MCUX_COMPONENT_driver.flexio
    depends on MCUX_HAS_COMPONENT_driver.flexio
```

## mcux/mcux-sdk-ng/drivers/flexio/i2s/Kconfig
```kconfig
# Copyright 2024 NXP
#
# SPDX-License-Identifier: BSD-3-Clause

config MCUX_HAS_COMPONENT_driver.flexio_i2s_dma
    bool
    default y if MCUX_HAS_COMPONENT_driver.flexio && MCUX_HAS_COMPONENT_driver.dma

config MCUX_HAS_COMPONENT_driver.flexio_i2s_edma
    bool
    default y if MCUX_HAS_COMPONENT_driver.flexio && (MCUX_HAS_COMPONENT_driver.edma || MCUX_HAS_COMPONENT_driver.edma4)

config MCUX_COMPONENT_driver.flexio_i2s_dma
    bool "flexio_i2s_dma"
    select MCUX_COMPONENT_driver.flexio_i2s
    select MCUX_COMPONENT_driver.dma
    depends on MCUX_HAS_COMPONENT_driver.flexio_i2s_dma

config MCUX_COMPONENT_driver.flexio_i2s_edma
    bool "flexio_i2s_edma"
    select MCUX_COMPONENT_driver.flexio_i2s
    select MCUX_COMPONENT_driver.edma if MCUX_HAS_COMPONENT_driver.edma
    select MCUX_COMPONENT_driver.edma4 if MCUX_HAS_COMPONENT_driver.edma4
    depends on MCUX_HAS_COMPONENT_driver.flexio_i2s_edma

config MCUX_COMPONENT_driver.flexio_i2s
    bool "flexio_i2s"
    select MCUX_COMPONENT_driver.flexio
    depends on MCUX_HAS_COMPONENT_driver.flexio
```

## mcux/mcux-sdk-ng/drivers/flexio/mculcd/Kconfig
```kconfig
# Copyright 2024 NXP
#
# SPDX-License-Identifier: BSD-3-Clause

config MCUX_HAS_COMPONENT_driver.flexio_mculcd_dma
    bool
    default y if MCUX_HAS_COMPONENT_driver.flexio_mculcd && MCUX_HAS_COMPONENT_driver.dma

config MCUX_HAS_COMPONENT_driver.flexio_mculcd_edma
    bool
    default y if MCUX_HAS_COMPONENT_driver.flexio_mculcd && (MCUX_HAS_COMPONENT_driver.edma || MCUX_HAS_COMPONENT_driver.edma4)

config MCUX_HAS_COMPONENT_driver.flexio_mculcd_smartdma
    bool
    default y if MCUX_HAS_COMPONENT_driver.flexio_mculcd && MCUX_HAS_COMPONENT_driver.smartdma

config MCUX_HAS_COMPONENT_driver.flexio_mculcd
    bool
    default y if MCUX_HW_IP_DriverType_FLEXIO

config MCUX_COMPONENT_driver.flexio_mculcd_dma
    bool "flexio_mculcd_dma"
    select MCUX_COMPONENT_driver.flexio_mculcd
    select MCUX_COMPONENT_driver.dma
    depends on MCUX_HAS_COMPONENT_driver.flexio_mculcd_dma

config MCUX_COMPONENT_driver.flexio_mculcd_edma
    bool "flexio_mculcd_edma"
    select MCUX_COMPONENT_driver.flexio_mculcd
    select MCUX_COMPONENT_driver.edma if MCUX_HAS_COMPONENT_driver.edma
    select MCUX_COMPONENT_driver.edma4 if MCUX_HAS_COMPONENT_driver.edma4
    depends on MCUX_HAS_COMPONENT_driver.flexio_mculcd_edma

config MCUX_COMPONENT_driver.flexio_mculcd_smartdma
    bool "flexio_mculcd_smartdma"
    select MCUX_COMPONENT_driver.flexio_mculcd
    select MCUX_COMPONENT_driver.smartdma
    depends on MCUX_HAS_COMPONENT_driver.flexio_mculcd_smartdma

config MCUX_COMPONENT_driver.flexio_mculcd
    bool "flexio_mculcd"
    select MCUX_COMPONENT_driver.flexio
    depends on MCUX_HAS_COMPONENT_driver.flexio_mculcd
```

## mcux/mcux-sdk-ng/drivers/flexio/qspi/Kconfig
```kconfig
# Copyright 2024 NXP
#
# SPDX-License-Identifier: BSD-3-Clause

config MCUX_COMPONENT_driver.flexio_qspi_smartdma
    bool "flexio_qspi_smartdma"
    select MCUX_COMPONENT_driver.flexio_qspi
    select MCUX_COMPONENT_driver.smartdma
    depends on MCUX_HAS_COMPONENT_driver.flexio
    depends on MCUX_HAS_COMPONENT_driver.smartdma

config MCUX_COMPONENT_driver.flexio_qspi_edma
    bool "flexio_qspi_edma"
    select MCUX_COMPONENT_driver.flexio_qspi
    select MCUX_COMPONENT_driver.dma3 if MCUX_HAS_COMPONENT_driver.dma3
    select MCUX_COMPONENT_driver.edma if MCUX_HAS_COMPONENT_driver.edma
    select MCUX_COMPONENT_driver.edma4 if MCUX_HAS_COMPONENT_driver.edma4
    depends on MCUX_HAS_COMPONENT_driver.flexio

config MCUX_COMPONENT_driver.flexio_qspi
    bool "flexio_qspi"
    select MCUX_COMPONENT_driver.flexio
    depends on MCUX_HAS_COMPONENT_driver.flexio
```

## mcux/mcux-sdk-ng/drivers/flexio/spi/Kconfig
```kconfig
# Copyright 2024 NXP
#
# SPDX-License-Identifier: BSD-3-Clause

config MCUX_HAS_COMPONENT_driver.flexio_spi_dma
    bool
    default y if MCUX_HAS_COMPONENT_driver.flexio && MCUX_HAS_COMPONENT_driver.dma

config MCUX_HAS_COMPONENT_driver.flexio_spi_edma
    bool
    default y if MCUX_HAS_COMPONENT_driver.flexio && (MCUX_HAS_COMPONENT_driver.dma3 || MCUX_HAS_COMPONENT_driver.edma || MCUX_HAS_COMPONENT_driver.edma4)

config MCUX_COMPONENT_driver.flexio_spi_dma
    bool "flexio_spi_dma"
    select MCUX_COMPONENT_driver.flexio_spi
    select MCUX_COMPONENT_driver.dma
    depends on MCUX_HAS_COMPONENT_driver.flexio_spi_dma

config MCUX_COMPONENT_driver.flexio_spi_edma
    bool "flexio_spi_edma"
    select MCUX_COMPONENT_driver.flexio_spi
    select MCUX_COMPONENT_driver.dma3 if MCUX_HAS_COMPONENT_driver.dma3
    select MCUX_COMPONENT_driver.edma if MCUX_HAS_COMPONENT_driver.edma
    select MCUX_COMPONENT_driver.edma4 if MCUX_HAS_COMPONENT_driver.edma4
    depends on MCUX_HAS_COMPONENT_driver.flexio_spi_edma

config MCUX_COMPONENT_driver.flexio_spi
    bool "flexio_spi"
    select MCUX_COMPONENT_driver.flexio
    depends on MCUX_HAS_COMPONENT_driver.flexio
```

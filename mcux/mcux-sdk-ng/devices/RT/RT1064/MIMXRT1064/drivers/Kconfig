## mcux/mcux-sdk-ng/devices/RT/RT1170/MIMXRT1173/Kconfig.chip
```kconfig
# Copyright 2024 NXP
# All rights reserved.
#
# SPDX-License-Identifier: BSD-3-Clause
#

config MCUX_HW_SOC_SERIES_RT
    bool
    default y

config MCUX_HW_SOC_MULTICORE_DEVICE
    bool
    default y

# device related
config MCUX_HW_DEVICE_ID_MIMXRT1173xxxxx
    bool

choice
    prompt "Device MIMXRT1173 Part"
    config MCUX_HW_DEVICE_PART_MIMXRT1173CVM8A
        bool "Device part MIMXRT1173CVM8A"
        select MCUX_HW_DEVICE_ID_MIMXRT1173xxxxx
endchoice

config MCUX_HW_DEVICE_ID
    string
    default "MIMXRT1173xxxxx" if MCUX_HW_DEVICE_ID_MIMXRT1173xxxxx

config MCUX_HW_DEVICE_PART
    string
    default "MIMXRT1173CVM8A" if MCUX_HW_DEVICE_PART_MIMXRT1173CVM8A


# ip information
config MCUX_HW_IP_DriverType_ACMP
    bool
    default y
    depends on MCUX_HW_DEVICE_ID_MIMXRT1173xxxxx

config MCUX_HW_IP_DriverType_ADC_ETC
    bool
    default y
    depends on MCUX_HW_DEVICE_ID_MIMXRT1173xxxxx

config MCUX_HW_IP_DriverType_ANADIG_PMU
    bool
    default y
    depends on MCUX_HW_DEVICE_ID_MIMXRT1173xxxxx

config MCUX_HW_IP_DriverType_AOI
    bool
    default y
    depends on MCUX_HW_DEVICE_ID_MIMXRT1173xxxxx

config MCUX_HW_IP_DriverType_ASRC
    bool
    default y
    depends on MCUX_HW_DEVICE_ID_MIMXRT1173xxxxx

config MCUX_HW_IP_DriverType_CAAM
    bool
    default y
    depends on MCUX_HW_DEVICE_ID_MIMXRT1173xxxxx

config MCUX_HW_IP_DriverType_CAN_WRAPPER
    bool
    default y
    depends on MCUX_HW_DEVICE_ID_MIMXRT1173xxxxx

config MCUX_HW_IP_DriverType_CAU
    bool
    default y
    depends on MCUX_HW_DEVICE_ID_MIMXRT1173xxxxx

config MCUX_HW_IP_DriverType_CCM
    bool
    default y
    depends on MCUX_HW_DEVICE_ID_MIMXRT1173xxxxx

config MCUX_HW_IP_DriverType_CCM_OBS
    bool
    default y
    depends on MCUX_HW_DEVICE_ID_MIMXRT1173xxxxx

config MCUX_HW_IP_DriverType_CDOG
    bool
    default y
    depends on MCUX_HW_DEVICE_ID_MIMXRT1173xxxxx

config MCUX_HW_IP_DriverType_CSI
    bool
    default y
    depends on MCUX_HW_DEVICE_ID_MIMXRT1173xxxxx

config MCUX_HW_IP_DriverType_DAC12
    bool
    default y
    depends on MCUX_HW_DEVICE_ID_MIMXRT1173xxxxx

config MCUX_HW_IP_DriverType_DCDC_2
    bool
    default y
    depends on MCUX_HW_DEVICE_ID_MIMXRT1173xxxxx

config MCUX_HW_IP_DriverType_DCIC
    bool
    default y
    depends on MCUX_HW_DEVICE_ID_MIMXRT1173xxxxx

config MCUX_HW_IP_DriverType_DMAMUX32
    bool
    default y
    depends on MCUX_HW_DEVICE_ID_MIMXRT1173xxxxx

config MCUX_HW_IP_DriverType_DSI_HOST_APB_PKT_IF
    bool
    default y
    depends on MCUX_HW_DEVICE_ID_MIMXRT1173xxxxx

config MCUX_HW_IP_DriverType_DSI_HOST_DPI_INTFC
    bool
    default y
    depends on MCUX_HW_DEVICE_ID_MIMXRT1173xxxxx

config MCUX_HW_IP_DriverType_DSI_HOST_NXP_FDSOI28_DPHY_INTFC
    bool
    default y
    depends on MCUX_HW_DEVICE_ID_MIMXRT1173xxxxx

config MCUX_HW_IP_DriverType_EDMA
    bool
    default y
    depends on MCUX_HW_DEVICE_ID_MIMXRT1173xxxxx

config MCUX_HW_IP_DriverType_ELCDIF
    bool
    default y
    depends on MCUX_HW_DEVICE_ID_MIMXRT1173xxxxx

config MCUX_HW_IP_DriverType_EMVSIM
    bool
    default y
    depends on MCUX_HW_DEVICE_ID_MIMXRT1173xxxxx

config MCUX_HW_IP_DriverType_ENC
    bool
    default y
    depends on MCUX_HW_DEVICE_ID_MIMXRT1173xxxxx

config MCUX_HW_IP_DriverType_ENET
    bool
    default y
    depends on MCUX_HW_DEVICE_ID_MIMXRT1173xxxxx

config MCUX_HW_IP_DriverType_EWM
    bool
    default y
    depends on MCUX_HW_DEVICE_ID_MIMXRT1173xxxxx

config MCUX_HW_IP_DriverType_FLEXCAN
    bool
    default y
    depends on MCUX_HW_DEVICE_ID_MIMXRT1173xxxxx

config MCUX_HW_IP_DriverType_FLEXIO
    bool
    default y
    depends on MCUX_HW_DEVICE_ID_MIMXRT1173xxxxx

config MCUX_HW_IP_DriverType_FLEXRAM
    bool
    default y
    depends on MCUX_HW_DEVICE_ID_MIMXRT1173xxxxx

config MCUX_HW_IP_DriverType_FLEXSPI
    bool
    default y
    depends on MCUX_HW_DEVICE_ID_MIMXRT1173xxxxx

config MCUX_HW_IP_DriverType_GPC_CPU_CTRL
    bool
    default y
    depends on MCUX_HW_DEVICE_ID_MIMXRT1173xxxxx

config MCUX_HW_IP_DriverType_GPC_SP_CTRL
    bool
    default y
    depends on MCUX_HW_DEVICE_ID_MIMXRT1173xxxxx

config MCUX_HW_IP_DriverType_GPC_STBY_CTRL
    bool
    default y
    depends on MCUX_HW_DEVICE_ID_MIMXRT1173xxxxx

config MCUX_HW_IP_DriverType_GPT
    bool
    default y
    depends on MCUX_HW_DEVICE_ID_MIMXRT1173xxxxx

config MCUX_HW_IP_DriverType_IEE
    bool
    default y
    depends on MCUX_HW_DEVICE_ID_MIMXRT1173xxxxx

config MCUX_HW_IP_DriverType_IEE_APC
    bool
    default y
    depends on MCUX_HW_DEVICE_ID_MIMXRT1173xxxxx

config MCUX_HW_IP_DriverType_IGPIO
    bool
    default y
    depends on MCUX_HW_DEVICE_ID_MIMXRT1173xxxxx

config MCUX_HW_IP_DriverType_IOMUXC
    bool
    default y
    depends on MCUX_HW_DEVICE_ID_MIMXRT1173xxxxx

config MCUX_HW_IP_DriverType_IPS_DOMAIN
    bool
    default y
    depends on MCUX_HW_DEVICE_ID_MIMXRT1173xxxxx

config MCUX_HW_IP_DriverType_KEY_MANAGER
    bool
    default y
    depends on MCUX_HW_DEVICE_ID_MIMXRT1173xxxxx

config MCUX_HW_IP_DriverType_KPP
    bool
    default y
    depends on MCUX_HW_DEVICE_ID_MIMXRT1173xxxxx

config MCUX_HW_IP_DriverType_LCDIFV2
    bool
    default y
    depends on MCUX_HW_DEVICE_ID_MIMXRT1173xxxxx

config MCUX_HW_IP_DriverType_LPADC
    bool
    default y
    depends on MCUX_HW_DEVICE_ID_MIMXRT1173xxxxx

config MCUX_HW_IP_DriverType_LPI2C
    bool
    default y
    depends on MCUX_HW_DEVICE_ID_MIMXRT1173xxxxx

config MCUX_HW_IP_DriverType_LPSPI
    bool
    default y
    depends on MCUX_HW_DEVICE_ID_MIMXRT1173xxxxx

config MCUX_HW_IP_DriverType_LPUART
    bool
    default y
    depends on MCUX_HW_DEVICE_ID_MIMXRT1173xxxxx

config MCUX_HW_IP_DriverType_MCM
    bool
    default y
    depends on MCUX_HW_DEVICE_ID_MIMXRT1173xxxxx

config MCUX_HW_IP_DriverType_MECC64
    bool
    default y
    depends on MCUX_HW_DEVICE_ID_MIMXRT1173xxxxx

config MCUX_HW_IP_DriverType_MEMORY
    bool
    default y
    depends on MCUX_HW_DEVICE_ID_MIMXRT1173xxxxx

config MCUX_HW_IP_DriverType_MIPI_CSI2RX
    bool
    default y
    depends on MCUX_HW_DEVICE_ID_MIMXRT1173xxxxx

config MCUX_HW_IP_DriverType_MIPI_DSI_SPLIT
    bool
    default y
    depends on MCUX_HW_DEVICE_ID_MIMXRT1173xxxxx

config MCUX_HW_IP_DriverType_MU
    bool
    default y
    depends on MCUX_HW_DEVICE_ID_MIMXRT1173xxxxx

config MCUX_HW_IP_DriverType_OCOTP
    bool
    default y
    depends on MCUX_HW_DEVICE_ID_MIMXRT1173xxxxx

config MCUX_HW_IP_DriverType_OTFAD
    bool
    default y
    depends on MCUX_HW_DEVICE_ID_MIMXRT1173xxxxx

config MCUX_HW_IP_DriverType_PDM
    bool
    default y
    depends on MCUX_HW_DEVICE_ID_MIMXRT1173xxxxx

config MCUX_HW_IP_DriverType_PIT
    bool
    default y
    depends on MCUX_HW_DEVICE_ID_MIMXRT1173xxxxx

config MCUX_HW_IP_DriverType_PUF
    bool
    default y
    depends on MCUX_HW_DEVICE_ID_MIMXRT1173xxxxx

config MCUX_HW_IP_DriverType_PWM
    bool
    default y
    depends on MCUX_HW_DEVICE_ID_MIMXRT1173xxxxx

config MCUX_HW_IP_DriverType_PXP
    bool
    default y
    depends on MCUX_HW_DEVICE_ID_MIMXRT1173xxxxx

config MCUX_HW_IP_DriverType_RDC
    bool
    default y
    depends on MCUX_HW_DEVICE_ID_MIMXRT1173xxxxx

config MCUX_HW_IP_DriverType_RDC_SEMAPHORE
    bool
    default y
    depends on MCUX_HW_DEVICE_ID_MIMXRT1173xxxxx

config MCUX_HW_IP_DriverType_RTWDOG
    bool
    default y
    depends on MCUX_HW_DEVICE_ID_MIMXRT1173xxxxx

config MCUX_HW_IP_DriverType_SAI
    bool
    default y
    depends on MCUX_HW_DEVICE_ID_MIMXRT1173xxxxx

config MCUX_HW_IP_DriverType_SCB
    bool
    default y
    depends on MCUX_HW_DEVICE_ID_MIMXRT1173xxxxx

config MCUX_HW_IP_DriverType_SEMA4
    bool
    default y
    depends on MCUX_HW_DEVICE_ID_MIMXRT1173xxxxx

config MCUX_HW_IP_DriverType_SEMC
    bool
    default y
    depends on MCUX_HW_DEVICE_ID_MIMXRT1173xxxxx

config MCUX_HW_IP_DriverType_SNVS
    bool
    default y
    depends on MCUX_HW_DEVICE_ID_MIMXRT1173xxxxx

config MCUX_HW_IP_DriverType_SPDIF
    bool
    default y
    depends on MCUX_HW_DEVICE_ID_MIMXRT1173xxxxx

config MCUX_HW_IP_DriverType_SRC_2
    bool
    default y
    depends on MCUX_HW_DEVICE_ID_MIMXRT1173xxxxx

config MCUX_HW_IP_DriverType_SSARC_HP
    bool
    default y
    depends on MCUX_HW_DEVICE_ID_MIMXRT1173xxxxx

config MCUX_HW_IP_DriverType_SSARC_LP
    bool
    default y
    depends on MCUX_HW_DEVICE_ID_MIMXRT1173xxxxx

config MCUX_HW_IP_DriverType_TMPSNS
    bool
    default y
    depends on MCUX_HW_DEVICE_ID_MIMXRT1173xxxxx

config MCUX_HW_IP_DriverType_TMR_1
    bool
    default y
    depends on MCUX_HW_DEVICE_ID_MIMXRT1173xxxxx

config MCUX_HW_IP_DriverType_USBNC
    bool
    default y
    depends on MCUX_HW_DEVICE_ID_MIMXRT1173xxxxx

config MCUX_HW_IP_DriverType_USB_HOST_DEVICE_EHCI
    bool
    default y
    depends on MCUX_HW_DEVICE_ID_MIMXRT1173xxxxx

config MCUX_HW_IP_DriverType_USB_HSDCD
    bool
    default y
    depends on MCUX_HW_DEVICE_ID_MIMXRT1173xxxxx

config MCUX_HW_IP_DriverType_USB_PHY
    bool
    default y
    depends on MCUX_HW_DEVICE_ID_MIMXRT1173xxxxx

config MCUX_HW_IP_DriverType_USDHC
    bool
    default y
    depends on MCUX_HW_DEVICE_ID_MIMXRT1173xxxxx

config MCUX_HW_IP_DriverType_VIDEO_MUX
    bool
    default y
    depends on MCUX_HW_DEVICE_ID_MIMXRT1173xxxxx

config MCUX_HW_IP_DriverType_WDOG01
    bool
    default y
    depends on MCUX_HW_DEVICE_ID_MIMXRT1173xxxxx

config MCUX_HW_IP_DriverType_XBARA
    bool
    default y
    depends on MCUX_HW_DEVICE_ID_MIMXRT1173xxxxx

config MCUX_HW_IP_DriverType_XBARB
    bool
    default y
    depends on MCUX_HW_DEVICE_ID_MIMXRT1173xxxxx

config MCUX_HW_IP_DriverType_XECC
    bool
    default y
    depends on MCUX_HW_DEVICE_ID_MIMXRT1173xxxxx

config MCUX_HW_IP_DriverType_XRDC2
    bool
    default y
    depends on MCUX_HW_DEVICE_ID_MIMXRT1173xxxxx

config MCUX_HW_IP_DriverType_iomuxc_gpr
    bool
    default y
    depends on MCUX_HW_DEVICE_ID_MIMXRT1173xxxxx

config MCUX_HW_IP_DriverType_iomuxc_lpsr
    bool
    default y
    depends on MCUX_HW_DEVICE_ID_MIMXRT1173xxxxx

config MCUX_HW_IP_DriverType_iomuxc_lpsr_gpr
    bool
    default y
    depends on MCUX_HW_DEVICE_ID_MIMXRT1173xxxxx

config MCUX_HW_IP_DriverType_iomuxc_snvs
    bool
    default y
    depends on MCUX_HW_DEVICE_ID_MIMXRT1173xxxxx

config MCUX_HW_IP_DriverType_iomuxc_snvs_gpr
    bool
    default y
    depends on MCUX_HW_DEVICE_ID_MIMXRT1173xxxxx
```

## mcux/mcux-sdk-ng/devices/RT/RT1170/MIMXRT1173/cm7/Kconfig.chip
```kconfig
# Copyright 2024 NXP
#
# SPDX-License-Identifier: BSD-3-Clause

# core related
config MCUX_HW_CORE
    string
    default "cm7f"

config MCUX_HW_CORE_CM7F
    bool
    default y

config MCUX_HW_CORE_ID
    string
    default "cm7"

config MCUX_HW_CORE_ID_CM7
    bool
    default y

config MCUX_HW_DEVICE_CORE
    string
    default "MIMXRT1173_cm7"

config MCUX_HW_FPU
    string
    default "DP_FPU"

config MCUX_HW_FPU_TYPE
    string
    default "fpv5_dp"

config MCUX_HW_FPV5_DP
    bool
    default y

config MCUX_HW_INT_PRIO_BITS
    int
    default 4

config MCUX_TOOLCHAIN_MCUX_STARTUP
    string
    default "mimxrt1173_cm7"

config MCUX_TOOLCHAIN_LINKER_DEVICE_PREFIX
    string
    default "MIMXRT1173xxxxx_cm7"

config MCUX_TOOLCHAIN_IAR_CPU_IDENTIFIER
    string
    default "MIMXRT1173xxx8_M7"

config MCUX_TOOLCHAIN_MDK_CPU_IDENTIFIER
    string
    default "MIMXRT1173CVM8A:cm7" if MCUX_HW_DEVICE_PART_MIMXRT1173CVM8A

config MCUX_TOOLCHAIN_JLINK_CPU_IDENTIFIER
    string
    default "MIMXRT1173xxxA_M7"
```

## mcux/mcux-sdk-ng/devices/RT/RT1170/MIMXRT1175/cm4/Kconfig.chip
```kconfig
# Copyright 2024 NXP
#
# SPDX-License-Identifier: BSD-3-Clause

# core related
config MCUX_HW_CORE
    string
    default "cm4f"

config MCUX_HW_CORE_CM4F
    bool
    default y

config MCUX_HW_CORE_ID
    string
    default "cm4"

config MCUX_HW_CORE_ID_CM4
    bool
    default y

config MCUX_HW_DEVICE_CORE
    string
    default "MIMXRT1175_cm4"

config MCUX_HW_FPU
    string
    default "SP_FPU"

config MCUX_HW_FPU_TYPE
    string
    default "fpv4_sp"

config MCUX_HW_FPV4_SP
    bool
    default y

config MCUX_HW_INT_PRIO_BITS
    int
    default 4

config MCUX_TOOLCHAIN_MCUX_STARTUP
    string
    default "mimxrt1175_cm4"

config MCUX_TOOLCHAIN_LINKER_DEVICE_PREFIX
    string
    default "MIMXRT1175xxxxx_cm4"

config MCUX_TOOLCHAIN_IAR_CPU_IDENTIFIER
    string
    default "MIMXRT1175xxxA_M4"

config MCUX_TOOLCHAIN_MDK_CPU_IDENTIFIER
    string
    default "MIMXRT1175DVMAA:cm4" if MCUX_HW_DEVICE_PART_MIMXRT1175DVMAA
    default "MIMXRT1175AVM8A:cm4" if MCUX_HW_DEVICE_PART_MIMXRT1175AVM8A
    default "MIMXRT1175CVM8A:cm4" if MCUX_HW_DEVICE_PART_MIMXRT1175CVM8A

config MCUX_TOOLCHAIN_JLINK_CPU_IDENTIFIER
    string
    default "MIMXRT1175xxxA_M4"

config MCUX_HW_IP_DriverType_LMEM
    bool
    default y
    depends on MCUX_HW_DEVICE_ID_MIMXRT1175xxxxx
```

## mcux/mcux-sdk-ng/devices/RT/RT1170/MIMXRT1175/cm7/Kconfig
```kconfig
# Copyright 2024 NXP
#
# SPDX-License-Identifier: BSD-3-Clause


config MCUX_HW_DEVICE_MIMXRT1175_CORE_ID_CM7
    bool
    default y

    imply MCUX_COMPONENT_driver.cache_armv7_m7 if MCUX_PRJSEG_module.device.suite

rsource "Kconfig.chip"
rsource "Kconfig.defconfig"
rsource "../xip/Kconfig"
```

## mcux/mcux-sdk-ng/devices/RT/RT1170/MIMXRT1175/drivers/Kconfig
```kconfig
# Copyright 2024 NXP
#
# SPDX-License-Identifier: BSD-3-Clause



rsource "../../../RT1170/MIMXRT1176/drivers/Kconfig"
```

## mcux/mcux-sdk-ng/devices/RT/RT1170/MIMXRT1176/cm4/Kconfig
```kconfig
# Copyright 2024 NXP
#
# SPDX-License-Identifier: BSD-3-Clause


config MCUX_HW_DEVICE_MIMXRT1176_CORE_ID_CM4
    bool
    default y

    imply MCUX_COMPONENT_driver.cache_lmem if MCUX_PRJSEG_module.device.suite

rsource "Kconfig.chip"
rsource "Kconfig.defconfig"
```

## mcux/mcux-sdk-ng/devices/RT/RT1170/MIMXRT1176/drivers/Kconfig
```kconfig
# Copyright 2024 NXP
#
# SPDX-License-Identifier: BSD-3-Clause

menu "Device specific drivers"
    config MCUX_COMPONENT_driver.clock
        bool "Use driver clock"
        # select MCUX_COMPONENT_driver.common

        if MCUX_COMPONENT_driver.clock

        endif

    config MCUX_COMPONENT_driver.iomuxc
        bool "Use driver iomuxc"
        select MCUX_COMPONENT_driver.common

        if MCUX_COMPONENT_driver.iomuxc

        endif

    config MCUX_COMPONENT_driver.mipi_csi2rx_soc
        bool "Use driver mipi csi2rx"
        select MCUX_COMPONENT_driver.common

        if MCUX_COMPONENT_driver.mipi_csi2rx_soc

        endif

    config MCUX_COMPONENT_driver.mipi_dsi_soc
        bool "Use driver mipi dsi"
        select MCUX_COMPONENT_driver.common

        if MCUX_COMPONENT_driver.mipi_dsi_soc

        endif

    rsource "./anatop_ai/Kconfig"
    rsource "./memory/Kconfig"
    rsource "./nic301/Kconfig"
    rsource "./power/Kconfig"
    rsource "./romapi/Kconfig"
    rsource "./flexram/Kconfig"

endmenu
```

## mcux/mcux-sdk-ng/devices/RT/RT1170/MIMXRT1176/drivers/anatop_ai/Kconfig
```kconfig
# Copyright 2024 NXP
#
# SPDX-License-Identifier: BSD-3-Clause


    config MCUX_COMPONENT_driver.anatop_ai
        bool "Use driver anatop_ai"
        select MCUX_COMPONENT_driver.common

        if MCUX_COMPONENT_driver.anatop_ai

        endif
```

## mcux/mcux-sdk-ng/devices/RT/RT1170/MIMXRT1176/drivers/flexram/Kconfig
```kconfig
# Copyright 2024 NXP
#
# SPDX-License-Identifier: BSD-3-Clause


    config MCUX_COMPONENT_driver.flexram_allocate
        bool "Use driver flexram_allocate"
        select MCUX_COMPONENT_driver.common

        if MCUX_COMPONENT_driver.flexram_allocate

        endif
```

## mcux/mcux-sdk-ng/devices/RT/RT1170/MIMXRT1176/drivers/memory/Kconfig
```kconfig
# Copyright 2024 NXP
#
# SPDX-License-Identifier: BSD-3-Clause


    config MCUX_COMPONENT_driver.memory
        bool "Use driver memory"
        select MCUX_COMPONENT_driver.common

        if MCUX_COMPONENT_driver.memory

        endif
```

## mcux/mcux-sdk-ng/devices/RT/RT1170/MIMXRT1176/drivers/power/Kconfig
```kconfig
# Copyright 2024 NXP
#
# SPDX-License-Identifier: BSD-3-Clause

    config MCUX_COMPONENT_driver.dcdc_2
        bool "Use driver dcdc"
        select MCUX_COMPONENT_driver.common

        if MCUX_COMPONENT_driver.dcdc_2

        endif

    config MCUX_COMPONENT_driver.gpc_xxx_ctrl
        bool "Use driver gpc"
        select MCUX_COMPONENT_driver.common

        if MCUX_COMPONENT_driver.gpc_xxx_ctrl

        endif

    config MCUX_COMPONENT_driver.pgmc
        bool "Use driver pgmc"
        select MCUX_COMPONENT_driver.common

        if MCUX_COMPONENT_driver.pgmc

        endif

    config MCUX_COMPONENT_driver.anadig_pmu
        bool "Use driver pmu"
        # select MCUX_COMPONENT_driver.common

        if MCUX_COMPONENT_driver.anadig_pmu

        endif

    config MCUX_COMPONENT_driver.src_2
        bool "Use driver src"
        select MCUX_COMPONENT_driver.common

        if MCUX_COMPONENT_driver.src_2

        endif
```

## mcux/mcux-sdk-ng/devices/RT/RT1170/MIMXRT1176/drivers/romapi/Kconfig
```kconfig
# Copyright 2024 NXP
#
# SPDX-License-Identifier: BSD-3-Clause


    config MCUX_COMPONENT_driver.romapi
        bool "Use driver ROM API"
        default y
        select MCUX_COMPONENT_driver.common

        if MCUX_COMPONENT_driver.romapi

        endif
```

## mcux/mcux-sdk-ng/devices/RT/RT1180/MIMXRT1181/Kconfig
```kconfig
# Copyright 2024 NXP
# All rights reserved.
#
# SPDX-License-Identifier: BSD-3-Clause

rsource "Kconfig.chip"
rsource "drivers/Kconfig"
rsource "../../../arm/Kconfig.common"
rsource "Kconfig.defconfig"
rsource "xip/Kconfig"

config MCUX_HW_DEVICE_MIMXRT1181
    # bool "Device MIMXRT1181 Configuration"
    bool
    default y

    imply MCUX_COMPONENT_driver.cache_xcache if MCUX_PRJSEG_module.device.suite
```

## mcux/mcux-sdk-ng/devices/RT/RT1180/MIMXRT1181/drivers/Kconfig
```kconfig
# Copyright 2024 NXP
#
# SPDX-License-Identifier: BSD-3-Clause

menu "Device specific drivers"
    rsource "../../../RT1180/MIMXRT1189/drivers/Kconfig_anadig_pmu_1"
    rsource "../../../RT1180/MIMXRT1189/drivers/Kconfig_clock"
    rsource "../../../RT1180/MIMXRT1189/drivers/Kconfig_dcdc_3"
    rsource "../../../RT1180/MIMXRT1189/drivers/Kconfig_edma_soc"
    rsource "../../../RT1180/MIMXRT1189/drivers/Kconfig_ele_base_api"
    rsource "../../../RT1180/MIMXRT1189/drivers/Kconfig_gpc_3"
    rsource "../../../RT1180/MIMXRT1189/drivers/Kconfig_iomuxc"
    rsource "../../../RT1180/MIMXRT1189/drivers/Kconfig_memory"
    rsource "../../../RT1180/MIMXRT1189/drivers/Kconfig_misc"
    rsource "../../../RT1180/MIMXRT1189/drivers/Kconfig_romapi"
    rsource "../../../RT1180/MIMXRT1189/drivers/Kconfig_src_3"
endmenu
```

## mcux/mcux-sdk-ng/devices/RT/RT1180/MIMXRT1181/xip/Kconfig
```kconfig
# Copyright 2024 NXP
#
# SPDX-License-Identifier: BSD-3-Clause

rsource "../../../RT1180/MIMXRT1189/xip/Kconfig"
```

## mcux/mcux-sdk-ng/devices/RT/RT1180/MIMXRT1182/Kconfig.chip
```kconfig
# Copyright 2024 NXP
# All rights reserved.
#
# SPDX-License-Identifier: BSD-3-Clause
#

config MCUX_HW_SOC_SERIES_RT
    bool
    default y

config MCUX_HW_SOC_SINGLECORE_DEVICE
    bool
    default y

# device related
config MCUX_HW_DEVICE_ID_MIMXRT1182xxxxx
    bool

choice MCUX_HW_DEVICE_PART_MIMXRT1182
    prompt "Device MIMXRT1182 Part"
    config MCUX_HW_DEVICE_PART_MIMXRT1182CVP2B
        bool "Device part MIMXRT1182CVP2B"
        select MCUX_HW_DEVICE_ID_MIMXRT1182xxxxx
    config MCUX_HW_DEVICE_PART_MIMXRT1182XVP2B
        bool "Device part MIMXRT1182XVP2B"
        select MCUX_HW_DEVICE_ID_MIMXRT1182xxxxx
endchoice

config MCUX_HW_DEVICE_ID
    string
    default "MIMXRT1182xxxxx" if MCUX_HW_DEVICE_ID_MIMXRT1182xxxxx

config MCUX_HW_DEVICE_PART
    string
    default "MIMXRT1182CVP2B" if MCUX_HW_DEVICE_PART_MIMXRT1182CVP2B
    default "MIMXRT1182XVP2B" if MCUX_HW_DEVICE_PART_MIMXRT1182XVP2B

# core related
config MCUX_HW_CORE
    string
    default "cm33"

config MCUX_HW_CORE_CM33
    bool
    default y

config MCUX_HW_CORE_ID
    string
    default "cm33"

config MCUX_HW_CORE_ID_CM33
    bool
    default y

config MCUX_HW_DEVICE_CORE
    string
    default "MIMXRT1182"

config MCUX_HW_FPU
    string
    default "SP_FPU"

config MCUX_HW_FPU_TYPE
    string
    default "fpv5_sp"

config MCUX_HW_FPV5_SP
    bool
    default y

config MCUX_HW_INT_PRIO_BITS
    int
    default 3

config MCUX_HW_DSP
    bool
    default y
 
config MCUX_HW_SAU
    bool
    default y

config MCUX_TOOLCHAIN_MCUX_STARTUP
    string
    default "mimxrt1182"

config MCUX_TOOLCHAIN_LINKER_DEVICE_PREFIX
    string
    default "MIMXRT1182xxxxx"

config MCUX_TOOLCHAIN_IAR_CPU_IDENTIFIER
    string
    default "MIMXRT1182xxx2"

config MCUX_TOOLCHAIN_MDK_CPU_IDENTIFIER
    string
    default "MIMXRT1182CVP2B" if MCUX_HW_DEVICE_PART_MIMXRT1182CVP2B
    default "MIMXRT1182XVP2B" if MCUX_HW_DEVICE_PART_MIMXRT1182XVP2B

config MCUX_TOOLCHAIN_JLINK_CPU_IDENTIFIER
    string
    default "MIMXRT1182xxx2"

# ip information
config MCUX_HW_IP_DriverType_ACMP
    bool
    default y
    depends on MCUX_HW_DEVICE_ID_MIMXRT1182xxxxx

config MCUX_HW_IP_DriverType_ANADIG_PMU_1
    bool
    default y
    depends on MCUX_HW_DEVICE_ID_MIMXRT1182xxxxx

config MCUX_HW_IP_DriverType_AOI
    bool
    default y
    depends on MCUX_HW_DEVICE_ID_MIMXRT1182xxxxx

config MCUX_HW_IP_DriverType_ARM
    bool
    default y
    depends on MCUX_HW_DEVICE_ID_MIMXRT1182xxxxx

config MCUX_HW_IP_DriverType_ASRC
    bool
    default y
    depends on MCUX_HW_DEVICE_ID_MIMXRT1182xxxxx

config MCUX_HW_IP_DriverType_AXBS
    bool
    default y
    depends on MCUX_HW_DEVICE_ID_MIMXRT1182xxxxx

config MCUX_HW_IP_DriverType_BBNSM
    bool
    default y
    depends on MCUX_HW_DEVICE_ID_MIMXRT1182xxxxx

config MCUX_HW_IP_DriverType_BLK_CTRL_BBSMMIX
    bool
    default y
    depends on MCUX_HW_DEVICE_ID_MIMXRT1182xxxxx

config MCUX_HW_IP_DriverType_BLK_CTRL_NS_AONMIX
    bool
    default y
    depends on MCUX_HW_DEVICE_ID_MIMXRT1182xxxxx

config MCUX_HW_IP_DriverType_BLK_CTRL_S_AONMIX
    bool
    default y
    depends on MCUX_HW_DEVICE_ID_MIMXRT1182xxxxx

config MCUX_HW_IP_DriverType_BLK_CTRL_WAKEUPMIX
    bool
    default y
    depends on MCUX_HW_DEVICE_ID_MIMXRT1182xxxxx

config MCUX_HW_IP_DriverType_CCM
    bool
    default y
    depends on MCUX_HW_DEVICE_ID_MIMXRT1182xxxxx

config MCUX_HW_IP_DriverType_CORE
    bool
    default y
    depends on MCUX_HW_DEVICE_ID_MIMXRT1182xxxxx

config MCUX_HW_IP_DriverType_DAC12
    bool
    default y
    depends on MCUX_HW_DEVICE_ID_MIMXRT1182xxxxx

config MCUX_HW_IP_DriverType_DCDC_3
    bool
    default y
    depends on MCUX_HW_DEVICE_ID_MIMXRT1182xxxxx

config MCUX_HW_IP_DriverType_EDGELOCK
    bool
    default y
    depends on MCUX_HW_DEVICE_ID_MIMXRT1182xxxxx

config MCUX_HW_IP_DriverType_EDMA3
    bool
    default y
    depends on MCUX_HW_DEVICE_ID_MIMXRT1182xxxxx

config MCUX_HW_IP_DriverType_EDMA4
    bool
    default y
    depends on MCUX_HW_DEVICE_ID_MIMXRT1182xxxxx

config MCUX_HW_IP_DriverType_EIM_EICHD
    bool
    default y
    depends on MCUX_HW_DEVICE_ID_MIMXRT1182xxxxx

config MCUX_HW_IP_DriverType_EQDC
    bool
    default y
    depends on MCUX_HW_DEVICE_ID_MIMXRT1182xxxxx

config MCUX_HW_IP_DriverType_ERM_1
    bool
    default y
    depends on MCUX_HW_DEVICE_ID_MIMXRT1182xxxxx

config MCUX_HW_IP_DriverType_ETHERCAT
    bool
    default y
    depends on MCUX_HW_DEVICE_ID_MIMXRT1182xxxxx

config MCUX_HW_IP_DriverType_EWM
    bool
    default y
    depends on MCUX_HW_DEVICE_ID_MIMXRT1182xxxxx

config MCUX_HW_IP_DriverType_FLEXCAN
    bool
    default y
    depends on MCUX_HW_DEVICE_ID_MIMXRT1182xxxxx

config MCUX_HW_IP_DriverType_FLEXIO
    bool
    default y
    depends on MCUX_HW_DEVICE_ID_MIMXRT1182xxxxx

config MCUX_HW_IP_DriverType_FLEXSPI
    bool
    default y
    depends on MCUX_HW_DEVICE_ID_MIMXRT1182xxxxx

config MCUX_HW_IP_DriverType_FLEXSPI_SLV
    bool
    default y
    depends on MCUX_HW_DEVICE_ID_MIMXRT1182xxxxx

config MCUX_HW_IP_DriverType_GPC_3
    bool
    default y
    depends on MCUX_HW_DEVICE_ID_MIMXRT1182xxxxx

config MCUX_HW_IP_DriverType_GPT
    bool
    default y
    depends on MCUX_HW_DEVICE_ID_MIMXRT1182xxxxx

config MCUX_HW_IP_DriverType_I3C
    bool
    default y
    depends on MCUX_HW_DEVICE_ID_MIMXRT1182xxxxx

config MCUX_HW_IP_DriverType_IEE
    bool
    default y
    depends on MCUX_HW_DEVICE_ID_MIMXRT1182xxxxx

config MCUX_HW_IP_DriverType_IEE_APC
    bool
    default y
    depends on MCUX_HW_DEVICE_ID_MIMXRT1182xxxxx

config MCUX_HW_IP_DriverType_IERC_IERB
    bool
    default y
    depends on MCUX_HW_DEVICE_ID_MIMXRT1182xxxxx

config MCUX_HW_IP_DriverType_IERC_PCI
    bool
    default y
    depends on MCUX_HW_DEVICE_ID_MIMXRT1182xxxxx

config MCUX_HW_IP_DriverType_IOMUXC
    bool
    default y
    depends on MCUX_HW_DEVICE_ID_MIMXRT1182xxxxx

config MCUX_HW_IP_DriverType_IOMUXC_AON
    bool
    default y
    depends on MCUX_HW_DEVICE_ID_MIMXRT1182xxxxx

config MCUX_HW_IP_DriverType_JTAGC
    bool
    default y
    depends on MCUX_HW_DEVICE_ID_MIMXRT1182xxxxx

config MCUX_HW_IP_DriverType_KPP
    bool
    default y
    depends on MCUX_HW_DEVICE_ID_MIMXRT1182xxxxx

config MCUX_HW_IP_DriverType_LOGIC
    bool
    default y
    depends on MCUX_HW_DEVICE_ID_MIMXRT1182xxxxx

config MCUX_HW_IP_DriverType_LPADC
    bool
    default y
    depends on MCUX_HW_DEVICE_ID_MIMXRT1182xxxxx

config MCUX_HW_IP_DriverType_LPI2C
    bool
    default y
    depends on MCUX_HW_DEVICE_ID_MIMXRT1182xxxxx

config MCUX_HW_IP_DriverType_LPIT
    bool
    default y
    depends on MCUX_HW_DEVICE_ID_MIMXRT1182xxxxx

config MCUX_HW_IP_DriverType_LPSPI
    bool
    default y
    depends on MCUX_HW_DEVICE_ID_MIMXRT1182xxxxx

config MCUX_HW_IP_DriverType_LPTMR
    bool
    default y
    depends on MCUX_HW_DEVICE_ID_MIMXRT1182xxxxx

config MCUX_HW_IP_DriverType_LPUART
    bool
    default y
    depends on MCUX_HW_DEVICE_ID_MIMXRT1182xxxxx

config MCUX_HW_IP_DriverType_M33_CACHE_MCM
    bool
    default y
    depends on MCUX_HW_DEVICE_ID_MIMXRT1182xxxxx

config MCUX_HW_IP_DriverType_MECC64
    bool
    default y
    depends on MCUX_HW_DEVICE_ID_MIMXRT1182xxxxx

config MCUX_HW_IP_DriverType_MEMORY
    bool
    default y
    depends on MCUX_HW_DEVICE_ID_MIMXRT1182xxxxx

config MCUX_HW_IP_DriverType_MOTOR
    bool
    default y
    depends on MCUX_HW_DEVICE_ID_MIMXRT1182xxxxx

config MCUX_HW_IP_DriverType_MSGINTR
    bool
    default y
    depends on MCUX_HW_DEVICE_ID_MIMXRT1182xxxxx

config MCUX_HW_IP_DriverType_MU_1
    bool
    default y
    depends on MCUX_HW_DEVICE_ID_MIMXRT1182xxxxx

config MCUX_HW_IP_DriverType_NETC
    bool
    default y
    depends on MCUX_HW_DEVICE_ID_MIMXRT1182xxxxx

config MCUX_HW_IP_DriverType_NETC_tmr
    bool
    default y
    depends on MCUX_HW_DEVICE_ID_MIMXRT1182xxxxx

config MCUX_HW_IP_DriverType_NVIC
    bool
    default y
    depends on MCUX_HW_DEVICE_ID_MIMXRT1182xxxxx

config MCUX_HW_IP_DriverType_OCOTP_FSB
    bool
    default y
    depends on MCUX_HW_DEVICE_ID_MIMXRT1182xxxxx

config MCUX_HW_IP_DriverType_OSC_RC_400M
    bool
    default y
    depends on MCUX_HW_DEVICE_ID_MIMXRT1182xxxxx

config MCUX_HW_IP_DriverType_OTFAD
    bool
    default y
    depends on MCUX_HW_DEVICE_ID_MIMXRT1182xxxxx

config MCUX_HW_IP_DriverType_PDM
    bool
    default y
    depends on MCUX_HW_DEVICE_ID_MIMXRT1182xxxxx

config MCUX_HW_IP_DriverType_PHY_LDO
    bool
    default y
    depends on MCUX_HW_DEVICE_ID_MIMXRT1182xxxxx

config MCUX_HW_IP_DriverType_PLL
    bool
    default y
    depends on MCUX_HW_DEVICE_ID_MIMXRT1182xxxxx

config MCUX_HW_IP_DriverType_PWM
    bool
    default y
    depends on MCUX_HW_DEVICE_ID_MIMXRT1182xxxxx

config MCUX_HW_IP_DriverType_RGPIO
    bool
    default y
    depends on MCUX_HW_DEVICE_ID_MIMXRT1182xxxxx

config MCUX_HW_IP_DriverType_RTWDOG
    bool
    default y
    depends on MCUX_HW_DEVICE_ID_MIMXRT1182xxxxx

config MCUX_HW_IP_DriverType_S3MU
    bool
    default y
    depends on MCUX_HW_DEVICE_ID_MIMXRT1182xxxxx

config MCUX_HW_IP_DriverType_SAFETY_CLK_MON
    bool
    default y
    depends on MCUX_HW_DEVICE_ID_MIMXRT1182xxxxx

config MCUX_HW_IP_DriverType_SAI
    bool
    default y
    depends on MCUX_HW_DEVICE_ID_MIMXRT1182xxxxx

config MCUX_HW_IP_DriverType_SCB
    bool
    default y
    depends on MCUX_HW_DEVICE_ID_MIMXRT1182xxxxx

config MCUX_HW_IP_DriverType_SEMA42
    bool
    default y
    depends on MCUX_HW_DEVICE_ID_MIMXRT1182xxxxx

config MCUX_HW_IP_DriverType_SPDIF
    bool
    default y
    depends on MCUX_HW_DEVICE_ID_MIMXRT1182xxxxx

config MCUX_HW_IP_DriverType_SRAMC
    bool
    default y
    depends on MCUX_HW_DEVICE_ID_MIMXRT1182xxxxx

config MCUX_HW_IP_DriverType_SRC_3
    bool
    default y
    depends on MCUX_HW_DEVICE_ID_MIMXRT1182xxxxx

config MCUX_HW_IP_DriverType_SYSPM
    bool
    default y
    depends on MCUX_HW_DEVICE_ID_MIMXRT1182xxxxx

config MCUX_HW_IP_DriverType_TMPSNS
    bool
    default y
    depends on MCUX_HW_DEVICE_ID_MIMXRT1182xxxxx

config MCUX_HW_IP_DriverType_TMR_1
    bool
    default y
    depends on MCUX_HW_DEVICE_ID_MIMXRT1182xxxxx

config MCUX_HW_IP_DriverType_TPM
    bool
    default y
    depends on MCUX_HW_DEVICE_ID_MIMXRT1182xxxxx

config MCUX_HW_IP_DriverType_TRDC
    bool
    default y
    depends on MCUX_HW_DEVICE_ID_MIMXRT1182xxxxx

config MCUX_HW_IP_DriverType_TRIGGER_SYNC
    bool
    default y
    depends on MCUX_HW_DEVICE_ID_MIMXRT1182xxxxx

config MCUX_HW_IP_DriverType_TSTMR
    bool
    default y
    depends on MCUX_HW_DEVICE_ID_MIMXRT1182xxxxx

config MCUX_HW_IP_DriverType_USB_HSDCD
    bool
    default y
    depends on MCUX_HW_DEVICE_ID_MIMXRT1182xxxxx

config MCUX_HW_IP_DriverType_USDHC
    bool
    default y
    depends on MCUX_HW_DEVICE_ID_MIMXRT1182xxxxx

config MCUX_HW_IP_DriverType_VMBANDGAP
    bool
    default y
    depends on MCUX_HW_DEVICE_ID_MIMXRT1182xxxxx

config MCUX_HW_IP_DriverType_VREF_2
    bool
    default y
    depends on MCUX_HW_DEVICE_ID_MIMXRT1182xxxxx

config MCUX_HW_IP_DriverType_XBAR_DSC
    bool
    default y
    depends on MCUX_HW_DEVICE_ID_MIMXRT1182xxxxx

config MCUX_HW_IP_DriverType_XCACHE
    bool
    default y
    depends on MCUX_HW_DEVICE_ID_MIMXRT1182xxxxx

config MCUX_HW_IP_DriverType_SYSCTR
    bool
    default y
    depends on MCUX_HW_DEVICE_ID_MIMXRT1189xxxxx
```

## mcux/mcux-sdk-ng/devices/RT/RT1180/MIMXRT1187/cm33/Kconfig
```kconfig
# Copyright 2024 NXP
#
# SPDX-License-Identifier: BSD-3-Clause


config MCUX_HW_DEVICE_MIMXRT1187_CORE_ID_CM33
    bool
    default y

    imply MCUX_COMPONENT_driver.cache_xcache if MCUX_PRJSEG_module.device.suite

rsource "Kconfig.chip"
rsource "Kconfig.defconfig"
rsource "../xip/Kconfig"
```

## mcux/mcux-sdk-ng/devices/RT/RT1064/MIMXRT1064/drivers/Kconfig
```kconfig
# Copyright 2024 NXP
#
# SPDX-License-Identifier: BSD-3-Clause

menu "Device specific drivers"
    config MCUX_COMPONENT_driver.clock
        bool "Use driver clock"
        # select MCUX_COMPONENT_driver.common

        if MCUX_COMPONENT_driver.clock

        endif

    config MCUX_COMPONENT_driver.iomuxc
        bool "Use driver iomuxc"
        select MCUX_COMPONENT_driver.common

        if MCUX_COMPONENT_driver.iomuxc

        endif

    rsource "../../../RT1050/MIMXRT1052/drivers/flexram/Kconfig"
    rsource "../../../RT1060/MIMXRT1062/drivers/romapi/Kconfig"
    rsource "../../../RT1060/MIMXRT1062/drivers/nic301/Kconfig"
endmenu
```

## mcux/mcux-sdk-ng/devices/RT/RT1064/MIMXRT1064/xip/Kconfig
```kconfig
# Copyright 2024 NXP
#
# SPDX-License-Identifier: BSD-3-Clause

menu "Device Boot Header"
    config MCUX_COMPONENT_device.boot_header
        bool "Use device boot header"
endmenu
```

## mcux/mcux-sdk-ng/devices/RT/RT1160/MIMXRT1165/cm7/Kconfig.chip
```kconfig
# Copyright 2024 NXP
#
# SPDX-License-Identifier: BSD-3-Clause

# core related
config MCUX_HW_CORE
    string
    default "cm7f"

config MCUX_HW_CORE_CM7F
    bool
    default y

config MCUX_HW_CORE_ID
    string
    default "cm7"

config MCUX_HW_CORE_ID_CM7
    bool
    default y

config MCUX_HW_DEVICE_CORE
    string
    default "MIMXRT1165_cm7"

config MCUX_HW_FPU
    string
    default "DP_FPU"

config MCUX_HW_FPU_TYPE
    string
    default "fpv5_dp"

config MCUX_HW_FPV5_DP
    bool
    default y

config MCUX_HW_INT_PRIO_BITS
    int
    default 4

config MCUX_TOOLCHAIN_MCUX_STARTUP
    string
    default "mimxrt1165_cm7"

config MCUX_TOOLCHAIN_LINKER_DEVICE_PREFIX
    string
    default "MIMXRT1165xxxxx_cm7"

config MCUX_TOOLCHAIN_IAR_CPU_IDENTIFIER
    string
    default "MIMXRT1165xxx6_M7"

config MCUX_TOOLCHAIN_MDK_CPU_IDENTIFIER
    string
    default "MIMXRT1165DVM6A:cm7" if MCUX_HW_DEVICE_PART_MIMXRT1165DVM6A
    default "MIMXRT1165CVM5A:cm7" if MCUX_HW_DEVICE_PART_MIMXRT1165CVM5A
    default "MIMXRT1165XVM5A:cm7" if MCUX_HW_DEVICE_PART_MIMXRT1165XVM5A

config MCUX_TOOLCHAIN_JLINK_CPU_IDENTIFIER
    string
    default "MIMXRT1165xxx6_M7"
```

## mcux/mcux-sdk-ng/devices/RT/RT1160/MIMXRT1165/drivers/Kconfig
```kconfig
# Copyright 2024 NXP
#
# SPDX-License-Identifier: BSD-3-Clause



rsource "../../../RT1160/MIMXRT1166/drivers/Kconfig"
```

## mcux/mcux-sdk-ng/devices/RT/RT1160/MIMXRT1166/cm4/Kconfig.chip
```kconfig
# Copyright 2024 NXP
#
# SPDX-License-Identifier: BSD-3-Clause

# core related
config MCUX_HW_CORE
    string
    default "cm4f"

config MCUX_HW_CORE_CM4F
    bool
    default y

config MCUX_HW_CORE_ID
    string
    default "cm4"

config MCUX_HW_CORE_ID_CM4
    bool
    default y

config MCUX_HW_DEVICE_CORE
    string
    default "MIMXRT1166_cm4"

config MCUX_HW_FPU
    string
    default "SP_FPU"

config MCUX_HW_FPU_TYPE
    string
    default "fpv4_sp"

config MCUX_HW_FPV4_SP
    bool
    default y

config MCUX_HW_INT_PRIO_BITS
    int
    default 4

config MCUX_TOOLCHAIN_MCUX_STARTUP
    string
    default "mimxrt1166_cm4"

config MCUX_TOOLCHAIN_LINKER_DEVICE_PREFIX
    string
    default "MIMXRT1166xxxxx_cm4"

config MCUX_TOOLCHAIN_IAR_CPU_IDENTIFIER
    string
    default "MIMXRT1166xxx6_M4"

config MCUX_TOOLCHAIN_MDK_CPU_IDENTIFIER
    string
    default "MIMXRT1166DVM6A:cm4" if MCUX_HW_DEVICE_PART_MIMXRT1166DVM6A
    default "MIMXRT1166CVM5A:cm4" if MCUX_HW_DEVICE_PART_MIMXRT1166CVM5A
    default "MIMXRT1166XVM5A:cm4" if MCUX_HW_DEVICE_PART_MIMXRT1166XVM5A

config MCUX_TOOLCHAIN_JLINK_CPU_IDENTIFIER
    string
    default "MIMXRT1166xxx6_M4"

config MCUX_HW_IP_DriverType_LMEM
    bool
    default y
    depends on MCUX_HW_DEVICE_ID_MIMXRT1166xxxxx
```

## mcux/mcux-sdk-ng/devices/RT/RT1160/MIMXRT1166/cm7/Kconfig.chip
```kconfig
# Copyright 2024 NXP
#
# SPDX-License-Identifier: BSD-3-Clause

# core related
config MCUX_HW_CORE
    string
    default "cm7f"

config MCUX_HW_CORE_CM7F
    bool
    default y

config MCUX_HW_CORE_ID
    string
    default "cm7"

config MCUX_HW_CORE_ID_CM7
    bool
    default y

config MCUX_HW_DEVICE_CORE
    string
    default "MIMXRT1166_cm7"

config MCUX_HW_FPU
    string
    default "DP_FPU"

config MCUX_HW_FPU_TYPE
    string
    default "fpv5_dp"

config MCUX_HW_FPV5_DP
    bool
    default y

config MCUX_HW_INT_PRIO_BITS
    int
    default 4

config MCUX_TOOLCHAIN_MCUX_STARTUP
    string
    default "mimxrt1166_cm7"

config MCUX_TOOLCHAIN_LINKER_DEVICE_PREFIX
    string
    default "MIMXRT1166xxxxx_cm7"

config MCUX_TOOLCHAIN_IAR_CPU_IDENTIFIER
    string
    default "MIMXRT1166xxx6_M7"

config MCUX_TOOLCHAIN_MDK_CPU_IDENTIFIER
    string
    default "MIMXRT1166DVM6A:cm7" if MCUX_HW_DEVICE_PART_MIMXRT1166DVM6A
    default "MIMXRT1166CVM5A:cm7" if MCUX_HW_DEVICE_PART_MIMXRT1166CVM5A
    default "MIMXRT1166XVM5A:cm7" if MCUX_HW_DEVICE_PART_MIMXRT1166XVM5A

config MCUX_TOOLCHAIN_JLINK_CPU_IDENTIFIER
    string
    default "MIMXRT1166xxx6_M7"
```

## mcux/mcux-sdk-ng/devices/RT/RT1160/MIMXRT1166/drivers/Kconfig
```kconfig
# Copyright 2024 NXP
#
# SPDX-License-Identifier: BSD-3-Clause

menu "Device specific drivers"
    config MCUX_COMPONENT_driver.clock
        bool "Use driver clock"
        # select MCUX_COMPONENT_driver.common

        if MCUX_COMPONENT_driver.clock

        endif

    config MCUX_COMPONENT_driver.iomuxc
        bool "Use driver iomuxc"
        select MCUX_COMPONENT_driver.common

        if MCUX_COMPONENT_driver.iomuxc

        endif

    config MCUX_COMPONENT_driver.mipi_csi2rx_soc
        bool "Use driver mipi csi2rx"
        select MCUX_COMPONENT_driver.common

        if MCUX_COMPONENT_driver.mipi_csi2rx_soc

        endif

    config MCUX_COMPONENT_driver.mipi_dsi_soc
        bool "Use driver mipi dsi"
        select MCUX_COMPONENT_driver.common

        if MCUX_COMPONENT_driver.mipi_dsi_soc

        endif

    rsource "../../../RT1170/MIMXRT1176/drivers/anatop_ai/Kconfig"
    rsource "../../../RT1170/MIMXRT1176/drivers/memory/Kconfig"
    rsource "../../../RT1170/MIMXRT1176/drivers/nic301/Kconfig"
    rsource "../../../RT1170/MIMXRT1176/drivers/power/Kconfig"
    rsource "./romapi/Kconfig"
    rsource "./flexram/Kconfig"

endmenu
```

## mcux/mcux-sdk-ng/devices/RT/RT1170/MIMXRT1173/Kconfig
```kconfig
# Copyright 2024 NXP
# All rights reserved.
#
# SPDX-License-Identifier: BSD-3-Clause

# rsource "${core_id}/Kconfig"
rsource "Kconfig.chip"
rsource "drivers/Kconfig"
rsource "../../../arm/Kconfig.common"
rsource "Kconfig.defconfig"

config MCUX_HW_DEVICE_MIMXRT1173
    # bool "Device MIMXRT1173 Configuration"
    bool
    default y
```

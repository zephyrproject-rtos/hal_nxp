## mcux/mcux-sdk-ng/devices/RT/RT700/MIMXRT798S/cm33_core0/Kconfig.chip
```kconfig
# Copyright 2024 NXP
# All rights reserved.
#
# SPDX-License-Identifier: BSD-3-Clause
# core related
config MCUX_HW_CORE
    string
    default "cm33"

config MCUX_HW_CORE_CM33
    bool
    default y

config MCUX_HW_CORE_ID
    string
    default "cm33_core0"

config MCUX_HW_CORE_ID_CM33_CORE0
    bool
    default y

config MCUX_HW_DEVICE_CORE
    string
    default "MIMXRT798S_cm33_core0"

config MCUX_HW_FPU
    string
    default "SP_FPU"

config MCUX_HW_FPU_TYPE
    string
    default "fpv5_sp"

config MCUX_HW_FPV5_SP
    bool
    default y

config MCUX_HW_INT_PRIO_BITS
    int
    default 3

config MCUX_HW_DSP
    bool
    default y

config MCUX_HW_SAU
    bool
    default y

config MCUX_HW_SOC_SERIES_RT
    bool
    default y

# For chipmodel generated files
config MCUX_TOOLCHAIN_LINKER_DEVICE_PREFIX
    string
    default "MIMXRT798Sxxxx_cm33_core0" if MCUX_HW_DEVICE_ID_MIMXRT798S

config MCUX_TOOLCHAIN_MCUX_STARTUP
    string
    default "mimxrt798s_cm33_core0"

# Toolchain related

config MCUX_TOOLCHAIN_IAR_CPU_IDENTIFIER
    string
    default "MIMXRT798S_M33_0" if MCUX_HW_DEVICE_ID_MIMXRT798S

config MCUX_TOOLCHAIN_MDK_CPU_IDENTIFIER
    string
    default "MIMXRT798SGFOA:cm33_core0" if MCUX_HW_DEVICE_PART_MIMXRT798SGFOA
    default "MIMXRT798SGAWAR:cm33_core0" if MCUX_HW_DEVICE_PART_MIMXRT798SGAWAR

config MCUX_TOOLCHAIN_JLINK_CPU_IDENTIFIER
    string
    default "MIMXRT798S_M33_0"
```

## mcux/mcux-sdk-ng/devices/RT/RT700/MIMXRT798S/cm33_core1/Kconfig
```kconfig
# Copyright 2024 NXP
# All rights reserved.
#
# SPDX-License-Identifier: BSD-3-Clause

config MCUX_HW_DEVICE_MIMXRT798S_CORE_ID_cm33_core1
    bool
    default y

rsource "Kconfig.chip"
rsource "../../../../arm/Kconfig.common"
```

## mcux/mcux-sdk-ng/devices/RT/RT600/MIMXRT685S/hifi4/Kconfig.chip
```kconfig
# Copyright 2024 NXP
# All rights reserved.
#
# SPDX-License-Identifier: BSD-3-Clause
# core related
config MCUX_HW_CORE
    string
    default "dsp"

config MCUX_HW_CORE_DSP
    bool
    default y

config MCUX_HW_CORE_ID
    string
    default "hifi4"

config MCUX_HW_CORE_ID_HIFI4
    bool
    default y

config MCUX_HW_DEVICE_CORE
    string
    default "MIMXRT685S_dsp"

config MCUX_HW_SOC_SERIES_RT
    bool
    default y

# For chipmodel generated files
config MCUX_TOOLCHAIN_LINKER_DEVICE_PREFIX
    string
    default "MIMXRT685S_hifi4" if MCUX_HW_DEVICE_ID_MIMXRT685S

config MCUX_TOOLCHAIN_MCUX_STARTUP
    string
    default "mimxrt685s_hifi4"

# Toolchain related

config MCUX_TOOLCHAIN_IAR_CPU_IDENTIFIER
    string
    default "MIMXRT685S_hifi4" if MCUX_HW_DEVICE_ID_MIMXRT685S

config MCUX_TOOLCHAIN_MDK_CPU_IDENTIFIER
    string
    default "MIMXRT685SFVKB:hifi4" if MCUX_HW_DEVICE_PART_MIMXRT685SFVKB
    default "MIMXRT685SFFOB:hifi4" if MCUX_HW_DEVICE_PART_MIMXRT685SFFOB
    default "MIMXRT685SFAWBR:hifi4" if MCUX_HW_DEVICE_PART_MIMXRT685SFAWBR
```

## mcux/mcux-sdk-ng/devices/RT/RT700/MIMXRT735S/cm33_core0/Kconfig.chip
```kconfig
# Copyright 2024 NXP
# All rights reserved.
#
# SPDX-License-Identifier: BSD-3-Clause
# core related
config MCUX_HW_CORE
    string
    default "cm33"

config MCUX_HW_CORE_CM33
    bool
    default y

config MCUX_HW_CORE_ID
    string
    default "cm33_core0"

config MCUX_HW_CORE_ID_CM33_CORE0
    bool
    default y

config MCUX_HW_DEVICE_CORE
    string
    default "MIMXRT735S_cm33_core0"

config MCUX_HW_FPU
    string
    default "SP_FPU"

config MCUX_HW_FPU_TYPE
    string
    default "fpv5_sp"

config MCUX_HW_FPV5_SP
    bool
    default y

config MCUX_HW_INT_PRIO_BITS
    int
    default 3

config MCUX_HW_DSP
    bool
    default y

config MCUX_HW_SAU
    bool
    default y

config MCUX_HW_SOC_SERIES_RT
    bool
    default y

# For chipmodel generated files
config MCUX_TOOLCHAIN_LINKER_DEVICE_PREFIX
    string
    default "MIMXRT735Sxxxx_cm33_core0" if MCUX_HW_DEVICE_ID_MIMXRT735S

config MCUX_TOOLCHAIN_MCUX_STARTUP
    string
    default "mimxrt735s_cm33_core0"

# Toolchain related

config MCUX_TOOLCHAIN_IAR_CPU_IDENTIFIER
    string
    default "MIMXRT735S_M33_0" if MCUX_HW_DEVICE_ID_MIMXRT735S

config MCUX_TOOLCHAIN_MDK_CPU_IDENTIFIER
    string
    default "MIMXRT735SGFOA:cm33_core0" if MCUX_HW_DEVICE_PART_MIMXRT735SGFOA
    default "MIMXRT735SGAWAR:cm33_core0" if MCUX_HW_DEVICE_PART_MIMXRT735SGAWAR

config MCUX_TOOLCHAIN_JLINK_CPU_IDENTIFIER
    string
    default "MIMXRT735S_M33_0"
```

## mcux/mcux-sdk-ng/devices/RT/RT700/MIMXRT735S/drivers/Kconfig
```kconfig
# Copyright 2024 NXP
#
# SPDX-License-Identifier: BSD-3-Clause

menu "Device specific drivers configuration"

    rsource "../../MIMXRT798S/drivers/Kconfig_clock"
    rsource "../../MIMXRT798S/drivers/Kconfig_dsp"
    rsource "../../MIMXRT798S/drivers/Kconfig_edma_soc"
    rsource "../../MIMXRT798S/drivers/Kconfig_ezhv"
    rsource "../../MIMXRT798S/drivers/Kconfig_inputmux_connections"
    rsource "../../MIMXRT798S/drivers/Kconfig_iopctl_soc"
    rsource "../../MIMXRT798S/drivers/Kconfig_power"
    rsource "../../MIMXRT798S/drivers/Kconfig_reset"
    rsource "../../MIMXRT798S/drivers/Kconfig_romapi"
endmenu
```

## mcux/mcux-sdk-ng/devices/RT/RT700/MIMXRT735S/ezhv/Kconfig
```kconfig
# Copyright 2024 NXP
#
# SPDX-License-Identifier: BSD-3-Clause

config MCUX_HW_DEVICE_MIMXRT735S_CORE_ID_ezhv
    bool
    default y

rsource "Kconfig.chip"
rsource "../../../../ezhv/Kconfig.common"
```

## mcux/mcux-sdk-ng/devices/RT/RT700/MIMXRT735S/ezhv/Kconfig.chip
```kconfig
# Copyright 2024 NXP
#
# SPDX-License-Identifier: BSD-3-Clause

# core related
config MCUX_HW_CORE
    string
    default "ezhv"

config MCUX_HW_CORE_EZHV
    bool
    default y

config MCUX_HW_CORE_ID
    string
    default "ezhv"

config MCUX_HW_CORE_ID_EZHV
    bool
    default y

config MCUX_HW_DEVICE_CORE
    string
    default "MIMXRT735S_ezhv"

config MCUX_HW_SOC_SERIES_RT
    bool
    default y

# For chipmodel generated files
config MCUX_TOOLCHAIN_LINKER_DEVICE_PREFIX
    string
    default "MIMXRT735S_ezhv" if MCUX_HW_DEVICE_ID_MIMXRT735S

config MCUX_TOOLCHAIN_MCUX_STARTUP
    string
    default "mimxrt735s_ezhv"

# Toolchain related

config MCUX_TOOLCHAIN_IAR_CPU_IDENTIFIER
    string
    default "MIMXRT735S_ezhv" if MCUX_HW_DEVICE_ID_MIMXRT735S

config MCUX_TOOLCHAIN_MDK_CPU_IDENTIFIER
    string
    default "MIMXRT735SGFOA:ezhv" if MCUX_HW_DEVICE_PART_MIMXRT735SGFOA
    default "MIMXRT735SGAWAR:ezhv" if MCUX_HW_DEVICE_PART_MIMXRT735SGAWAR
```

## mcux/mcux-sdk-ng/devices/RT/RT700/MIMXRT735S/hifi1/Kconfig.chip
```kconfig
# Copyright 2024 NXP
# All rights reserved.
#
# SPDX-License-Identifier: BSD-3-Clause
# core related
config MCUX_HW_CORE
    string
    default "dsp"

config MCUX_HW_CORE_DSP
    bool
    default y

config MCUX_HW_CORE_ID
    string
    default "hifi1"

config MCUX_HW_CORE_ID_HIFI1
    bool
    default y

config MCUX_HW_DEVICE_CORE
    string
    default "MIMXRT735S_hifi1"

config MCUX_HW_SOC_SERIES_RT
    bool
    default y
```

## mcux/mcux-sdk-ng/devices/RT/RT700/MIMXRT758S/ezhv/Kconfig.chip
```kconfig
# Copyright 2024 NXP
#
# SPDX-License-Identifier: BSD-3-Clause

# core related
config MCUX_HW_CORE
    string
    default "ezhv"

config MCUX_HW_CORE_EZHV
    bool
    default y

config MCUX_HW_CORE_ID
    string
    default "ezhv"

config MCUX_HW_CORE_ID_EZHV
    bool
    default y

config MCUX_HW_DEVICE_CORE
    string
    default "MIMXRT758S_ezhv"

config MCUX_HW_SOC_SERIES_RT
    bool
    default y

# For chipmodel generated files
config MCUX_TOOLCHAIN_LINKER_DEVICE_PREFIX
    string
    default "MIMXRT758S_ezhv" if MCUX_HW_DEVICE_ID_MIMXRT758S

config MCUX_TOOLCHAIN_MCUX_STARTUP
    string
    default "mimxrt758s_ezhv"

# Toolchain related

config MCUX_TOOLCHAIN_IAR_CPU_IDENTIFIER
    string
    default "MIMXRT758S_ezhv" if MCUX_HW_DEVICE_ID_MIMXRT758S

config MCUX_TOOLCHAIN_MDK_CPU_IDENTIFIER
    string
    default "MIMXRT758SGFOA:ezhv" if MCUX_HW_DEVICE_PART_MIMXRT758SGFOA
    default "MIMXRT758SGAWAR:ezhv" if MCUX_HW_DEVICE_PART_MIMXRT758SGAWAR
```

## mcux/mcux-sdk-ng/devices/RT/RT700/MIMXRT758S/hifi1/Kconfig
```kconfig
# Copyright 2024 NXP
# All rights reserved.
#
# SPDX-License-Identifier: BSD-3-Clause

config MCUX_HW_DEVICE_MIMXRT758S_CORE_ID_hifi1
    bool
    default y

rsource "Kconfig.chip"
rsource "../../../../xtensa/Kconfig.common"
```

## mcux/mcux-sdk-ng/devices/RT/RT700/MIMXRT798S/Kconfig.chip
```kconfig
# Copyright 2024 NXP
#
# SPDX-License-Identifier: BSD-3-Clause


# device related

config MCUX_HW_DEVICE_ID_MIMXRT798S
    bool

choice MCUX_HW_DEVICE_PART_MIMXRT798S
    prompt "Device MIMXRT798S Part"
    config MCUX_HW_DEVICE_PART_MIMXRT798SGFOA
    bool "Device part MIMXRT798SGFOA"
    select MCUX_HW_DEVICE_ID_MIMXRT798S
    config MCUX_HW_DEVICE_PART_MIMXRT798SGAWAR
    bool "Device part MIMXRT798SGAWAR"
    select MCUX_HW_DEVICE_ID_MIMXRT798S
endchoice

config MCUX_HW_DEVICE_ID
    string
    default "MIMXRT798S" if MCUX_HW_DEVICE_ID_MIMXRT798S

config MCUX_HW_DEVICE_PART
    string
    default "MIMXRT798SGFOA" if MCUX_HW_DEVICE_PART_MIMXRT798SGFOA
    default "MIMXRT798SGAWAR" if MCUX_HW_DEVICE_PART_MIMXRT798SGAWAR

# ip information
config MCUX_HW_IP_DriverType_ACMP
    bool
    default y
    depends on MCUX_HW_DEVICE_ID_MIMXRT798S

config MCUX_HW_IP_DriverType_AHBSC
    bool
    default y
    depends on MCUX_HW_DEVICE_ID_MIMXRT798S

config MCUX_HW_IP_DriverType_AIPS
    bool
    default y if MCUX_HW_CORE_CM33
    depends on MCUX_HW_DEVICE_ID_MIMXRT798S

config MCUX_HW_IP_DriverType_AXBS
    bool
    default y if MCUX_HW_CORE_CM33
    depends on MCUX_HW_DEVICE_ID_MIMXRT798S

config MCUX_HW_IP_DriverType_CACHE64_CTRL
    bool
    default y if MCUX_HW_DEVICE_MIMXRT798S_CORE_ID_cm33_core0
    depends on MCUX_HW_DEVICE_ID_MIMXRT798S

config MCUX_HW_IP_DriverType_CACHE64_POLSEL
    bool
    default y if MCUX_HW_DEVICE_MIMXRT798S_CORE_ID_cm33_core0
    depends on MCUX_HW_DEVICE_ID_MIMXRT798S

config MCUX_HW_IP_DriverType_CORE
    bool
    default y
    depends on MCUX_HW_DEVICE_ID_MIMXRT798S

config MCUX_HW_IP_DriverType_CRC
    bool
    default y if MCUX_HW_DEVICE_MIMXRT798S_CORE_ID_cm33_core0
    depends on MCUX_HW_DEVICE_ID_MIMXRT798S

config MCUX_HW_IP_DriverType_DBGMB
    bool
    default y if MCUX_HW_DEVICE_MIMXRT798S_CORE_ID_cm33_core0
    depends on MCUX_HW_DEVICE_ID_MIMXRT798S

config MCUX_HW_IP_DriverType_EDMA4
    bool
    default y
    depends on MCUX_HW_DEVICE_ID_MIMXRT798S

config MCUX_HW_IP_DriverType_DMA_TCD
    bool
    default y
    depends on MCUX_HW_DEVICE_ID_MIMXRT798S

config MCUX_HW_IP_DriverType_ELS
    bool
    default y if MCUX_HW_DEVICE_MIMXRT798S_CORE_ID_cm33_core0
    depends on MCUX_HW_DEVICE_ID_MIMXRT798S

config MCUX_HW_IP_DriverType_FLEXIO
    bool
    default y
    depends on MCUX_HW_DEVICE_ID_MIMXRT798S

config MCUX_HW_IP_DriverType_FRO
    bool
    default y
    depends on MCUX_HW_DEVICE_ID_MIMXRT798S

config MCUX_HW_IP_DriverType_GDET
    bool
    default y
    depends on MCUX_HW_DEVICE_ID_MIMXRT798S

config MCUX_HW_IP_DriverType_GLIKEY
    bool
    default y
    depends on MCUX_HW_DEVICE_ID_MIMXRT798S

config MCUX_HW_IP_DriverType_GPIO
    bool
    default y
    depends on MCUX_HW_DEVICE_ID_MIMXRT798S

config MCUX_HW_IP_DriverType_ITRC
    bool
    default y if MCUX_HW_DEVICE_MIMXRT798S_CORE_ID_cm33_core0
    depends on MCUX_HW_DEVICE_ID_MIMXRT798S

config MCUX_HW_IP_DriverType_JPEGDEC
    bool
    default y
    depends on MCUX_HW_DEVICE_ID_MIMXRT798S

config MCUX_HW_IP_DriverType_JPGDECWRP
    bool
    default y
    depends on MCUX_HW_DEVICE_ID_MIMXRT798S

config MCUX_HW_IP_DriverType_LCDIF
    bool
    default y
    depends on MCUX_HW_DEVICE_ID_MIMXRT798S

config MCUX_HW_IP_DriverType_LPADC
    bool
    default y
    depends on MCUX_HW_DEVICE_ID_MIMXRT798S

config MCUX_HW_IP_DriverType_CDOG
    bool
    default y
    depends on MCUX_HW_DEVICE_ID_MIMXRT798S

config MCUX_HW_IP_DriverType_LPC_CLKCTL
    bool
    default y
    depends on MCUX_HW_DEVICE_ID_MIMXRT798S

config MCUX_HW_IP_DriverType_CTIMER
    bool
    default y
    depends on MCUX_HW_DEVICE_ID_MIMXRT798S

config MCUX_HW_IP_DriverType_LPFLEXCOMM
    bool
    default y
    depends on MCUX_HW_DEVICE_ID_MIMXRT798S

config MCUX_HW_IP_DriverType_FREQME
    bool
    default y if MCUX_HW_DEVICE_MIMXRT798S_CORE_ID_cm33_core0
    depends on MCUX_HW_DEVICE_ID_MIMXRT798S

config MCUX_HW_IP_DriverType_I3C
    bool
    default y
    depends on MCUX_HW_DEVICE_ID_MIMXRT798S

config MCUX_HW_IP_DriverType_INPUTMUX
    bool
    default y
    depends on MCUX_HW_DEVICE_ID_MIMXRT798S

config MCUX_HW_IP_DriverType_IOPCTL_SOC
    bool
    default y
    depends on MCUX_HW_DEVICE_ID_MIMXRT798S

config MCUX_HW_IP_DriverType_MRT
    bool
    default y
    depends on MCUX_HW_DEVICE_ID_MIMXRT798S

config MCUX_HW_IP_DriverType_OSTIMER
    bool
    default y
    depends on MCUX_HW_DEVICE_ID_MIMXRT798S

config MCUX_HW_IP_DriverType_LPC_OTP
    bool
    default y if MCUX_HW_DEVICE_MIMXRT798S_CORE_ID_cm33_core0
    depends on MCUX_HW_DEVICE_ID_MIMXRT798S

config MCUX_HW_IP_DriverType_PINT
    bool
    default y
    depends on MCUX_HW_DEVICE_ID_MIMXRT798S

config MCUX_HW_IP_DriverType_LPC_PMC
    bool
    default y
    depends on MCUX_HW_DEVICE_ID_MIMXRT798S

config MCUX_HW_IP_DriverType_PUFV3
    bool
    default y if MCUX_HW_DEVICE_MIMXRT798S_CORE_ID_cm33_core0
    depends on MCUX_HW_DEVICE_ID_MIMXRT798S

config MCUX_HW_IP_DriverType_LPC_RSTCTL
    bool
    default y
    depends on MCUX_HW_DEVICE_ID_MIMXRT798S

config MCUX_HW_IP_DriverType_SCTIMER
    bool
    default y if MCUX_HW_DEVICE_MIMXRT798S_CORE_ID_cm33_core0
    depends on MCUX_HW_DEVICE_ID_MIMXRT798S

config MCUX_HW_IP_DriverType_UTICK
    bool
    default y
    depends on MCUX_HW_DEVICE_ID_MIMXRT798S

config MCUX_HW_IP_DriverType_WWDT
    bool
    default y
    depends on MCUX_HW_DEVICE_ID_MIMXRT798S

config MCUX_HW_IP_DriverType_LPFLEXCOMM_LPI2C
    bool
    default y
    depends on MCUX_HW_DEVICE_ID_MIMXRT798S

config MCUX_HW_IP_DriverType_LPFLEXCOMM_LPSPI
    bool
    default y
    depends on MCUX_HW_DEVICE_ID_MIMXRT798S

config MCUX_HW_IP_DriverType_LPFLEXCOMM_LPUART
    bool
    default y
    depends on MCUX_HW_DEVICE_ID_MIMXRT798S

config MCUX_HW_IP_DriverType_MIPI_DSI
    bool
    default y
    depends on MCUX_HW_DEVICE_ID_MIMXRT798S

config MCUX_HW_IP_DriverType_MMU
    bool
    default y if MCUX_HW_DEVICE_MIMXRT798S_CORE_ID_cm33_core0
    depends on MCUX_HW_DEVICE_ID_MIMXRT798S

config MCUX_HW_IP_DriverType_MU_1
    bool
    default y
    depends on MCUX_HW_DEVICE_ID_MIMXRT798S

config MCUX_HW_IP_DriverType_NPU
    bool
    default y
    depends on MCUX_HW_DEVICE_ID_MIMXRT798S

config MCUX_HW_IP_DriverType_OSC32KNP
    bool
    default y
    depends on MCUX_HW_DEVICE_ID_MIMXRT798S

config MCUX_HW_IP_DriverType_OSCCA
    bool
    default y if MCUX_HW_DEVICE_MIMXRT798S_CORE_ID_cm33_core0
    depends on MCUX_HW_DEVICE_ID_MIMXRT798S

config MCUX_HW_IP_DriverType_PDM
    bool
    default y
    depends on MCUX_HW_DEVICE_ID_MIMXRT798S

config MCUX_HW_IP_DriverType_PKC
    bool
    default y if MCUX_HW_DEVICE_MIMXRT798S_CORE_ID_cm33_core0
    depends on MCUX_HW_DEVICE_ID_MIMXRT798S

config MCUX_HW_IP_DriverType_PNGDEC
    bool
    default y
    depends on MCUX_HW_DEVICE_ID_MIMXRT798S

config MCUX_HW_IP_DriverType_PUF_CTRL
    bool
    default y if MCUX_HW_DEVICE_MIMXRT798S_CORE_ID_cm33_core0
    depends on MCUX_HW_DEVICE_ID_MIMXRT798S

config MCUX_HW_IP_DriverType_ROMC
    bool
    default y if MCUX_HW_DEVICE_MIMXRT798S_CORE_ID_cm33_core0
    depends on MCUX_HW_DEVICE_ID_MIMXRT798S

config MCUX_HW_IP_DriverType_RTC_V2
    bool
    default y
    depends on MCUX_HW_DEVICE_ID_MIMXRT798S

config MCUX_HW_IP_DriverType_SAI
    bool
    default y
    depends on MCUX_HW_DEVICE_ID_MIMXRT798S

config MCUX_HW_IP_DriverType_SDADC
    bool
    default y
    depends on MCUX_HW_DEVICE_ID_MIMXRT798S

config MCUX_HW_IP_DriverType_SEMA42
    bool
    default y
    depends on MCUX_HW_DEVICE_ID_MIMXRT798S

config MCUX_HW_IP_DriverType_SLEEPCON
    bool
    default y
    depends on MCUX_HW_DEVICE_ID_MIMXRT798S

config MCUX_HW_IP_DriverType_SYSCON0
    bool
    default y if MCUX_HW_DEVICE_MIMXRT798S_CORE_ID_cm33_core0
    depends on MCUX_HW_DEVICE_ID_MIMXRT798S

config MCUX_HW_IP_DriverType_SYSCON1
    bool
    default y if MCUX_HW_DEVICE_MIMXRT798S_CORE_ID_cm33_core1
    depends on MCUX_HW_DEVICE_ID_MIMXRT798S

config MCUX_HW_IP_DriverType_SYSCON2
    bool
    default y
    depends on MCUX_HW_DEVICE_ID_MIMXRT798S

config MCUX_HW_IP_DriverType_SYSCON3
    bool
    default y
    depends on MCUX_HW_DEVICE_ID_MIMXRT798S

config MCUX_HW_IP_DriverType_SYSCON4
    bool
    default y
    depends on MCUX_HW_DEVICE_ID_MIMXRT798S

config MCUX_HW_IP_DriverType_SYSPM
    bool
    default y if MCUX_HW_DEVICE_MIMXRT798S_CORE_ID_cm33_core0
    depends on MCUX_HW_DEVICE_ID_MIMXRT798S

config MCUX_HW_IP_DriverType_TRNG
    bool
    default y if MCUX_HW_DEVICE_MIMXRT798S_CORE_ID_cm33_core0
    depends on MCUX_HW_DEVICE_ID_MIMXRT798S

config MCUX_HW_IP_DriverType_USB_HOST_DEVICE_EHCI
    bool
    default y
    depends on MCUX_HW_DEVICE_ID_MIMXRT798S

config MCUX_HW_IP_DriverType_USB_HSDCD
    bool
    default y
    depends on MCUX_HW_DEVICE_ID_MIMXRT798S

config MCUX_HW_IP_DriverType_USBNC
    bool
    default y
    depends on MCUX_HW_DEVICE_ID_MIMXRT798S

config MCUX_HW_IP_DriverType_USB_PHY
    bool
    default y
    depends on MCUX_HW_DEVICE_ID_MIMXRT798S

config MCUX_HW_IP_DriverType_USDHC
    bool
    default y
    depends on MCUX_HW_DEVICE_ID_MIMXRT798S

config MCUX_HW_IP_DriverType_XCACHE
    bool
    default y if MCUX_HW_DEVICE_MIMXRT798S_CORE_ID_cm33_core0
    depends on MCUX_HW_DEVICE_ID_MIMXRT798S

config MCUX_HW_IP_DriverType_XSPI
    bool
    default y
    depends on MCUX_HW_DEVICE_ID_MIMXRT798S
```

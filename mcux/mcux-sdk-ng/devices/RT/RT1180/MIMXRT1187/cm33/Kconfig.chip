## mcux/mcux-sdk-ng/devices/RT/RT600/MIMXRT633S/Kconfig.chip
```kconfig
# Copyright 2024 NXP
# All rights reserved.
#
# SPDX-License-Identifier: BSD-3-Clause
# core related
config MCUX_HW_CORE
    string
    default "cm33"

config MCUX_HW_CORE_CM33
    bool
    default y

config MCUX_HW_CORE_ID
    string
    default "cm33"

config MCUX_HW_CORE_ID_CM33
    bool
    default y

config MCUX_HW_DEVICE_CORE
    string
    default "MIMXRT633S"

config MCUX_HW_FPU
    string
    default "SP_FPU"

config MCUX_HW_FPU_TYPE
    string
    default "fpv5_sp"

config MCUX_HW_FPV5_SP
    bool
    default y

config MCUX_HW_INT_PRIO_BITS
    int
    default 3

config MCUX_HW_DSP
    bool
    default y

config MCUX_HW_SAU
    bool
    default y

config MCUX_HW_SOC_SERIES_RT
    bool
    default y

config MCUX_HW_SOC_SINGLECORE_DEVICE
    bool
    default y

# device related

config MCUX_HW_DEVICE_ID_MIMXRT633S
    bool

choice
    prompt "Device MIMXRT633S Part"
    config MCUX_HW_DEVICE_PART_MIMXRT633SFVKB
    bool "Device part MIMXRT633SFVKB"
    select MCUX_HW_DEVICE_ID_MIMXRT633S
    config MCUX_HW_DEVICE_PART_MIMXRT633SFFOB
    bool "Device part MIMXRT633SFFOB"
    select MCUX_HW_DEVICE_ID_MIMXRT633S
    config MCUX_HW_DEVICE_PART_MIMXRT633SFAWBR
    bool "Device part MIMXRT633SFAWBR"
    select MCUX_HW_DEVICE_ID_MIMXRT633S
endchoice

config MCUX_HW_DEVICE_ID
    string
    default "MIMXRT633S" if MCUX_HW_DEVICE_ID_MIMXRT633S

config MCUX_HW_DEVICE_PART
    string
    default "MIMXRT633SFVKB" if MCUX_HW_DEVICE_PART_MIMXRT633SFVKB
    default "MIMXRT633SFFOB" if MCUX_HW_DEVICE_PART_MIMXRT633SFFOB
    default "MIMXRT633SFAWBR" if MCUX_HW_DEVICE_PART_MIMXRT633SFAWBR

# For chipmodel generated files
config MCUX_TOOLCHAIN_LINKER_DEVICE_PREFIX
    string
    default "MIMXRT633S" if MCUX_HW_DEVICE_ID_MIMXRT633S

config MCUX_TOOLCHAIN_MCUX_STARTUP
    string
    default "mimxrt633s"

# Toolchain related

config MCUX_TOOLCHAIN_IAR_CPU_IDENTIFIER
    string
    default "MIMXRT633S" if MCUX_HW_DEVICE_ID_MIMXRT633S

config MCUX_TOOLCHAIN_MDK_CPU_IDENTIFIER
    string
    default "MIMXRT633SFVKB" if MCUX_HW_DEVICE_PART_MIMXRT633SFVKB
    default "MIMXRT633SFFOB" if MCUX_HW_DEVICE_PART_MIMXRT633SFFOB
    default "MIMXRT633SFAWBR" if MCUX_HW_DEVICE_PART_MIMXRT633SFAWBR

config MCUX_TOOLCHAIN_JLINK_CPU_IDENTIFIER
    string
    default "MIMXRT633S_M33"

config MCUX_HW_IP_DriverType_IAP3
    bool
    default y
    depends on MCUX_HW_DEVICE_ID_MIMXRT533S

# ip information
config MCUX_HW_IP_DriverType_ACMP
    bool
    default y
    depends on MCUX_HW_DEVICE_ID_MIMXRT633S

config MCUX_HW_IP_DriverType_CACHE64_CTRL
    bool
    default y
    depends on MCUX_HW_DEVICE_ID_MIMXRT633S

config MCUX_HW_IP_DriverType_CACHE64_POLSEL
    bool
    default y
    depends on MCUX_HW_DEVICE_ID_MIMXRT633S

config MCUX_HW_IP_DriverType_CASPER
    bool
    default y
    depends on MCUX_HW_DEVICE_ID_MIMXRT633S

config MCUX_HW_IP_DriverType_CTIMER
    bool
    default y
    depends on MCUX_HW_DEVICE_ID_MIMXRT633S

config MCUX_HW_IP_DriverType_DMIC
    bool
    default y
    depends on MCUX_HW_DEVICE_ID_MIMXRT633S

config MCUX_HW_IP_DriverType_FLEXCOMM
    bool
    default y
    depends on MCUX_HW_DEVICE_ID_MIMXRT633S

config MCUX_HW_IP_DriverType_FLEXCOMM_I2C
    bool
    default y
    depends on MCUX_HW_DEVICE_ID_MIMXRT633S

config MCUX_HW_IP_DriverType_FLEXCOMM_I2S
    bool
    default y
    depends on MCUX_HW_DEVICE_ID_MIMXRT633S

config MCUX_HW_IP_DriverType_FLEXCOMM_SPI
    bool
    default y
    depends on MCUX_HW_DEVICE_ID_MIMXRT633S

config MCUX_HW_IP_DriverType_FLEXCOMM_USART
    bool
    default y
    depends on MCUX_HW_DEVICE_ID_MIMXRT633S

config MCUX_HW_IP_DriverType_FLEXSPI
    bool
    default y
    depends on MCUX_HW_DEVICE_ID_MIMXRT633S

config MCUX_HW_IP_DriverType_GPIO_PORT
    bool
    default y
    depends on MCUX_HW_DEVICE_ID_MIMXRT633S

config MCUX_HW_IP_DriverType_HASHCRYPT
    bool
    default y
    depends on MCUX_HW_DEVICE_ID_MIMXRT633S

config MCUX_HW_IP_DriverType_I3C
    bool
    default y
    depends on MCUX_HW_DEVICE_ID_MIMXRT633S

config MCUX_HW_IP_DriverType_INPUTMUX
    bool
    default y
    depends on MCUX_HW_DEVICE_ID_MIMXRT633S

config MCUX_HW_IP_DriverType_IOPCTL
    bool
    default y
    depends on MCUX_HW_DEVICE_ID_MIMXRT633S

config MCUX_HW_IP_DriverType_LPADC
    bool
    default y
    depends on MCUX_HW_DEVICE_ID_MIMXRT633S

config MCUX_HW_IP_DriverType_LPC_AHB_SECURE_CTRL
    bool
    default y
    depends on MCUX_HW_DEVICE_ID_MIMXRT633S

config MCUX_HW_IP_DriverType_LPC_CLKCTL0
    bool
    default y
    depends on MCUX_HW_DEVICE_ID_MIMXRT633S

config MCUX_HW_IP_DriverType_LPC_CLKCTL1
    bool
    default y
    depends on MCUX_HW_DEVICE_ID_MIMXRT633S

config MCUX_HW_IP_DriverType_LPC_PMC
    bool
    default y
    depends on MCUX_HW_DEVICE_ID_MIMXRT633S

config MCUX_HW_IP_DriverType_LPC_PUF
    bool
    default y
    depends on MCUX_HW_DEVICE_ID_MIMXRT633S

config MCUX_HW_IP_DriverType_LPC_RSTCTL0
    bool
    default y
    depends on MCUX_HW_DEVICE_ID_MIMXRT633S

config MCUX_HW_IP_DriverType_LPC_RSTCTL1
    bool
    default y
    depends on MCUX_HW_DEVICE_ID_MIMXRT633S

config MCUX_HW_IP_DriverType_LPC_SYSCTL0
    bool
    default y
    depends on MCUX_HW_DEVICE_ID_MIMXRT633S

config MCUX_HW_IP_DriverType_LPC_SYSCTL1
    bool
    default y
    depends on MCUX_HW_DEVICE_ID_MIMXRT633S

config MCUX_HW_IP_DriverType_MCO_CRC
    bool
    default y
    depends on MCUX_HW_DEVICE_ID_MIMXRT633S

config MCUX_HW_IP_DriverType_MCO_FREQME
    bool
    default y
    depends on MCUX_HW_DEVICE_ID_MIMXRT633S

config MCUX_HW_IP_DriverType_MRT
    bool
    default y
    depends on MCUX_HW_DEVICE_ID_MIMXRT633S

config MCUX_HW_IP_DriverType_MU
    bool
    default y
    depends on MCUX_HW_DEVICE_ID_MIMXRT633S

config MCUX_HW_IP_DriverType_OSTIMER
    bool
    default y
    depends on MCUX_HW_DEVICE_ID_MIMXRT633S

config MCUX_HW_IP_DriverType_OTFAD
    bool
    default y
    depends on MCUX_HW_DEVICE_ID_MIMXRT633S

config MCUX_HW_IP_DriverType_OTP
    bool
    default y
    depends on MCUX_HW_DEVICE_ID_MIMXRT633S

config MCUX_HW_IP_DriverType_PINT
    bool
    default y
    depends on MCUX_HW_DEVICE_ID_MIMXRT633S

config MCUX_HW_IP_DriverType_POWERQUAD
    bool
    default y
    depends on MCUX_HW_DEVICE_ID_MIMXRT633S

config MCUX_HW_IP_DriverType_RTC_LITE
    bool
    default y
    depends on MCUX_HW_DEVICE_ID_MIMXRT633S

config MCUX_HW_IP_DriverType_SCTIMER
    bool
    default y
    depends on MCUX_HW_DEVICE_ID_MIMXRT633S

config MCUX_HW_IP_DriverType_SDMA
    bool
    default y
    depends on MCUX_HW_DEVICE_ID_MIMXRT633S

config MCUX_HW_IP_DriverType_SECGPIO
    bool
    default y
    depends on MCUX_HW_DEVICE_ID_MIMXRT633S

config MCUX_HW_IP_DriverType_SEMA42
    bool
    default y
    depends on MCUX_HW_DEVICE_ID_MIMXRT633S

config MCUX_HW_IP_DriverType_TRNG
    bool
    default y
    depends on MCUX_HW_DEVICE_ID_MIMXRT633S

config MCUX_HW_IP_DriverType_USB_DEVICE_IP3511HS
    bool
    default y
    depends on MCUX_HW_DEVICE_ID_MIMXRT633S

config MCUX_HW_IP_DriverType_USB_HOST_IP3516HS
    bool
    default y
    depends on MCUX_HW_DEVICE_ID_MIMXRT633S

config MCUX_HW_IP_DriverType_USB_HSDCD
    bool
    default y
    depends on MCUX_HW_DEVICE_ID_MIMXRT633S

config MCUX_HW_IP_DriverType_USB_PHY
    bool
    default y
    depends on MCUX_HW_DEVICE_ID_MIMXRT633S

config MCUX_HW_IP_DriverType_USDHC
    bool
    default y
    depends on MCUX_HW_DEVICE_ID_MIMXRT633S

config MCUX_HW_IP_DriverType_UTICK
    bool
    default y
    depends on MCUX_HW_DEVICE_ID_MIMXRT633S

config MCUX_HW_IP_DriverType_WWDT
    bool
    default y
    depends on MCUX_HW_DEVICE_ID_MIMXRT633S
```

## mcux/mcux-sdk-ng/devices/RT/RT600/MIMXRT685S/Kconfig.chip
```kconfig
# Copyright 2024 NXP
#
# SPDX-License-Identifier: BSD-3-Clause


# device related

config MCUX_HW_DEVICE_ID_MIMXRT685S
    bool

choice MCUX_HW_DEVICE_PART_MIMXRT685S
    prompt "Device MIMXRT685S Part"
    config MCUX_HW_DEVICE_PART_MIMXRT685SFVKB
    bool "Device part MIMXRT685SFVKB"
    select MCUX_HW_DEVICE_ID_MIMXRT685S
    config MCUX_HW_DEVICE_PART_MIMXRT685SFFOB
    bool "Device part MIMXRT685SFFOB"
    select MCUX_HW_DEVICE_ID_MIMXRT685S
    config MCUX_HW_DEVICE_PART_MIMXRT685SFAWBR
    bool "Device part MIMXRT685SFAWBR"
    select MCUX_HW_DEVICE_ID_MIMXRT685S
endchoice

config MCUX_HW_DEVICE_ID
    string
    default "MIMXRT685S" if MCUX_HW_DEVICE_ID_MIMXRT685S

config MCUX_HW_DEVICE_PART
    string
    default "MIMXRT685SFVKB" if MCUX_HW_DEVICE_PART_MIMXRT685SFVKB
    default "MIMXRT685SFFOB" if MCUX_HW_DEVICE_PART_MIMXRT685SFFOB
    default "MIMXRT685SFAWBR" if MCUX_HW_DEVICE_PART_MIMXRT685SFAWBR

config MCUX_HW_IP_DriverType_IAP3
    bool
    default y if MCUX_HW_DEVICE_MIMXRT685S_CORE_ID_cm33
    depends on MCUX_HW_DEVICE_ID_MIMXRT685S

# ip information
config MCUX_HW_IP_DriverType_ACMP
    bool
    default y
    depends on MCUX_HW_DEVICE_ID_MIMXRT685S

config MCUX_HW_IP_DriverType_CACHE64_CTRL
    bool
    default y if MCUX_HW_DEVICE_MIMXRT685S_CORE_ID_cm33
    depends on MCUX_HW_DEVICE_ID_MIMXRT685S

config MCUX_HW_IP_DriverType_CACHE64_POLSEL
    bool
    default y if MCUX_HW_DEVICE_MIMXRT685S_CORE_ID_cm33
    depends on MCUX_HW_DEVICE_ID_MIMXRT685S

config MCUX_HW_IP_DriverType_CASPER
    bool
    default y if MCUX_HW_DEVICE_MIMXRT685S_CORE_ID_cm33
    depends on MCUX_HW_DEVICE_ID_MIMXRT685S

config MCUX_HW_IP_DriverType_CTIMER
    bool
    default y
    depends on MCUX_HW_DEVICE_ID_MIMXRT685S

config MCUX_HW_IP_DriverType_DMIC
    bool
    default y
    depends on MCUX_HW_DEVICE_ID_MIMXRT685S

config MCUX_HW_IP_DriverType_FLEXCOMM
    bool
    default y
    depends on MCUX_HW_DEVICE_ID_MIMXRT685S

config MCUX_HW_IP_DriverType_FLEXCOMM_I2C
    bool
    default y
    depends on MCUX_HW_DEVICE_ID_MIMXRT685S

config MCUX_HW_IP_DriverType_FLEXCOMM_I2S
    bool
    default y
    depends on MCUX_HW_DEVICE_ID_MIMXRT685S

config MCUX_HW_IP_DriverType_FLEXCOMM_SPI
    bool
    default y
    depends on MCUX_HW_DEVICE_ID_MIMXRT685S

config MCUX_HW_IP_DriverType_FLEXCOMM_USART
    bool
    default y
    depends on MCUX_HW_DEVICE_ID_MIMXRT685S

config MCUX_HW_IP_DriverType_FLEXSPI
    bool
    default y
    depends on MCUX_HW_DEVICE_ID_MIMXRT685S

config MCUX_HW_IP_DriverType_GPIO_PORT
    bool
    default y
    depends on MCUX_HW_DEVICE_ID_MIMXRT685S

config MCUX_HW_IP_DriverType_HASHCRYPT
    bool
    default y if MCUX_HW_DEVICE_MIMXRT685S_CORE_ID_cm33
    depends on MCUX_HW_DEVICE_ID_MIMXRT685S

config MCUX_HW_IP_DriverType_I3C
    bool
    default y
    depends on MCUX_HW_DEVICE_ID_MIMXRT685S

config MCUX_HW_IP_DriverType_INPUTMUX
    bool
    default y
    depends on MCUX_HW_DEVICE_ID_MIMXRT685S

config MCUX_HW_IP_DriverType_IOPCTL
    bool
    default y
    depends on MCUX_HW_DEVICE_ID_MIMXRT685S

config MCUX_HW_IP_DriverType_LPADC
    bool
    default y
    depends on MCUX_HW_DEVICE_ID_MIMXRT685S

config MCUX_HW_IP_DriverType_LPC_AHB_SECURE_CTRL
    bool
    default y
    depends on MCUX_HW_DEVICE_ID_MIMXRT685S

config MCUX_HW_IP_DriverType_LPC_CLKCTL0
    bool
    default y
    depends on MCUX_HW_DEVICE_ID_MIMXRT685S

config MCUX_HW_IP_DriverType_LPC_CLKCTL1
    bool
    default y
    depends on MCUX_HW_DEVICE_ID_MIMXRT685S

config MCUX_HW_IP_DriverType_LPC_PMC
    bool
    default y if MCUX_HW_DEVICE_MIMXRT685S_CORE_ID_cm33
    depends on MCUX_HW_DEVICE_ID_MIMXRT685S

config MCUX_HW_IP_DriverType_LPC_PUF
    bool
    default y if MCUX_HW_DEVICE_MIMXRT685S_CORE_ID_cm33
    depends on MCUX_HW_DEVICE_ID_MIMXRT685S

config MCUX_HW_IP_DriverType_LPC_RSTCTL0
    bool
    default y
    depends on MCUX_HW_DEVICE_ID_MIMXRT685S

config MCUX_HW_IP_DriverType_LPC_RSTCTL1
    bool
    default y
    depends on MCUX_HW_DEVICE_ID_MIMXRT685S

config MCUX_HW_IP_DriverType_LPC_SYSCTL0
    bool
    default y
    depends on MCUX_HW_DEVICE_ID_MIMXRT685S

config MCUX_HW_IP_DriverType_LPC_SYSCTL1
    bool
    default y
    depends on MCUX_HW_DEVICE_ID_MIMXRT685S

config MCUX_HW_IP_DriverType_MCO_CRC
    bool
    default y
    depends on MCUX_HW_DEVICE_ID_MIMXRT685S

config MCUX_HW_IP_DriverType_MCO_FREQME
    bool
    default y if MCUX_HW_DEVICE_MIMXRT685S_CORE_ID_cm33
    depends on MCUX_HW_DEVICE_ID_MIMXRT685S

config MCUX_HW_IP_DriverType_MRT
    bool
    default y
    depends on MCUX_HW_DEVICE_ID_MIMXRT685S

config MCUX_HW_IP_DriverType_MU
    bool
    default y
    depends on MCUX_HW_DEVICE_ID_MIMXRT685S

config MCUX_HW_IP_DriverType_OSTIMER
    bool
    default y
    depends on MCUX_HW_DEVICE_ID_MIMXRT685S

config MCUX_HW_IP_DriverType_OTFAD
    bool
    default y if MCUX_HW_DEVICE_MIMXRT685S_CORE_ID_cm33
    depends on MCUX_HW_DEVICE_ID_MIMXRT685S

config MCUX_HW_IP_DriverType_OTP
    bool
    default y if MCUX_HW_DEVICE_MIMXRT685S_CORE_ID_cm33
    depends on MCUX_HW_DEVICE_ID_MIMXRT685S

config MCUX_HW_IP_DriverType_PINT
    bool
    default y
    depends on MCUX_HW_DEVICE_ID_MIMXRT685S

config MCUX_HW_IP_DriverType_POWERQUAD
    bool
    default y if MCUX_HW_DEVICE_MIMXRT685S_CORE_ID_cm33
    depends on MCUX_HW_DEVICE_ID_MIMXRT685S

config MCUX_HW_IP_DriverType_RTC_LITE
    bool
    default y
    depends on MCUX_HW_DEVICE_ID_MIMXRT685S

config MCUX_HW_IP_DriverType_SCTIMER
    bool
    default y
    depends on MCUX_HW_DEVICE_ID_MIMXRT685S

config MCUX_HW_IP_DriverType_SDMA
    bool
    default y
    depends on MCUX_HW_DEVICE_ID_MIMXRT685S

config MCUX_HW_IP_DriverType_SECGPIO
    bool
    default y
    depends on MCUX_HW_DEVICE_ID_MIMXRT685S

config MCUX_HW_IP_DriverType_SEMA42
    bool
    default y
    depends on MCUX_HW_DEVICE_ID_MIMXRT685S

config MCUX_HW_IP_DriverType_TRNG
    bool
    default y if MCUX_HW_DEVICE_MIMXRT685S_CORE_ID_cm33
    depends on MCUX_HW_DEVICE_ID_MIMXRT685S

config MCUX_HW_IP_DriverType_USB_DEVICE_IP3511HS
    bool
    default y if MCUX_HW_DEVICE_MIMXRT685S_CORE_ID_cm33
    depends on MCUX_HW_DEVICE_ID_MIMXRT685S

config MCUX_HW_IP_DriverType_USB_HOST_IP3516HS
    bool
    default y if MCUX_HW_DEVICE_MIMXRT685S_CORE_ID_cm33
    depends on MCUX_HW_DEVICE_ID_MIMXRT685S

config MCUX_HW_IP_DriverType_USB_HSDCD
    bool
    default y if MCUX_HW_DEVICE_MIMXRT685S_CORE_ID_cm33
    depends on MCUX_HW_DEVICE_ID_MIMXRT685S

config MCUX_HW_IP_DriverType_USB_PHY
    bool
    default y if MCUX_HW_DEVICE_MIMXRT685S_CORE_ID_cm33
    depends on MCUX_HW_DEVICE_ID_MIMXRT685S

config MCUX_HW_IP_DriverType_USDHC
    bool
    default y if MCUX_HW_DEVICE_MIMXRT685S_CORE_ID_cm33
    depends on MCUX_HW_DEVICE_ID_MIMXRT685S

config MCUX_HW_IP_DriverType_UTICK
    bool
    default y
    depends on MCUX_HW_DEVICE_ID_MIMXRT685S

config MCUX_HW_IP_DriverType_WWDT
    bool
    default y
    depends on MCUX_HW_DEVICE_ID_MIMXRT685S
```

## mcux/mcux-sdk-ng/devices/RT/RT600/MIMXRT685S/drivers/Kconfig
```kconfig
# Copyright 2024 NXP
# All rights reserved.
#
# SPDX-License-Identifier: BSD-3-Clause

menu "Device specific drivers configuration"

    config MCUX_COMPONENT_driver.clock
         bool "Use driver clock"
         default y

    config MCUX_COMPONENT_driver.dsp
         bool "Use driver dsp"
         default y
         depends on MCUX_HW_DEVICE_MIMXRT685S && MCUX_HW_CORE_CM33

    config MCUX_COMPONENT_driver.i2s_bridge
         bool "Use driver i2s_bridge"
         default y

    config MCUX_COMPONENT_driver.inputmux_connections
         bool "Use driver inputmux_connections"
         default y

    config MCUX_COMPONENT_driver.power
         bool "Use driver power"
         default y
         depends on MCUX_HW_DEVICE_MIMXRT685S && MCUX_HW_CORE_CM33

    config MCUX_COMPONENT_driver.reset
         bool "Use driver reset"
         default y

endmenu
```

## mcux/mcux-sdk-ng/devices/Wireless/KW/KW47B42ZB7/Kconfig.chip
```kconfig
# Copyright 2024 NXP
#
# SPDX-License-Identifier: BSD-3-Clause

# device related

config MCUX_HW_DEVICE_ID_KW47B42ZB7xxxA
    bool

choice
    prompt "Device KW47B42ZB7 Part"
    config MCUX_HW_DEVICE_PART_KW47B42ZB7AFTA
    bool "Device part KW47B42ZB7AFTA"
    select MCUX_HW_DEVICE_ID_KW47B42ZB7xxxA
endchoice

config MCUX_HW_DEVICE_ID
    string
    default "KW47B42ZB7xxxA" if MCUX_HW_DEVICE_ID_KW47B42ZB7xxxA

config MCUX_HW_DEVICE_PART
    string
    default "KW47B42ZB7AFTA" if MCUX_HW_DEVICE_PART_KW47B42ZB7AFTA

# ip information
config MCUX_HW_IP_DriverType_ATX
    bool
    default y
    depends on MCUX_HW_DEVICE_ID_KW47B42ZB7xxxA

config MCUX_HW_IP_DriverType_AXBS
    bool
    default y
    depends on MCUX_HW_DEVICE_ID_KW47B42ZB7xxxA

config MCUX_HW_IP_DriverType_BLE2_REG
    bool
    default y
    depends on MCUX_HW_DEVICE_ID_KW47B42ZB7xxxA

config MCUX_HW_IP_DriverType_BTLE_RF
    bool
    default y
    depends on MCUX_HW_DEVICE_ID_KW47B42ZB7xxxA

config MCUX_HW_IP_DriverType_BTRTU1
    bool
    default y
    depends on MCUX_HW_DEVICE_ID_KW47B42ZB7xxxA

config MCUX_HW_IP_DriverType_BTU2_REG
    bool
    default y
    depends on MCUX_HW_DEVICE_ID_KW47B42ZB7xxxA

config MCUX_HW_IP_DriverType_CCM32K
    bool
    default y
    depends on MCUX_HW_DEVICE_ID_KW47B42ZB7xxxA

config MCUX_HW_IP_DriverType_CE
    bool
    default y
    depends on MCUX_HW_DEVICE_ID_KW47B42ZB7xxxA

config MCUX_HW_IP_DriverType_CMC
    bool
    default y
    depends on MCUX_HW_DEVICE_ID_KW47B42ZB7xxxA

config MCUX_HW_IP_DriverType_CRC
    bool
    default y
    depends on MCUX_HW_DEVICE_ID_KW47B42ZB7xxxA

config MCUX_HW_IP_DriverType_DSB
    bool
    default y
    depends on MCUX_HW_DEVICE_ID_KW47B42ZB7xxxA

config MCUX_HW_IP_DriverType_DMA3
    bool
    default y
    depends on MCUX_HW_DEVICE_ID_KW47B42ZB7xxxA

config MCUX_HW_IP_DriverType_ELEMU
    bool
    default y
    depends on MCUX_HW_DEVICE_ID_KW47B42ZB7xxxA

config MCUX_HW_IP_DriverType_EWM
    bool
    default y
    depends on MCUX_HW_DEVICE_ID_KW47B42ZB7xxxA

config MCUX_HW_IP_DriverType_FLASH_K4
    bool
    default y
    depends on MCUX_HW_DEVICE_ID_KW47B42ZB7xxxA

config MCUX_HW_IP_DriverType_FLEXCAN
    bool
    default y
    depends on MCUX_HW_DEVICE_ID_KW47B42ZB7xxxA

config MCUX_HW_IP_DriverType_FLEXIO
    bool
    default y
    depends on MCUX_HW_DEVICE_ID_KW47B42ZB7xxxA

config MCUX_HW_IP_DriverType_FMC
    bool
    default y
    depends on MCUX_HW_DEVICE_ID_KW47B42ZB7xxxA

config MCUX_HW_IP_DriverType_FRO192
    bool
    default y
    depends on MCUX_HW_DEVICE_ID_KW47B42ZB7xxxA

config MCUX_HW_IP_DriverType_GEN4PHY
    bool
    default y
    depends on MCUX_HW_DEVICE_ID_KW47B42ZB7xxxA

config MCUX_HW_IP_DriverType_GENFSK
    bool
    default y
    depends on MCUX_HW_DEVICE_ID_KW47B42ZB7xxxA

config MCUX_HW_IP_DriverType_GPIO
    bool
    default y
    depends on MCUX_HW_DEVICE_ID_KW47B42ZB7xxxA

config MCUX_HW_IP_DriverType_I3C
    bool
    default y
    depends on MCUX_HW_DEVICE_ID_KW47B42ZB7xxxA

config MCUX_HW_IP_DriverType_IMU
    bool
    default y
    depends on MCUX_HW_DEVICE_ID_KW47B42ZB7xxxA

config MCUX_HW_IP_DriverType_LPADC
    bool
    default y
    depends on MCUX_HW_DEVICE_ID_KW47B42ZB7xxxA

config MCUX_HW_IP_DriverType_LPCMP
    bool
    default y
    depends on MCUX_HW_DEVICE_ID_KW47B42ZB7xxxA

config MCUX_HW_IP_DriverType_LPI2C
    bool
    default y
    depends on MCUX_HW_DEVICE_ID_KW47B42ZB7xxxA

config MCUX_HW_IP_DriverType_LPIT
    bool
    default y
    depends on MCUX_HW_DEVICE_ID_KW47B42ZB7xxxA

config MCUX_HW_IP_DriverType_LPSPI
    bool
    default y
    depends on MCUX_HW_DEVICE_ID_KW47B42ZB7xxxA

config MCUX_HW_IP_DriverType_LPTMR
    bool
    default y
    depends on MCUX_HW_DEVICE_ID_KW47B42ZB7xxxA

config MCUX_HW_IP_DriverType_LPUART
    bool
    default y
    depends on MCUX_HW_DEVICE_ID_KW47B42ZB7xxxA

config MCUX_HW_IP_DriverType_LTC
    bool
    default y
    depends on MCUX_HW_DEVICE_ID_KW47B42ZB7xxxA

config MCUX_HW_IP_DriverType_MCM
    bool
    default y
    depends on MCUX_HW_DEVICE_ID_KW47B42ZB7xxxA

config MCUX_HW_IP_DriverType_MRCC
    bool
    default y
    depends on MCUX_HW_DEVICE_ID_KW47B42ZB7xxxA

config MCUX_HW_IP_DriverType_MSCM
    bool
    default y
    depends on MCUX_HW_DEVICE_ID_KW47B42ZB7xxxA

config MCUX_HW_IP_DriverType_MSF1
    bool
    default y
    depends on MCUX_HW_DEVICE_ID_KW47B42ZB7xxxA

config MCUX_HW_IP_DriverType_MU_1
    bool
    default y
    depends on MCUX_HW_DEVICE_ID_KW47B42ZB7xxxA

config MCUX_HW_IP_DriverType_PORT
    bool
    default y
    depends on MCUX_HW_DEVICE_ID_KW47B42ZB7xxxA

config MCUX_HW_IP_DriverType_RADIO_CTRL
    bool
    default y
    depends on MCUX_HW_DEVICE_ID_KW47B42ZB7xxxA

config MCUX_HW_IP_DriverType_RADIO_PACKET_RAM
    bool
    default y
    depends on MCUX_HW_DEVICE_ID_KW47B42ZB7xxxA

config MCUX_HW_IP_DriverType_RBME
    bool
    default y
    depends on MCUX_HW_DEVICE_ID_KW47B42ZB7xxxA

config MCUX_HW_IP_DriverType_REGFILE
    bool
    default y
    depends on MCUX_HW_DEVICE_ID_KW47B42ZB7xxxA

config MCUX_HW_IP_DriverType_RFMC
    bool
    default y
    depends on MCUX_HW_DEVICE_ID_KW47B42ZB7xxxA

config MCUX_HW_IP_DriverType_RF_CMC
    bool
    default y
    depends on MCUX_HW_DEVICE_ID_KW47B42ZB7xxxA

config MCUX_HW_IP_DriverType_SCG
    bool
    default y
    depends on MCUX_HW_DEVICE_ID_KW47B42ZB7xxxA

config MCUX_HW_IP_DriverType_SFA
    bool
    default y
    depends on MCUX_HW_DEVICE_ID_KW47B42ZB7xxxA

config MCUX_HW_IP_DriverType_SEMA42
    bool
    default y
    depends on MCUX_HW_DEVICE_ID_KW47B42ZB7xxxA

config MCUX_HW_IP_DriverType_SMSCM
    bool
    default y
    depends on MCUX_HW_DEVICE_ID_KW47B42ZB7xxxA

config MCUX_HW_IP_DriverType_SPC
    bool
    default y
    depends on MCUX_HW_DEVICE_ID_KW47B42ZB7xxxA

config MCUX_HW_IP_DriverType_SRTC
    bool
    default y
    depends on MCUX_HW_DEVICE_ID_KW47B42ZB7xxxA

config MCUX_HW_IP_DriverType_SYSPM
    bool
    default y
    depends on MCUX_HW_DEVICE_ID_KW47B42ZB7xxxA

config MCUX_HW_IP_DriverType_TPIU
    bool
    default y
    depends on MCUX_HW_DEVICE_ID_KW47B42ZB7xxxA

config MCUX_HW_IP_DriverType_TPM
    bool
    default y
    depends on MCUX_HW_DEVICE_ID_KW47B42ZB7xxxA

config MCUX_HW_IP_DriverType_TRDC
    bool
    default y
    depends on MCUX_HW_DEVICE_ID_KW47B42ZB7xxxA

config MCUX_HW_IP_DriverType_TRGMUX
    bool
    default y
    depends on MCUX_HW_DEVICE_ID_KW47B42ZB7xxxA

config MCUX_HW_IP_DriverType_TSTMR
    bool
    default y
    depends on MCUX_HW_DEVICE_ID_KW47B42ZB7xxxA

config MCUX_HW_IP_DriverType_VBAT
    bool
    default y
    depends on MCUX_HW_DEVICE_ID_KW47B42ZB7xxxA

config MCUX_HW_IP_DriverType_VREF_1
    bool
    default y
    depends on MCUX_HW_DEVICE_ID_KW47B42ZB7xxxA

config MCUX_HW_IP_DriverType_WDOG32
    bool
    default y
    depends on MCUX_HW_DEVICE_ID_KW47B42ZB7xxxA

config MCUX_HW_IP_DriverType_WOR
    bool
    default y
    depends on MCUX_HW_DEVICE_ID_KW47B42ZB7xxxA

config MCUX_HW_IP_DriverType_WUU
    bool
    default y
    depends on MCUX_HW_DEVICE_ID_KW47B42ZB7xxxA

config MCUX_HW_IP_DriverType_XCVR_ANALOG
    bool
    default y
    depends on MCUX_HW_DEVICE_ID_KW47B42ZB7xxxA

config MCUX_HW_IP_DriverType_XCVR_MISC
    bool
    default y
    depends on MCUX_HW_DEVICE_ID_KW47B42ZB7xxxA

config MCUX_HW_IP_DriverType_XCVR_PLL_DIG
    bool
    default y
    depends on MCUX_HW_DEVICE_ID_KW47B42ZB7xxxA

config MCUX_HW_IP_DriverType_XCVR_RX_DIG
    bool
    default y
    depends on MCUX_HW_DEVICE_ID_KW47B42ZB7xxxA

config MCUX_HW_IP_DriverType_XCVR_TSM
    bool
    default y
    depends on MCUX_HW_DEVICE_ID_KW47B42ZB7xxxA

config MCUX_HW_IP_DriverType_XCVR_TX_DIG
    bool
    default y
    depends on MCUX_HW_DEVICE_ID_KW47B42ZB7xxxA
```

## mcux/mcux-sdk-ng/devices/Wireless/KW/KW47Z42092/drivers/Kconfig
```kconfig
# Copyright 2024 NXP
#
# SPDX-License-Identifier: BSD-3-Clause

menu "Device specific drivers configuration"
     rsource "../../KW47Z420B3/drivers/Kconfig_clock"
     rsource "../../KW47Z420B3/drivers/Kconfig_romapi"
endmenu
```

## mcux/mcux-sdk-ng/devices/Wireless/KW/KW47Z420B3/Kconfig.chip
```kconfig
# Copyright 2024 NXP
#
# SPDX-License-Identifier: BSD-3-Clause

# core related
config MCUX_HW_CORE
    string
    default "cm33"

config MCUX_HW_CORE_CM33
    bool
    default y

config MCUX_HW_CORE_ID
    string
    default "cm33"

config MCUX_HW_CORE_ID_CM33
    bool
    default y

config MCUX_HW_DEVICE_CORE
    string
    default "KW47Z420B3"

config MCUX_HW_FPU
    string
    default "SP_FPU"

config MCUX_HW_FPU_TYPE
    string
    default "fpv5_sp"

config MCUX_HW_FPV5_SP
    bool
    default y

config MCUX_HW_INT_PRIO_BITS
    int
    default 3

config MCUX_HW_DSP
    bool
    default y

config MCUX_HW_SAU
    bool
    default y

config MCUX_HW_SOC_SERIES_WIRELESS
    bool
    default y

config MCUX_HW_SOC_SINGLECORE_DEVICE
    bool
    default y

# For chipmodel generated files
config MCUX_TOOLCHAIN_LINKER_DEVICE_PREFIX
    string
    default "kw47z420b3" if MCUX_HW_DEVICE_ID_KW47Z420B3xxxA

config MCUX_TOOLCHAIN_MCUX_STARTUP
    string
    default "kw47z420b3"

# Toolchain related

config MCUX_TOOLCHAIN_IAR_CPU_IDENTIFIER
    string
    default "KW47Z420B3" if MCUX_HW_DEVICE_ID_KW47Z420B3xxxA

config MCUX_TOOLCHAIN_MDK_CPU_IDENTIFIER
    string
    default "KW47Z420B3AFTA" if MCUX_HW_DEVICE_PART_KW47Z420B3AFTA

config MCUX_TOOLCHAIN_JLINK_CPU_IDENTIFIER
    string
    default "KW47Z420B3" if MCUX_HW_DEVICE_ID_KW47Z420B3xxxA

# device related

config MCUX_HW_DEVICE_ID_KW47Z420B3xxxA
    bool

choice MCUX_HW_DEVICE_PART_KW47Z420B3
    prompt "Device KW47Z420B3 Part"
    config MCUX_HW_DEVICE_PART_KW47Z420B3AFTA
    bool "Device part KW47Z420B3AFTA"
    select MCUX_HW_DEVICE_ID_KW47Z420B3xxxA
endchoice

config MCUX_HW_DEVICE_ID
    string
    default "KW47Z420B3xxxA" if MCUX_HW_DEVICE_ID_KW47Z420B3xxxA

config MCUX_HW_DEVICE_PART
    string
    default "KW47Z420B3AFTA" if MCUX_HW_DEVICE_PART_KW47Z420B3AFTA

# ip information
config MCUX_HW_IP_DriverType_ATX
    bool
    default y
    depends on MCUX_HW_DEVICE_ID_KW47Z420B3xxxA

config MCUX_HW_IP_DriverType_AXBS
    bool
    default y
    depends on MCUX_HW_DEVICE_ID_KW47Z420B3xxxA

config MCUX_HW_IP_DriverType_BTRTU1
    bool
    default y
    depends on MCUX_HW_DEVICE_ID_KW47Z420B3xxxA

config MCUX_HW_IP_DriverType_BTU2_REG
    bool
    default y
    depends on MCUX_HW_DEVICE_ID_KW47Z420B3xxxA

config MCUX_HW_IP_DriverType_CCM32K
    bool
    default y
    depends on MCUX_HW_DEVICE_ID_KW47Z420B3xxxA

config MCUX_HW_IP_DriverType_CMC
    bool
    default y
    depends on MCUX_HW_DEVICE_ID_KW47Z420B3xxxA

config MCUX_HW_IP_DriverType_CRC
    bool
    default y
    depends on MCUX_HW_DEVICE_ID_KW47Z420B3xxxA

config MCUX_HW_IP_DriverType_DMA3
    bool
    default y
    depends on MCUX_HW_DEVICE_ID_KW47Z420B3xxxA

config MCUX_HW_IP_DriverType_ELEMU
    bool
    default y
    depends on MCUX_HW_DEVICE_ID_KW47Z420B3xxxA

config MCUX_HW_IP_DriverType_EWM
    bool
    default y
    depends on MCUX_HW_DEVICE_ID_KW47Z420B3xxxA

config MCUX_HW_IP_DriverType_FLASH_K4
    bool
    default y
    depends on MCUX_HW_DEVICE_ID_KW47Z420B3xxxA

config MCUX_HW_IP_DriverType_FLEXCAN
    bool
    default y
    depends on MCUX_HW_DEVICE_ID_KW47Z420B3xxxA

config MCUX_HW_IP_DriverType_FLEXIO
    bool
    default y
    depends on MCUX_HW_DEVICE_ID_KW47Z420B3xxxA

config MCUX_HW_IP_DriverType_FMC
    bool
    default y
    depends on MCUX_HW_DEVICE_ID_KW47Z420B3xxxA

config MCUX_HW_IP_DriverType_GPIO
    bool
    default y
    depends on MCUX_HW_DEVICE_ID_KW47Z420B3xxxA

config MCUX_HW_IP_DriverType_I3C
    bool
    default y
    depends on MCUX_HW_DEVICE_ID_KW47Z420B3xxxA

config MCUX_HW_IP_DriverType_LPADC
    bool
    default y
    depends on MCUX_HW_DEVICE_ID_KW47Z420B3xxxA

config MCUX_HW_IP_DriverType_LPCMP
    bool
    default y
    depends on MCUX_HW_DEVICE_ID_KW47Z420B3xxxA

config MCUX_HW_IP_DriverType_LPI2C
    bool
    default y
    depends on MCUX_HW_DEVICE_ID_KW47Z420B3xxxA

config MCUX_HW_IP_DriverType_LPIT
    bool
    default y
    depends on MCUX_HW_DEVICE_ID_KW47Z420B3xxxA

config MCUX_HW_IP_DriverType_LPSPI
    bool
    default y
    depends on MCUX_HW_DEVICE_ID_KW47Z420B3xxxA

config MCUX_HW_IP_DriverType_LPTMR
    bool
    default y
    depends on MCUX_HW_DEVICE_ID_KW47Z420B3xxxA

config MCUX_HW_IP_DriverType_LPUART
    bool
    default y
    depends on MCUX_HW_DEVICE_ID_KW47Z420B3xxxA

config MCUX_HW_IP_DriverType_LTC
    bool
    default y
    depends on MCUX_HW_DEVICE_ID_KW47Z420B3xxxA

config MCUX_HW_IP_DriverType_MCM
    bool
    default y
    depends on MCUX_HW_DEVICE_ID_KW47Z420B3xxxA

config MCUX_HW_IP_DriverType_MRCC
    bool
    default y
    depends on MCUX_HW_DEVICE_ID_KW47Z420B3xxxA

config MCUX_HW_IP_DriverType_MSCM
    bool
    default y
    depends on MCUX_HW_DEVICE_ID_KW47Z420B3xxxA

config MCUX_HW_IP_DriverType_MSF1
    bool
    default y
    depends on MCUX_HW_DEVICE_ID_KW47Z420B3xxxA

config MCUX_HW_IP_DriverType_PORT
    bool
    default y
    depends on MCUX_HW_DEVICE_ID_KW47Z420B3xxxA

config MCUX_HW_IP_DriverType_REGFILE
    bool
    default y
    depends on MCUX_HW_DEVICE_ID_KW47Z420B3xxxA

config MCUX_HW_IP_DriverType_SCG
    bool
    default y
    depends on MCUX_HW_DEVICE_ID_KW47Z420B3xxxA

config MCUX_HW_IP_DriverType_SFA
    bool
    default y
    depends on MCUX_HW_DEVICE_ID_KW47Z420B3xxxA

config MCUX_HW_IP_DriverType_SEMA42
    bool
    default y
    depends on MCUX_HW_DEVICE_ID_KW47Z420B3xxxA

config MCUX_HW_IP_DriverType_SMSCM
    bool
    default y
    depends on MCUX_HW_DEVICE_ID_KW47Z420B3xxxA

config MCUX_HW_IP_DriverType_SPC
    bool
    default y
    depends on MCUX_HW_DEVICE_ID_KW47Z420B3xxxA

config MCUX_HW_IP_DriverType_SRTC
    bool
    default y
    depends on MCUX_HW_DEVICE_ID_KW47Z420B3xxxA

config MCUX_HW_IP_DriverType_SYSPM
    bool
    default y
    depends on MCUX_HW_DEVICE_ID_KW47Z420B3xxxA

config MCUX_HW_IP_DriverType_TPIU
    bool
    default y
    depends on MCUX_HW_DEVICE_ID_KW47Z420B3xxxA

config MCUX_HW_IP_DriverType_TPM
    bool
    default y
    depends on MCUX_HW_DEVICE_ID_KW47Z420B3xxxA

config MCUX_HW_IP_DriverType_TRDC
    bool
    default y
    depends on MCUX_HW_DEVICE_ID_KW47Z420B3xxxA

config MCUX_HW_IP_DriverType_TRGMUX
    bool
    default y
    depends on MCUX_HW_DEVICE_ID_KW47Z420B3xxxA

config MCUX_HW_IP_DriverType_TSTMR
    bool
    default y
    depends on MCUX_HW_DEVICE_ID_KW47Z420B3xxxA

config MCUX_HW_IP_DriverType_VBAT
    bool
    default y
    depends on MCUX_HW_DEVICE_ID_KW47Z420B3xxxA

config MCUX_HW_IP_DriverType_VREF_1
    bool
    default y
    depends on MCUX_HW_DEVICE_ID_KW47Z420B3xxxA

config MCUX_HW_IP_DriverType_WDOG32
    bool
    default y
    depends on MCUX_HW_DEVICE_ID_KW47Z420B3xxxA

config MCUX_HW_IP_DriverType_WUU
    bool
    default y
    depends on MCUX_HW_DEVICE_ID_KW47Z420B3xxxA
```

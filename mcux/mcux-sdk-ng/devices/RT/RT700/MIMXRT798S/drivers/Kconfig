## mcux/mcux-sdk-ng/devices/i.MX/i.MX7ULP/MCIMX7U3/Kconfig
```kconfig
# Copyright 2024 NXP
# All rights reserved.
#
# SPDX-License-Identifier: BSD-3-Clause

rsource "Kconfig.chip"
rsource "drivers/Kconfig"
rsource "../../../arm/Kconfig.common"
rsource "Kconfig.defconfig"

## pinmux dependency
config MCUX_DEPENDENCY_PINMUX
    bool
    default n

    imply MCUX_COMPONENT_driver.gpio
    imply MCUX_COMPONENT_driver.port

## Project segment and component dependency data
config MCUX_HW_DEVICE_MCIMX7U3
    # bool "Device MCIMX7U3 Configuration"
    bool
    default y
    ## Project segment dependency data

    select MCUX_COMPONENT_driver.port if MCUX_PRJSEG_module.board.pinmux
    select MCUX_COMPONENT_driver.gpio if MCUX_PRJSEG_module.board.pinmux
    select MCUX_COMPONENT_driver.clock if MCUX_PRJSEG_module.board.clock
    select MCUX_COMPONENT_component.lpuart_adapter if MCUX_PRJSEG_module.board.console_lite
    select MCUX_COMPONENT_driver.lpuart if MCUX_PRJSEG_module.board.console_lite
    select MCUX_COMPONENT_driver.msmc

    # component dependency
    select MCUX_COMPONENT_driver.dmamux if MCUX_COMPONENT_device.RTE
    select MCUX_COMPONENT_driver.edma if MCUX_COMPONENT_device.RTE
    select MCUX_COMPONENT_driver.edma if MCUX_COMPONENT_driver.sai_edma
    select MCUX_COMPONENT_driver.edma if MCUX_COMPONENT_driver.lpi2c_edma
    select MCUX_COMPONENT_driver.edma if MCUX_COMPONENT_driver.lpspi_edma
    select MCUX_COMPONENT_driver.edma if MCUX_COMPONENT_driver.lpuart_edma
    select MCUX_COMPONENT_component.lpuart_adapter if MCUX_COMPONENT_component.serial_manager_uart
    select MCUX_COMPONENT_component.lpuart_adapter if MCUX_COMPONENT_utility.debug_console_lite
    select MCUX_COMPONENT_driver.lpspi_edma if MCUX_COMPONENT_driver.cmsis_lpspi
    select MCUX_COMPONENT_driver.lpi2c_edma if MCUX_COMPONENT_driver.cmsis_lpi2c
    select MCUX_COMPONENT_driver.lpuart_edma if MCUX_COMPONENT_driver.cmsis_lpuart
    select MCUX_COMPONENT_driver.edma if MCUX_COMPONENT_driver.flexio_camera_edma
    select MCUX_COMPONENT_driver.edma if MCUX_COMPONENT_driver.flexio_i2s_edma
    select MCUX_COMPONENT_driver.edma if MCUX_COMPONENT_driver.flexio_mculcd_edma
    select MCUX_COMPONENT_driver.edma if MCUX_COMPONENT_driver.flexio_spi_edma
    select MCUX_COMPONENT_driver.edma if MCUX_COMPONENT_driver.flexio_uart_edma
    select MCUX_COMPONENT_driver.edma if MCUX_COMPONENT_driver.ltc_edma
    select MCUX_COMPONENT_driver.edma if MCUX_COMPONENT_driver.qspi_edma
```

## mcux/mcux-sdk-ng/devices/i.MX/i.MX7ULP/MCIMX7U3/drivers/Kconfig
```kconfig
# Copyright 2024 NXP
#
# SPDX-License-Identifier: BSD-3-Clause

rsource "../../../i.MX7ULP/MCIMX7U5/drivers/Kconfig"
```

## mcux/mcux-sdk-ng/devices/i.MX/i.MX7ULP/MCIMX7U5/Kconfig.chip
```kconfig
# Copyright 2024 NXP
#
# SPDX-License-Identifier: BSD-3-Clause

# core related
config MCUX_HW_CORE
    string
    default "cm4f"

config MCUX_HW_CORE_CM4F
    bool
    default y

config MCUX_HW_CORE_ID
    string
    default "cm4"

config MCUX_HW_CORE_ID_CM4
    bool
    default y

config MCUX_HW_DEVICE_CORE
    string
    default "MCIMX7U5_cm4"

config MCUX_HW_FPU
    string
    default "SP_FPU"

config MCUX_HW_FPU_TYPE
    string
    default "fpv4_sp"

config MCUX_HW_FPV4_SP
    bool
    default y

config MCUX_HW_INT_PRIO_BITS
    int
    default 4

config MCUX_HW_SOC_SERIES_MIMX
    bool
    default y

config MCUX_HW_SOC_SINGLECORE_DEVICE
    bool
    default y

# device related

config MCUX_HW_DEVICE_ID_MCIMX7U5xxxxx
    bool

choice
    prompt "Device MCIMX7U5 Part"
    config MCUX_HW_DEVICE_PART_MCIMX7U5DVP07
    bool "Device part MCIMX7U5DVP07"
    select MCUX_HW_DEVICE_ID_MCIMX7U5xxxxx
    config MCUX_HW_DEVICE_PART_MCIMX7U5DVK07
    bool "Device part MCIMX7U5DVK07"
    select MCUX_HW_DEVICE_ID_MCIMX7U5xxxxx
    config MCUX_HW_DEVICE_PART_MCIMX7U5CVP06
    bool "Device part MCIMX7U5CVP06"
    select MCUX_HW_DEVICE_ID_MCIMX7U5xxxxx
endchoice

config MCUX_HW_DEVICE_ID
    string
    default "MCIMX7U5xxxxx" if MCUX_HW_DEVICE_ID_MCIMX7U5xxxxx

config MCUX_HW_DEVICE_PART
    string
    default "MCIMX7U5DVP07" if MCUX_HW_DEVICE_PART_MCIMX7U5DVP07
    default "MCIMX7U5DVK07" if MCUX_HW_DEVICE_PART_MCIMX7U5DVK07
    default "MCIMX7U5CVP06" if MCUX_HW_DEVICE_PART_MCIMX7U5CVP06

# For chipmodel generated files
config MCUX_TOOLCHAIN_LINKER_DEVICE_PREFIX
    string
    default "MCIMX7U5xxxxx" if MCUX_HW_DEVICE_ID_MCIMX7U5xxxxx

config MCUX_TOOLCHAIN_MCUX_STARTUP
    string
    default "mcimx7u5"

# Toolchain related

config MCUX_TOOLCHAIN_IAR_CPU_IDENTIFIER
    string
    default "MCIMX7U5_M4" if MCUX_HW_DEVICE_ID_MCIMX7U5xxxxx

config MCUX_TOOLCHAIN_MDK_CPU_IDENTIFIER
    string
    default "MCIMX7U5DVP07" if MCUX_HW_DEVICE_PART_MCIMX7U5DVP07
    default "MCIMX7U5DVK07" if MCUX_HW_DEVICE_PART_MCIMX7U5DVK07
    default "MCIMX7U5CVP06" if MCUX_HW_DEVICE_PART_MCIMX7U5CVP06

# ip information
config MCUX_HW_IP_DriverType_ACMP
    bool
    default y
    depends on MCUX_HW_DEVICE_ID_MCIMX7U5xxxxx

config MCUX_HW_IP_DriverType_AXBS
    bool
    default y
    depends on MCUX_HW_DEVICE_ID_MCIMX7U5xxxxx

config MCUX_HW_IP_DriverType_CRC
    bool
    default y
    depends on MCUX_HW_DEVICE_ID_MCIMX7U5xxxxx

config MCUX_HW_IP_DriverType_DAC12
    bool
    default y
    depends on MCUX_HW_DEVICE_ID_MCIMX7U5xxxxx

config MCUX_HW_IP_DriverType_DMAMUX
    bool
    default y
    depends on MCUX_HW_DEVICE_ID_MCIMX7U5xxxxx

config MCUX_HW_IP_DriverType_EDMA
    bool
    default y
    depends on MCUX_HW_DEVICE_ID_MCIMX7U5xxxxx

config MCUX_HW_IP_DriverType_EWM
    bool
    default y
    depends on MCUX_HW_DEVICE_ID_MCIMX7U5xxxxx

config MCUX_HW_IP_DriverType_FB
    bool
    default y
    depends on MCUX_HW_DEVICE_ID_MCIMX7U5xxxxx

config MCUX_HW_IP_DriverType_FGPIO
    bool
    default y
    depends on MCUX_HW_DEVICE_ID_MCIMX7U5xxxxx

config MCUX_HW_IP_DriverType_FLEXIO
    bool
    default y
    depends on MCUX_HW_DEVICE_ID_MCIMX7U5xxxxx

config MCUX_HW_IP_DriverType_GPIO
    bool
    default y
    depends on MCUX_HW_DEVICE_ID_MCIMX7U5xxxxx

config MCUX_HW_IP_DriverType_IOMUXC0
    bool
    default y
    depends on MCUX_HW_DEVICE_ID_MCIMX7U5xxxxx

config MCUX_HW_IP_DriverType_IOMUXC1
    bool
    default y
    depends on MCUX_HW_DEVICE_ID_MCIMX7U5xxxxx

config MCUX_HW_IP_DriverType_IOMUXC1_DDR
    bool
    default y
    depends on MCUX_HW_DEVICE_ID_MCIMX7U5xxxxx

config MCUX_HW_IP_DriverType_LCDIF
    bool
    default y
    depends on MCUX_HW_DEVICE_ID_MCIMX7U5xxxxx

config MCUX_HW_IP_DriverType_LLWU
    bool
    default y
    depends on MCUX_HW_DEVICE_ID_MCIMX7U5xxxxx

config MCUX_HW_IP_DriverType_LMEM
    bool
    default y
    depends on MCUX_HW_DEVICE_ID_MCIMX7U5xxxxx

config MCUX_HW_IP_DriverType_LPADC
    bool
    default y
    depends on MCUX_HW_DEVICE_ID_MCIMX7U5xxxxx

config MCUX_HW_IP_DriverType_LPI2C
    bool
    default y
    depends on MCUX_HW_DEVICE_ID_MCIMX7U5xxxxx

config MCUX_HW_IP_DriverType_LPIT
    bool
    default y
    depends on MCUX_HW_DEVICE_ID_MCIMX7U5xxxxx

config MCUX_HW_IP_DriverType_LPSPI
    bool
    default y
    depends on MCUX_HW_DEVICE_ID_MCIMX7U5xxxxx

config MCUX_HW_IP_DriverType_LPTMR
    bool
    default y
    depends on MCUX_HW_DEVICE_ID_MCIMX7U5xxxxx

config MCUX_HW_IP_DriverType_LPUART
    bool
    default y
    depends on MCUX_HW_DEVICE_ID_MCIMX7U5xxxxx

config MCUX_HW_IP_DriverType_LTC
    bool
    default y
    depends on MCUX_HW_DEVICE_ID_MCIMX7U5xxxxx

config MCUX_HW_IP_DriverType_MCM
    bool
    default y
    depends on MCUX_HW_DEVICE_ID_MCIMX7U5xxxxx

config MCUX_HW_IP_DriverType_MIPI_DSI
    bool
    default y
    depends on MCUX_HW_DEVICE_ID_MCIMX7U5xxxxx

config MCUX_HW_IP_DriverType_MIPI_DSI_HOST_APB_PKT_IF
    bool
    default y
    depends on MCUX_HW_DEVICE_ID_MCIMX7U5xxxxx

config MCUX_HW_IP_DriverType_MIPI_DSI_HOST_DPI_INTFC
    bool
    default y
    depends on MCUX_HW_DEVICE_ID_MCIMX7U5xxxxx

config MCUX_HW_IP_DriverType_MIPI_DSI_HOST_FSL_IP1_DPHY_INTFC
    bool
    default y
    depends on MCUX_HW_DEVICE_ID_MCIMX7U5xxxxx

config MCUX_HW_IP_DriverType_MMCAU
    bool
    default y
    depends on MCUX_HW_DEVICE_ID_MCIMX7U5xxxxx

config MCUX_HW_IP_DriverType_MMDC
    bool
    default y
    depends on MCUX_HW_DEVICE_ID_MCIMX7U5xxxxx

config MCUX_HW_IP_DriverType_MSMC
    bool
    default y
    depends on MCUX_HW_DEVICE_ID_MCIMX7U5xxxxx

config MCUX_HW_IP_DriverType_MU
    bool
    default y
    depends on MCUX_HW_DEVICE_ID_MCIMX7U5xxxxx

config MCUX_HW_IP_DriverType_OCOTP
    bool
    default y
    depends on MCUX_HW_DEVICE_ID_MCIMX7U5xxxxx

config MCUX_HW_IP_DriverType_OTFAD
    bool
    default y
    depends on MCUX_HW_DEVICE_ID_MCIMX7U5xxxxx

config MCUX_HW_IP_DriverType_PCC
    bool
    default y
    depends on MCUX_HW_DEVICE_ID_MCIMX7U5xxxxx

config MCUX_HW_IP_DriverType_PMC0
    bool
    default y
    depends on MCUX_HW_DEVICE_ID_MCIMX7U5xxxxx

config MCUX_HW_IP_DriverType_PORT
    bool
    default y
    depends on MCUX_HW_DEVICE_ID_MCIMX7U5xxxxx

config MCUX_HW_IP_DriverType_QUADSPI
    bool
    default y
    depends on MCUX_HW_DEVICE_ID_MCIMX7U5xxxxx

config MCUX_HW_IP_DriverType_ROMC
    bool
    default y
    depends on MCUX_HW_DEVICE_ID_MCIMX7U5xxxxx

config MCUX_HW_IP_DriverType_SAI
    bool
    default y
    depends on MCUX_HW_DEVICE_ID_MCIMX7U5xxxxx

config MCUX_HW_IP_DriverType_SCG
    bool
    default y
    depends on MCUX_HW_DEVICE_ID_MCIMX7U5xxxxx

config MCUX_HW_IP_DriverType_SEMA42
    bool
    default y
    depends on MCUX_HW_DEVICE_ID_MCIMX7U5xxxxx

config MCUX_HW_IP_DriverType_SIM
    bool
    default y
    depends on MCUX_HW_DEVICE_ID_MCIMX7U5xxxxx

config MCUX_HW_IP_DriverType_SNVS
    bool
    default y
    depends on MCUX_HW_DEVICE_ID_MCIMX7U5xxxxx

config MCUX_HW_IP_DriverType_TPM
    bool
    default y
    depends on MCUX_HW_DEVICE_ID_MCIMX7U5xxxxx

config MCUX_HW_IP_DriverType_TRGMUX
    bool
    default y
    depends on MCUX_HW_DEVICE_ID_MCIMX7U5xxxxx

config MCUX_HW_IP_DriverType_TRNG
    bool
    default y
    depends on MCUX_HW_DEVICE_ID_MCIMX7U5xxxxx

config MCUX_HW_IP_DriverType_TSTMR
    bool
    default y
    depends on MCUX_HW_DEVICE_ID_MCIMX7U5xxxxx

config MCUX_HW_IP_DriverType_USBNC
    bool
    default y
    depends on MCUX_HW_DEVICE_ID_MCIMX7U5xxxxx

config MCUX_HW_IP_DriverType_USB_HOST_DEVICE_EHCI
    bool
    default y
    depends on MCUX_HW_DEVICE_ID_MCIMX7U5xxxxx

config MCUX_HW_IP_DriverType_USB_HSDCD
    bool
    default y
    depends on MCUX_HW_DEVICE_ID_MCIMX7U5xxxxx

config MCUX_HW_IP_DriverType_USB_PHY
    bool
    default y
    depends on MCUX_HW_DEVICE_ID_MCIMX7U5xxxxx

config MCUX_HW_IP_DriverType_VIU
    bool
    default y
    depends on MCUX_HW_DEVICE_ID_MCIMX7U5xxxxx

config MCUX_HW_IP_DriverType_WDOG32
    bool
    default y
    depends on MCUX_HW_DEVICE_ID_MCIMX7U5xxxxx

config MCUX_HW_IP_DriverType_XRDC
    bool
    default y
    depends on MCUX_HW_DEVICE_ID_MCIMX7U5xxxxx

config MCUX_HW_IP_DriverType_uSDHC
    bool
    default y
    depends on MCUX_HW_DEVICE_ID_MCIMX7U5xxxxx
```

## mcux/mcux-sdk-ng/devices/i.MX/i.MX8M/MIMX8MD7/Kconfig
```kconfig
# Copyright 2024 NXP
# All rights reserved.
#
# SPDX-License-Identifier: BSD-3-Clause

rsource "Kconfig.chip"
rsource "drivers/Kconfig"
rsource "../../../arm/Kconfig.common"
rsource "Kconfig.defconfig"

## pinmux dependency
config MCUX_DEPENDENCY_PINMUX
    bool
    default n

    imply MCUX_COMPONENT_driver.igpio
    imply MCUX_COMPONENT_driver.port

## Project segment and component dependency data
config MCUX_HW_DEVICE_MIMX8MD7
    # bool "Device MIMX8MD7 Configuration"
    bool
    default y
    ## Project segment dependency data

    select MCUX_COMPONENT_driver.port if MCUX_PRJSEG_module.board.pinmux
    select MCUX_COMPONENT_driver.igpio if MCUX_PRJSEG_module.board.pinmux
    select MCUX_COMPONENT_driver.clock if MCUX_PRJSEG_module.board.clock
    select MCUX_COMPONENT_component.iuart_adapter if MCUX_PRJSEG_module.board.console_lite
    select MCUX_COMPONENT_driver.iuart if MCUX_PRJSEG_module.board.console_lite
    select MCUX_COMPONENT_driver.rdc

    # component dependency
    select MCUX_COMPONENT_component.iuart_adapter if MCUX_COMPONENT_component.serial_manager_uart
    select MCUX_COMPONENT_component.iuart_adapter if MCUX_COMPONENT_utility.debug_console_lite
```

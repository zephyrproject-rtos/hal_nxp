## mcux/mcux-sdk-ng/devices/Wireless/RW/RW612/Kconfig
```kconfig
# Copyright 2024 NXP
#  
#
# SPDX-License-Identifier: BSD-3-Clause

rsource "Kconfig.chip"
rsource "drivers/Kconfig"
rsource "../../../arm/Kconfig.common"
rsource "Kconfig.defconfig"

## Project segment and component dependency data
config MCUX_HW_DEVICE_RW612
    bool
    default y

    # component dependency
    select MCUX_COMPONENT_driver.common if MCUX_COMPONENT_driver.ocotp
    select MCUX_COMPONENT_driver.common if MCUX_COMPONENT_driver.iped
    select MCUX_COMPONENT_driver.power if MCUX_COMPONENT_driver.utick
    select MCUX_COMPONENT_component.usart_adapter if MCUX_COMPONENT_component.serial_manager_uart
    select MCUX_COMPONENT_component.usart_adapter if MCUX_COMPONENT_utility.debug_console_lite
    select MCUX_COMPONENT_driver.memory if MCUX_COMPONENT_driver.enet
    select MCUX_COMPONENT_driver.memory if MCUX_COMPONENT_driver.lpc_dma
    select MCUX_COMPONENT_driver.lpc_dma if MCUX_COMPONENT_driver.dmic_dma
    select MCUX_COMPONENT_driver.lpc_dma if MCUX_COMPONENT_driver.flexspi_dma
    select MCUX_COMPONENT_driver.lpc_dma if MCUX_COMPONENT_driver.flexcomm_i2c_dma
    select MCUX_COMPONENT_driver.lpc_dma if MCUX_COMPONENT_driver.flexcomm_i2s_dma
    select MCUX_COMPONENT_driver.lpc_dma if MCUX_COMPONENT_driver.lcdic_dma
    select MCUX_COMPONENT_driver.lpc_dma if MCUX_COMPONENT_driver.flexcomm_spi_dma
    select MCUX_COMPONENT_driver.lpc_dma if MCUX_COMPONENT_driver.flexcomm_usart_dma
    select MCUX_COMPONENT_driver.common if MCUX_COMPONENT_driver.flash_config
```

## mcux/mcux-sdk-ng/devices/Wireless/RW/RW612/Kconfig.chip
```kconfig
# Copyright 2024 NXP
#
# SPDX-License-Identifier: BSD-3-Clause

# core related
config MCUX_HW_CORE
    string
    default "cm33"

config MCUX_HW_CORE_CM33
    bool
    default y

config MCUX_HW_CORE_ID
    string
    default "cm33"

config MCUX_HW_CORE_ID_CM33
    bool
    default y

config MCUX_HW_DEVICE_CORE
    string
    default "RW612"

config MCUX_HW_FPU
    string
    default "SP_FPU"

config MCUX_HW_FPU_TYPE
    string
    default "fpv5_sp"

config MCUX_HW_FPV5_SP
    bool
    default y

config MCUX_HW_INT_PRIO_BITS
    int
    default 3

config MCUX_HW_DSP
    bool
    default n

config MCUX_HW_SAU
    bool
    default y

config MCUX_HW_SOC_SERIES_WIRELESS
    bool
    default y

config MCUX_HW_SOC_SINGLECORE_DEVICE
    bool
    default y

# device related

config MCUX_HW_DEVICE_ID_RW612
    bool

choice
    prompt "Device RW612 Part"
    config MCUX_HW_DEVICE_PART_RW612HNA2I
    bool "Device part RW612HNA2I"
    select MCUX_HW_DEVICE_ID_RW612
    config MCUX_HW_DEVICE_PART_RW612ETA2I
    bool "Device part RW612ETA2I"
    select MCUX_HW_DEVICE_ID_RW612
    config MCUX_HW_DEVICE_PART_RW612UKA2I
    bool "Device part RW612UKA2I"
    select MCUX_HW_DEVICE_ID_RW612
endchoice

config MCUX_HW_DEVICE_ID
    string
    default "RW612" if MCUX_HW_DEVICE_ID_RW612

config MCUX_HW_DEVICE_PART
    string
    default "RW612HNA2I" if MCUX_HW_DEVICE_PART_RW612HNA2I
    default "RW612ETA2I" if MCUX_HW_DEVICE_PART_RW612ETA2I
    default "RW612UKA2I" if MCUX_HW_DEVICE_PART_RW612UKA2I

# For chipmodel generated files
config MCUX_TOOLCHAIN_LINKER_DEVICE_PREFIX
    string
    default "RW612" if MCUX_HW_DEVICE_ID_RW612

config MCUX_TOOLCHAIN_MCUX_STARTUP
    string
    default "rw612"

# Toolchain related

config MCUX_TOOLCHAIN_IAR_CPU_IDENTIFIER
    string
    default "RW612" if MCUX_HW_DEVICE_ID_RW612

config MCUX_TOOLCHAIN_MDK_CPU_IDENTIFIER
    string
    default "RW612HNA2I" if MCUX_HW_DEVICE_PART_RW612HNA2I
    default "RW612ETA2I" if MCUX_HW_DEVICE_PART_RW612ETA2I
    default "RW612UKA2I" if MCUX_HW_DEVICE_PART_RW612UKA2I

config MCUX_TOOLCHAIN_JLINK_CPU_IDENTIFIER
    string
    default "RW612"

# ip information
config MCUX_HW_IP_DriverType_CACHE64_CTRL
    bool
    default y
    depends on MCUX_HW_DEVICE_ID_RW612

config MCUX_HW_IP_DriverType_CACHE64_POLSEL
    bool
    default y
    depends on MCUX_HW_DEVICE_ID_RW612

config MCUX_HW_IP_DriverType_CDOG
    bool
    default y
    depends on MCUX_HW_DEVICE_ID_RW612

config MCUX_HW_IP_DriverType_CNS_ACOMP
    bool
    default y
    depends on MCUX_HW_DEVICE_ID_RW612

config MCUX_HW_IP_DriverType_CNS_ADC
    bool
    default y
    depends on MCUX_HW_DEVICE_ID_RW612

config MCUX_HW_IP_DriverType_CNS_APU
    bool
    default y
    depends on MCUX_HW_DEVICE_ID_RW612

config MCUX_HW_IP_DriverType_CNS_BG
    bool
    default y
    depends on MCUX_HW_DEVICE_ID_RW612

config MCUX_HW_IP_DriverType_CNS_BLEAPU
    bool
    default y
    depends on MCUX_HW_DEVICE_ID_RW612

config MCUX_HW_IP_DriverType_CNS_BUCK11
    bool
    default y
    depends on MCUX_HW_DEVICE_ID_RW612

config MCUX_HW_IP_DriverType_CNS_BUCK18
    bool
    default y
    depends on MCUX_HW_DEVICE_ID_RW612

config MCUX_HW_IP_DriverType_CNS_CAU
    bool
    default y
    depends on MCUX_HW_DEVICE_ID_RW612

config MCUX_HW_IP_DriverType_CNS_CIU1_IMU
    bool
    default y
    depends on MCUX_HW_DEVICE_ID_RW612

config MCUX_HW_IP_DriverType_CNS_CIU2_IMU
    bool
    default y
    depends on MCUX_HW_DEVICE_ID_RW612

config MCUX_HW_IP_DriverType_CNS_DAC
    bool
    default y
    depends on MCUX_HW_DEVICE_ID_RW612

config MCUX_HW_IP_DriverType_CNS_MCI_IO_MUX
    bool
    default y
    depends on MCUX_HW_DEVICE_ID_RW612

config MCUX_HW_IP_DriverType_CNS_PMU
    bool
    default y
    depends on MCUX_HW_DEVICE_ID_RW612

config MCUX_HW_IP_DriverType_CNS_PUF
    bool
    default y
    depends on MCUX_HW_DEVICE_ID_RW612

config MCUX_HW_IP_DriverType_CNS_RF_SYSCON
    bool
    default y
    depends on MCUX_HW_DEVICE_ID_RW612

config MCUX_HW_IP_DriverType_CNS_SDU_FBR_CARD
    bool
    default y
    depends on MCUX_HW_DEVICE_ID_RW612

config MCUX_HW_IP_DriverType_CNS_SDU_FN0_CARD
    bool
    default y
    depends on MCUX_HW_DEVICE_ID_RW612

config MCUX_HW_IP_DriverType_CNS_SDU_FN_CARD
    bool
    default y
    depends on MCUX_HW_DEVICE_ID_RW612

config MCUX_HW_IP_DriverType_CNS_SENSOR_CTRL
    bool
    default y
    depends on MCUX_HW_DEVICE_ID_RW612

config MCUX_HW_IP_DriverType_CNS_SOCCIU
    bool
    default y
    depends on MCUX_HW_DEVICE_ID_RW612

config MCUX_HW_IP_DriverType_CNS_SOC_OTP_CTRL
    bool
    default y
    depends on MCUX_HW_DEVICE_ID_RW612

config MCUX_HW_IP_DriverType_CNS_SYSPLL_T3
    bool
    default y
    depends on MCUX_HW_DEVICE_ID_RW612

config MCUX_HW_IP_DriverType_CNS_SYSPLL_TCPU
    bool
    default y
    depends on MCUX_HW_DEVICE_ID_RW612

config MCUX_HW_IP_DriverType_CNS_SYSPLL_TDDR
    bool
    default y
    depends on MCUX_HW_DEVICE_ID_RW612

config MCUX_HW_IP_DriverType_CNS_WLAPU
    bool
    default y
    depends on MCUX_HW_DEVICE_ID_RW612

config MCUX_HW_IP_DriverType_CTIMER
    bool
    default y
    depends on MCUX_HW_DEVICE_ID_RW612

config MCUX_HW_IP_DriverType_DMIC
    bool
    default y
    depends on MCUX_HW_DEVICE_ID_RW612

config MCUX_HW_IP_DriverType_ELS
    bool
    default y
    depends on MCUX_HW_DEVICE_ID_RW612

config MCUX_HW_IP_DriverType_ENET
    bool
    default y
    depends on MCUX_HW_DEVICE_ID_RW612

config MCUX_HW_IP_DriverType_FLEXCOMM
    bool
    default y
    depends on MCUX_HW_DEVICE_ID_RW612

config MCUX_HW_IP_DriverType_FLEXCOMM_I2C
    bool
    default y
    depends on MCUX_HW_DEVICE_ID_RW612

config MCUX_HW_IP_DriverType_FLEXCOMM_I2S
    bool
    default y
    depends on MCUX_HW_DEVICE_ID_RW612

config MCUX_HW_IP_DriverType_FLEXCOMM_SPI
    bool
    default y
    depends on MCUX_HW_DEVICE_ID_RW612

config MCUX_HW_IP_DriverType_FLEXCOMM_USART
    bool
    default y
    depends on MCUX_HW_DEVICE_ID_RW612

config MCUX_HW_IP_DriverType_FLEXSPI
    bool
    default y
    depends on MCUX_HW_DEVICE_ID_RW612

config MCUX_HW_IP_DriverType_FLEXSPI_IPED_RW61X
    bool
    default y
    depends on MCUX_HW_DEVICE_ID_RW612

config MCUX_HW_IP_DriverType_GDMA
    bool
    default y
    depends on MCUX_HW_DEVICE_ID_RW612

config MCUX_HW_IP_DriverType_GPIO_PORT
    bool
    default y
    depends on MCUX_HW_DEVICE_ID_RW612

config MCUX_HW_IP_DriverType_INPUTMUX
    bool
    default y
    depends on MCUX_HW_DEVICE_ID_RW612

config MCUX_HW_IP_DriverType_LCDIC
    bool
    default y
    depends on MCUX_HW_DEVICE_ID_RW612

config MCUX_HW_IP_DriverType_LPC_AHB_SECURE_CTRL
    bool
    default y
    depends on MCUX_HW_DEVICE_ID_RW612

config MCUX_HW_IP_DriverType_LPC_CLKCTL0
    bool
    default y
    depends on MCUX_HW_DEVICE_ID_RW612

config MCUX_HW_IP_DriverType_LPC_CLKCTL1
    bool
    default y
    depends on MCUX_HW_DEVICE_ID_RW612

config MCUX_HW_IP_DriverType_LPC_DBGMAILBOX
    bool
    default y
    depends on MCUX_HW_DEVICE_ID_RW612

config MCUX_HW_IP_DriverType_LPC_RSTCTL0
    bool
    default y
    depends on MCUX_HW_DEVICE_ID_RW612

config MCUX_HW_IP_DriverType_LPC_RSTCTL1
    bool
    default y
    depends on MCUX_HW_DEVICE_ID_RW612

config MCUX_HW_IP_DriverType_LPC_SYSCTL0
    bool
    default y
    depends on MCUX_HW_DEVICE_ID_RW612

config MCUX_HW_IP_DriverType_LPC_SYSCTL1
    bool
    default y
    depends on MCUX_HW_DEVICE_ID_RW612

config MCUX_HW_IP_DriverType_LPC_SYSCTL2
    bool
    default y
    depends on MCUX_HW_DEVICE_ID_RW612

config MCUX_HW_IP_DriverType_MCO_CRC
    bool
    default y
    depends on MCUX_HW_DEVICE_ID_RW612

config MCUX_HW_IP_DriverType_MCO_FREQME
    bool
    default y
    depends on MCUX_HW_DEVICE_ID_RW612

config MCUX_HW_IP_DriverType_MEMORY
    bool
    default y
    depends on MCUX_HW_DEVICE_ID_RW612

config MCUX_HW_IP_DriverType_MRT
    bool
    default y
    depends on MCUX_HW_DEVICE_ID_RW612

config MCUX_HW_IP_DriverType_OSTIMER
    bool
    default y
    depends on MCUX_HW_DEVICE_ID_RW612

config MCUX_HW_IP_DriverType_OTP_RW61X
    bool
    default y
    depends on MCUX_HW_DEVICE_ID_RW612

config MCUX_HW_IP_DriverType_PINT
    bool
    default y
    depends on MCUX_HW_DEVICE_ID_RW612

config MCUX_HW_IP_DriverType_PKC
    bool
    default y
    depends on MCUX_HW_DEVICE_ID_RW612

config MCUX_HW_IP_DriverType_POWERLIB
    bool
    default y
    depends on MCUX_HW_DEVICE_ID_RW612

config MCUX_HW_IP_DriverType_POWERQUAD
    bool
    default y
    depends on MCUX_HW_DEVICE_ID_RW612

config MCUX_HW_IP_DriverType_ROMC
    bool
    default y
    depends on MCUX_HW_DEVICE_ID_RW612

config MCUX_HW_IP_DriverType_RTC_LITE
    bool
    default y
    depends on MCUX_HW_DEVICE_ID_RW612

config MCUX_HW_IP_DriverType_RW_ITRC
    bool
    default y
    depends on MCUX_HW_DEVICE_ID_RW612

config MCUX_HW_IP_DriverType_SCTIMER
    bool
    default y
    depends on MCUX_HW_DEVICE_ID_RW612

config MCUX_HW_IP_DriverType_SDMA
    bool
    default y
    depends on MCUX_HW_DEVICE_ID_RW612

config MCUX_HW_IP_DriverType_TRNG
    bool
    default y
    depends on MCUX_HW_DEVICE_ID_RW612

config MCUX_HW_IP_DriverType_USB_HOST_DEVICE_EHCI
    bool
    default y
    depends on MCUX_HW_DEVICE_ID_RW612

config MCUX_HW_IP_DriverType_USIM
    bool
    default y
    depends on MCUX_HW_DEVICE_ID_RW612

config MCUX_HW_IP_DriverType_UTICK
    bool
    default y
    depends on MCUX_HW_DEVICE_ID_RW612

config MCUX_HW_IP_DriverType_WWDT
    bool
    default y
    depends on MCUX_HW_DEVICE_ID_RW612
```

## mcux/mcux-sdk-ng/devices/Wireless/RW/RW612/drivers/Kconfig
```kconfig
# Copyright 2024 NXP
#  
#
# SPDX-License-Identifier: BSD-3-Clause

menu "Device specific drivers configuration"

    config MCUX_COMPONENT_driver.clock
         bool "Use driver clock"
         default y

    config MCUX_COMPONENT_driver.i2s_bridge
         bool "Use driver i2s_bridge"
         default y

    config MCUX_COMPONENT_driver.inputmux_connections
         bool "Use driver inputmux_connections"
         default y

    config MCUX_COMPONENT_driver.io_mux
         bool "Use driver io_mux"
         default y

    config MCUX_COMPONENT_driver.iped_rw61x
         bool "Use driver iped"
         default y

    config MCUX_COMPONENT_driver.memory
         bool "Use driver memory"
         default y

    config MCUX_COMPONENT_driver.ocotp_rw61x
         bool "Use driver ocotp"
         default y

    config MCUX_COMPONENT_driver.power
         bool "Use driver power"
         default y

    config MCUX_COMPONENT_driver.reset
         bool "Use driver reset"
         default y

    config MCUX_COMPONENT_driver.romapi
         bool "Use driver romapi"

endmenu
```

## mcux/mcux-sdk-ng/devices/arm/Kconfig.common
```kconfig
rsource "../../arch/arm/configuration/Kconfig"
rsource "../../arch/arm/cortexm/Kconfig"
rsource "../../arch/arm/CMSIS/Kconfig"

menu "Device CMSIS system drivers"
    config MCUX_COMPONENT_device.CMSIS
        bool "Use device CMSIS"
        select MCUX_COMPONENT_CMSIS_Include_core_cm

    config MCUX_COMPONENT_device.system
        bool "Use device.system"
        imply MCUX_COMPONENT_device.CMSIS

    config MCUX_COMPONENT_device.startup
        bool "Use device.startup"
        imply MCUX_COMPONENT_device.system

    config MCUX_COMPONENT_device.RTE
        bool "Use device.rte driver"        
endmenu

menu "Device Suite"
    config MCUX_PRJSEG_module.device.suite
        bool "Use default device suite"
    config FLASH_BASE_ADDRESS
        hex "Flash base address for the application"
        default 0x0
endmenu
```

## mcux/mcux-sdk-ng/devices/dsp56800/Kconfig.common
```kconfig
rsource "../../arch/dsp56800/configuration/Kconfig"
rsource "../../arch/dsp56800/core/Kconfig"

menu "Device CMSIS system drivers"
    config MCUX_COMPONENT_device.CMSIS
        bool "Use device CMSIS"

    config MCUX_COMPONENT_device.system
        bool "Use device.system"
        imply MCUX_COMPONENT_device.CMSIS

    config MCUX_COMPONENT_device.startup
        bool "Use device.startup"
        imply MCUX_COMPONENT_device.system
endmenu

menu "Device Suite"
    config MCUX_PRJSEG_module.device.suite
        bool "Use default device suite"
endmenu
```

## mcux/mcux-sdk-ng/devices/ezhv/Kconfig.common
```kconfig
# Copyright 2024 NXP
#
# SPDX-License-Identifier: BSD-3-Clause

rsource "../../arch/riscv/configuration/Kconfig"
rsource "../../arch/riscv/core/Kconfig"
rsource "../../arch/riscv/headers/Kconfig"

menu "Device CMSIS system drivers"
    config MCUX_COMPONENT_device.CMSIS
        bool "Use device CMSIS"

    config MCUX_COMPONENT_device.system
        bool "Use device.system"
        imply MCUX_COMPONENT_device.CMSIS

    config MCUX_COMPONENT_device.startup
        bool "Use device.startup"
        imply MCUX_COMPONENT_device.system

    config MCUX_COMPONENT_device.RTE
        bool "Use device.rte driver"        
endmenu

menu "Device Suite"
    config MCUX_PRJSEG_module.device.suite
        bool "Use default device suite"
endmenu
```

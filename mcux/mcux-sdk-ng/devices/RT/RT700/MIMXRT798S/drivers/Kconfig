## mcux/mcux-sdk-ng/devices/Wireless/KW/KW45B41Z52/Kconfig.chip
```kconfig
# Copyright 2024 NXP
#
# SPDX-License-Identifier: BSD-3-Clause

# core related
config MCUX_HW_CORE
    string
    default "cm33"

config MCUX_HW_CORE_CM33
    bool
    default y

config MCUX_HW_CORE_ID
    string
    default "cm33"

config MCUX_HW_CORE_ID_CM33
    bool
    default y

config MCUX_HW_DEVICE_CORE
    string
    default "KW45B41Z52"

config MCUX_HW_FPU
    string
    default "SP_FPU"

config MCUX_HW_FPU_TYPE
    string
    default "fpv5_sp"

config MCUX_HW_FPV5_SP
    bool
    default y

config MCUX_HW_INT_PRIO_BITS
    int
    default 3

config MCUX_HW_DSP
    bool
    default y

config MCUX_HW_SAU
    bool
    default y

config MCUX_HW_SOC_SERIES_WIRELESS
    bool
    default y

config MCUX_HW_SOC_SINGLECORE_DEVICE
    bool
    default y

# device related

config MCUX_HW_DEVICE_ID_KW45B41Z52xxxA
    bool

choice
    prompt "Device KW45B41Z52 Part"
    config MCUX_HW_DEVICE_PART_KW45B41Z52AFTA
    bool "Device part KW45B41Z52AFTA"
    select MCUX_HW_DEVICE_ID_KW45B41Z52xxxA
    config MCUX_HW_DEVICE_PART_KW45B41Z52AFPA
    bool "Device part KW45B41Z52AFPA"
    select MCUX_HW_DEVICE_ID_KW45B41Z52xxxA
endchoice

config MCUX_HW_DEVICE_ID
    string
    default "KW45B41Z52xxxA" if MCUX_HW_DEVICE_ID_KW45B41Z52xxxA

config MCUX_HW_DEVICE_PART
    string
    default "KW45B41Z52AFTA" if MCUX_HW_DEVICE_PART_KW45B41Z52AFTA
    default "KW45B41Z52AFPA" if MCUX_HW_DEVICE_PART_KW45B41Z52AFPA

# For chipmodel generated files
config MCUX_TOOLCHAIN_LINKER_DEVICE_PREFIX
    string
    default "KW45B41Z52xxxA" if MCUX_HW_DEVICE_ID_KW45B41Z52xxxA

config MCUX_TOOLCHAIN_MCUX_STARTUP
    string
    default "kw45b41z52"

# Toolchain related

config MCUX_TOOLCHAIN_IAR_CPU_IDENTIFIER
    string
    default "KW45B41Z52" if MCUX_HW_DEVICE_ID_KW45B41Z52xxxA

config MCUX_TOOLCHAIN_MDK_CPU_IDENTIFIER
    string
    default "KW45B41Z52AFTA" if MCUX_HW_DEVICE_PART_KW45B41Z52AFTA
    default "KW45B41Z52AFPA" if MCUX_HW_DEVICE_PART_KW45B41Z52AFPA

config MCUX_TOOLCHAIN_JLINK_CPU_IDENTIFIER
    string
    default "KW45B41Z52" if MCUX_HW_DEVICE_ID_KW45B41Z52xxxA

# ip information
config MCUX_HW_IP_DriverType_ATX
    bool
    default y
    depends on MCUX_HW_DEVICE_ID_KW45B41Z52xxxA

config MCUX_HW_IP_DriverType_AXBS
    bool
    default y
    depends on MCUX_HW_DEVICE_ID_KW45B41Z52xxxA

config MCUX_HW_IP_DriverType_BLE2_REG
    bool
    default y
    depends on MCUX_HW_DEVICE_ID_KW45B41Z52xxxA

config MCUX_HW_IP_DriverType_BTLE_RF
    bool
    default y
    depends on MCUX_HW_DEVICE_ID_KW45B41Z52xxxA

config MCUX_HW_IP_DriverType_BTRTU1
    bool
    default y
    depends on MCUX_HW_DEVICE_ID_KW45B41Z52xxxA

config MCUX_HW_IP_DriverType_BTU2_REG
    bool
    default y
    depends on MCUX_HW_DEVICE_ID_KW45B41Z52xxxA

config MCUX_HW_IP_DriverType_CCM32K
    bool
    default y
    depends on MCUX_HW_DEVICE_ID_KW45B41Z52xxxA

config MCUX_HW_IP_DriverType_CMC
    bool
    default y
    depends on MCUX_HW_DEVICE_ID_KW45B41Z52xxxA

config MCUX_HW_IP_DriverType_CRC
    bool
    default y
    depends on MCUX_HW_DEVICE_ID_KW45B41Z52xxxA

config MCUX_HW_IP_DriverType_DSB
    bool
    default y
    depends on MCUX_HW_DEVICE_ID_KW45B41Z52xxxA

config MCUX_HW_IP_DriverType_DMA3
    bool
    default y
    depends on MCUX_HW_DEVICE_ID_KW45B41Z52xxxA

config MCUX_HW_IP_DriverType_ELEMU
    bool
    default y
    depends on MCUX_HW_DEVICE_ID_KW45B41Z52xxxA

config MCUX_HW_IP_DriverType_EWM
    bool
    default y
    depends on MCUX_HW_DEVICE_ID_KW45B41Z52xxxA

config MCUX_HW_IP_DriverType_FLASH_K4
    bool
    default y
    depends on MCUX_HW_DEVICE_ID_KW45B41Z52xxxA

config MCUX_HW_IP_DriverType_FLEXIO
    bool
    default y
    depends on MCUX_HW_DEVICE_ID_KW45B41Z52xxxA

config MCUX_HW_IP_DriverType_FMC
    bool
    default y
    depends on MCUX_HW_DEVICE_ID_KW45B41Z52xxxA

config MCUX_HW_IP_DriverType_FRO192
    bool
    default y
    depends on MCUX_HW_DEVICE_ID_KW45B41Z52xxxA

config MCUX_HW_IP_DriverType_GEN4PHY
    bool
    default y
    depends on MCUX_HW_DEVICE_ID_KW45B41Z52xxxA

config MCUX_HW_IP_DriverType_GENFSK
    bool
    default y
    depends on MCUX_HW_DEVICE_ID_KW45B41Z52xxxA

config MCUX_HW_IP_DriverType_GPIO
    bool
    default y
    depends on MCUX_HW_DEVICE_ID_KW45B41Z52xxxA

config MCUX_HW_IP_DriverType_I3C
    bool
    default y
    depends on MCUX_HW_DEVICE_ID_KW45B41Z52xxxA

config MCUX_HW_IP_DriverType_IMU
    bool
    default y
    depends on MCUX_HW_DEVICE_ID_KW45B41Z52xxxA

config MCUX_HW_IP_DriverType_LPADC
    bool
    default y
    depends on MCUX_HW_DEVICE_ID_KW45B41Z52xxxA

config MCUX_HW_IP_DriverType_LPCMP
    bool
    default y
    depends on MCUX_HW_DEVICE_ID_KW45B41Z52xxxA

config MCUX_HW_IP_DriverType_LPI2C
    bool
    default y
    depends on MCUX_HW_DEVICE_ID_KW45B41Z52xxxA

config MCUX_HW_IP_DriverType_LPIT
    bool
    default y
    depends on MCUX_HW_DEVICE_ID_KW45B41Z52xxxA

config MCUX_HW_IP_DriverType_LPSPI
    bool
    default y
    depends on MCUX_HW_DEVICE_ID_KW45B41Z52xxxA

config MCUX_HW_IP_DriverType_LPTMR
    bool
    default y
    depends on MCUX_HW_DEVICE_ID_KW45B41Z52xxxA

config MCUX_HW_IP_DriverType_LPUART
    bool
    default y
    depends on MCUX_HW_DEVICE_ID_KW45B41Z52xxxA

config MCUX_HW_IP_DriverType_LTC
    bool
    default y
    depends on MCUX_HW_DEVICE_ID_KW45B41Z52xxxA

config MCUX_HW_IP_DriverType_MCM
    bool
    default y
    depends on MCUX_HW_DEVICE_ID_KW45B41Z52xxxA

config MCUX_HW_IP_DriverType_MRCC
    bool
    default y
    depends on MCUX_HW_DEVICE_ID_KW45B41Z52xxxA

config MCUX_HW_IP_DriverType_MSCM
    bool
    default y
    depends on MCUX_HW_DEVICE_ID_KW45B41Z52xxxA

config MCUX_HW_IP_DriverType_MSF1
    bool
    default y
    depends on MCUX_HW_DEVICE_ID_KW45B41Z52xxxA

config MCUX_HW_IP_DriverType_PORT
    bool
    default y
    depends on MCUX_HW_DEVICE_ID_KW45B41Z52xxxA

config MCUX_HW_IP_DriverType_RADIO_CTRL
    bool
    default y
    depends on MCUX_HW_DEVICE_ID_KW45B41Z52xxxA

config MCUX_HW_IP_DriverType_RADIO_PACKET_RAM
    bool
    default y
    depends on MCUX_HW_DEVICE_ID_KW45B41Z52xxxA

config MCUX_HW_IP_DriverType_RBME
    bool
    default y
    depends on MCUX_HW_DEVICE_ID_KW45B41Z52xxxA

config MCUX_HW_IP_DriverType_REGFILE
    bool
    default y
    depends on MCUX_HW_DEVICE_ID_KW45B41Z52xxxA

config MCUX_HW_IP_DriverType_RFMC
    bool
    default y
    depends on MCUX_HW_DEVICE_ID_KW45B41Z52xxxA

config MCUX_HW_IP_DriverType_RF_CMC
    bool
    default y
    depends on MCUX_HW_DEVICE_ID_KW45B41Z52xxxA

config MCUX_HW_IP_DriverType_SCG
    bool
    default y
    depends on MCUX_HW_DEVICE_ID_KW45B41Z52xxxA

config MCUX_HW_IP_DriverType_SFA
    bool
    default y
    depends on MCUX_HW_DEVICE_ID_KW45B41Z52xxxA

config MCUX_HW_IP_DriverType_SEMA42
    bool
    default y
    depends on MCUX_HW_DEVICE_ID_KW45B41Z52xxxA

config MCUX_HW_IP_DriverType_SMSCM
    bool
    default y
    depends on MCUX_HW_DEVICE_ID_KW45B41Z52xxxA

config MCUX_HW_IP_DriverType_SPC
    bool
    default y
    depends on MCUX_HW_DEVICE_ID_KW45B41Z52xxxA

config MCUX_HW_IP_DriverType_SRTC
    bool
    default y
    depends on MCUX_HW_DEVICE_ID_KW45B41Z52xxxA

config MCUX_HW_IP_DriverType_SYSPM
    bool
    default y
    depends on MCUX_HW_DEVICE_ID_KW45B41Z52xxxA

config MCUX_HW_IP_DriverType_TPIU
    bool
    default y
    depends on MCUX_HW_DEVICE_ID_KW45B41Z52xxxA

config MCUX_HW_IP_DriverType_TPM
    bool
    default y
    depends on MCUX_HW_DEVICE_ID_KW45B41Z52xxxA

config MCUX_HW_IP_DriverType_TRDC
    bool
    default y
    depends on MCUX_HW_DEVICE_ID_KW45B41Z52xxxA

config MCUX_HW_IP_DriverType_TRGMUX
    bool
    default y
    depends on MCUX_HW_DEVICE_ID_KW45B41Z52xxxA

config MCUX_HW_IP_DriverType_TSTMR
    bool
    default y
    depends on MCUX_HW_DEVICE_ID_KW45B41Z52xxxA

config MCUX_HW_IP_DriverType_VBAT
    bool
    default y
    depends on MCUX_HW_DEVICE_ID_KW45B41Z52xxxA

config MCUX_HW_IP_DriverType_VREF_1
    bool
    default y
    depends on MCUX_HW_DEVICE_ID_KW45B41Z52xxxA

config MCUX_HW_IP_DriverType_WDOG32
    bool
    default y
    depends on MCUX_HW_DEVICE_ID_KW45B41Z52xxxA

config MCUX_HW_IP_DriverType_WOR
    bool
    default y
    depends on MCUX_HW_DEVICE_ID_KW45B41Z52xxxA

config MCUX_HW_IP_DriverType_WUU
    bool
    default y
    depends on MCUX_HW_DEVICE_ID_KW45B41Z52xxxA

config MCUX_HW_IP_DriverType_XCVR_ANALOG
    bool
    default y
    depends on MCUX_HW_DEVICE_ID_KW45B41Z52xxxA

config MCUX_HW_IP_DriverType_XCVR_MISC
    bool
    default y
    depends on MCUX_HW_DEVICE_ID_KW45B41Z52xxxA

config MCUX_HW_IP_DriverType_XCVR_PLL_DIG
    bool
    default y
    depends on MCUX_HW_DEVICE_ID_KW45B41Z52xxxA

config MCUX_HW_IP_DriverType_XCVR_RX_DIG
    bool
    default y
    depends on MCUX_HW_DEVICE_ID_KW45B41Z52xxxA

config MCUX_HW_IP_DriverType_XCVR_TSM
    bool
    default y
    depends on MCUX_HW_DEVICE_ID_KW45B41Z52xxxA

config MCUX_HW_IP_DriverType_XCVR_TX_DIG
    bool
    default y
    depends on MCUX_HW_DEVICE_ID_KW45B41Z52xxxA
```

## mcux/mcux-sdk-ng/devices/Wireless/KW/KW45Z41052/drivers/Kconfig
```kconfig
# Copyright 2024 NXP
#
# SPDX-License-Identifier: BSD-3-Clause

menu "Device specific drivers configuration"
     rsource "../../KW45B41Z83/drivers/Kconfig_clock"
     rsource "../../KW45B41Z83/drivers/Kconfig_romapi"
endmenu
```

## mcux/mcux-sdk-ng/devices/Wireless/KW/KW47B42Z83/cm33_core0/Kconfig
```kconfig
# Copyright 2024 NXP
#  
#
# SPDX-License-Identifier: BSD-3-Clause

config MCUX_HW_DEVICE_KW47B42Z83_CORE_ID_cm33_core0
    bool
    default y

rsource "Kconfig.chip"

config ECC_RAM_STCM8_INIT
    bool "ECC_RAM_STCM8_INIT"
    help
        No prefix in generated macro
```

## mcux/mcux-sdk-ng/devices/Wireless/KW/KW47B42Z83/cm33_core1/Kconfig.chip
```kconfig
# Copyright 2024 NXP
#
# SPDX-License-Identifier: BSD-3-Clause

# core related
config MCUX_HW_CORE
    string
    default "cm33"

config MCUX_HW_CORE_CM33
    bool
    default y

config MCUX_HW_CORE_ID
    string
    default "cm33_core1"

config MCUX_HW_CORE_ID_CM33_CORE1
    bool
    default y

config MCUX_HW_DEVICE_CORE
    string
    default "KW47B42Z83_cm33_core1"

config MCUX_HW_FPU
    string
    default "NO_FPU"

config MCUX_HW_FPU_TYPE
    string
    default "no_fpu"

config MCUX_HW_NO_FPU
    bool
    default y

config MCUX_HW_INT_PRIO_BITS
    int
    default 3

config MCUX_HW_DSP
    bool
    default n

config MCUX_HW_SAU
    bool
    default y

config MCUX_HW_SOC_SERIES_WIRELESS
    bool
    default y

config MCUX_HW_SOC_SINGLECORE_DEVICE
    bool
    default y

# For chipmodel generated files
config MCUX_TOOLCHAIN_LINKER_DEVICE_PREFIX
    string
    default "kw47b42z8_cm33_core1" if MCUX_HW_DEVICE_ID_KW47B42Z83xxxA

config MCUX_TOOLCHAIN_MCUX_STARTUP
    string
    default "kw47b42z83_cm33_core1"

# Toolchain related

config MCUX_TOOLCHAIN_IAR_CPU_IDENTIFIER
    string
    default "KW47B42Z83_core1" if MCUX_HW_DEVICE_ID_KW47B42Z83xxxA

config MCUX_TOOLCHAIN_MDK_CPU_IDENTIFIER
    string
    default "KW47B42Z83AFTA" if MCUX_HW_DEVICE_PART_KW47B42Z83AFTA

config MCUX_TOOLCHAIN_JLINK_CPU_IDENTIFIER
    string
    default "KW47B42Z83" if MCUX_HW_DEVICE_ID_KW47B42Z83xxxA
```

## mcux/mcux-sdk-ng/devices/Wireless/KW/KW47B42Z83/drivers/Kconfig
```kconfig
# Copyright 2024 NXP
#
# SPDX-License-Identifier: BSD-3-Clause

menu "Device specific drivers configuration"
     rsource "../../KW47B42ZB7/drivers/Kconfig_clock"
     rsource "../../KW47B42ZB7/drivers/Kconfig_romapi"
endmenu
```

## mcux/mcux-sdk-ng/devices/Wireless/KW/KW47B42Z97/cm33_core0/Kconfig.chip
```kconfig
# Copyright 2024 NXP
#
# SPDX-License-Identifier: BSD-3-Clause

# core related

config MCUX_HW_CORE
    string
    default "cm33"

config MCUX_HW_CORE_CM33
    bool
    default y

config MCUX_HW_CORE_ID
    string
    default "cm33_core0"

config MCUX_HW_CORE_ID_CM33_CORE0
    bool
    default y

config MCUX_HW_DEVICE_CORE
    string
    default "KW47B42Z97_cm33_core0"

config MCUX_HW_FPU
    string
    default "SP_FPU"

config MCUX_HW_FPU_TYPE
    string
    default "fpv5_sp"

config MCUX_HW_FPV5_SP
    bool
    default y

config MCUX_HW_INT_PRIO_BITS
    int
    default 3

config MCUX_HW_DSP
    bool
    default y

config MCUX_HW_SAU
    bool
    default y

config MCUX_HW_SOC_SERIES_WIRELESS
    bool
    default y

config MCUX_HW_SOC_SINGLECORE_DEVICE
    bool
    default y

# For chipmodel generated files
config MCUX_TOOLCHAIN_LINKER_DEVICE_PREFIX
    string
    default "kw47b42z9_cm33_core0" if MCUX_HW_DEVICE_ID_KW47B42Z97xxxA

config MCUX_TOOLCHAIN_MCUX_STARTUP
    string
    default "kw47b42z97_cm33_core0"

# Toolchain related

config MCUX_TOOLCHAIN_IAR_CPU_IDENTIFIER
    string
    default "KW47B42Z97_core0" if MCUX_HW_DEVICE_ID_KW47B42Z97xxxA

config MCUX_TOOLCHAIN_MDK_CPU_IDENTIFIER
    string
    default "KW47B42Z97AFTA" if MCUX_HW_DEVICE_PART_KW47B42Z97AFTA

config MCUX_TOOLCHAIN_JLINK_CPU_IDENTIFIER
    string
    default "KW47B42Z97" if MCUX_HW_DEVICE_ID_KW47B42Z97xxxA
```

## mcux/mcux-sdk-ng/devices/Wireless/KW/KW47B42ZB3/Kconfig
```kconfig
# Copyright 2024 NXP
#
# SPDX-License-Identifier: BSD-3-Clause
rsource "${core_id}/Kconfig"

rsource "Kconfig.chip"
rsource "drivers/Kconfig"
rsource "../../../arm/Kconfig.common"
rsource "Kconfig.defconfig"

## Project segment and component dependency data
config MCUX_HW_DEVICE_KW47B42ZB3
    # bool "Device KW47B42ZB3 Configuration"
    bool
    default y

    # component dependency
    select MCUX_COMPONENT_driver.lpadc if MCUX_COMPONENT_device.utility
    select MCUX_COMPONENT_driver.vref_1 if MCUX_COMPONENT_device.utility
    select MCUX_COMPONENT_driver.dma3 if MCUX_COMPONENT_driver.lpi2c_edma
    select MCUX_COMPONENT_driver.dma3 if MCUX_COMPONENT_driver.lpspi_edma
    select MCUX_COMPONENT_driver.dma3 if MCUX_COMPONENT_driver.lpuart_edma
    select MCUX_COMPONENT_driver.dma3 if MCUX_COMPONENT_driver.flexcan_edma
    select MCUX_COMPONENT_driver.dma3 if MCUX_COMPONENT_driver.flexio_uart_edma
    select MCUX_COMPONENT_driver.dma3 if MCUX_COMPONENT_driver.flexio_spi_edma
    select MCUX_COMPONENT_driver.lpi2c_edma if MCUX_COMPONENT_driver.cmsis_lpi2c
    select MCUX_COMPONENT_driver.lpspi_edma if MCUX_COMPONENT_driver.cmsis_lpspi
    select MCUX_COMPONENT_driver.lpuart_edma if MCUX_COMPONENT_driver.cmsis_lpuart
    select MCUX_COMPONENT_component.lpuart_adapter if MCUX_COMPONENT_component.serial_manager_uart
    select MCUX_COMPONENT_component.lpuart_adapter if MCUX_COMPONENT_utility.debug_console_lite

    select MCUX_COMPONENT_driver.spc   if MCUX_COMPONENT_component.power_manager_framework
    select MCUX_COMPONENT_driver.cmc   if MCUX_COMPONENT_component.power_manager_framework
    select MCUX_COMPONENT_driver.wuu   if MCUX_COMPONENT_component.power_manager_framework
    select MCUX_COMPONENT_driver.crc   if MCUX_COMPONENT_component.power_manager_framework
```

## mcux/mcux-sdk-ng/devices/Wireless/KW/KW47B42ZB3/cm33_core1/Kconfig
```kconfig
# Copyright 2024 NXP
#  
#
# SPDX-License-Identifier: BSD-3-Clause

config MCUX_HW_DEVICE_KW47B42ZB3_CORE_ID_cm33_core1
    bool
    default y

rsource "Kconfig.chip"
```

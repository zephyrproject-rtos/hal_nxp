## mcux/mcux-sdk-ng/devices/RT/RT700/MIMXRT798S/drivers/Kconfig
```kconfig
# Copyright 2024 NXP
# All rights reserved.
#
# SPDX-License-Identifier: BSD-3-Clause

menu "Device specific drivers configuration"
    rsource "./Kconfig_clock"
    rsource "./Kconfig_dsp"
    rsource "./Kconfig_edma_soc"
    rsource "./Kconfig_ezhv"
    rsource "./Kconfig_inputmux_connections"
    rsource "./Kconfig_iopctl_soc"
    rsource "./Kconfig_mipi_dsi_soc"
    rsource "./Kconfig_power"
    rsource "./Kconfig_reset"
    rsource "./Kconfig_romapi"
endmenu
```

## mcux/mcux-sdk-ng/devices/RT/RT700/MIMXRT798S/ezhv/Kconfig.chip
```kconfig
# Copyright 2024 NXP
#
# SPDX-License-Identifier: BSD-3-Clause

# core related
config MCUX_HW_CORE
    string
    default "ezhv"

config MCUX_HW_CORE_EZHV
    bool
    default y

config MCUX_HW_CORE_ID
    string
    default "ezhv"

config MCUX_HW_CORE_ID_EZHV
    bool
    default y

config MCUX_HW_DEVICE_CORE
    string
    default "MIMXRT798S_ezhv"

config MCUX_HW_SOC_SERIES_RT
    bool
    default y

# For chipmodel generated files
config MCUX_TOOLCHAIN_LINKER_DEVICE_PREFIX
    string
    default "MIMXRT798S_ezhv" if MCUX_HW_DEVICE_ID_MIMXRT798S

config MCUX_TOOLCHAIN_MCUX_STARTUP
    string
    default "mimxrt798s_ezhv"
```

## mcux/mcux-sdk-ng/devices/Wireless/K32W/K32W1480/Kconfig.chip
```kconfig
# Copyright 2024 NXP
#
# SPDX-License-Identifier: BSD-3-Clause

# core related
config MCUX_HW_CORE
    string
    default "cm33"

config MCUX_HW_CORE_CM33
    bool
    default y

config MCUX_HW_CORE_ID
    string
    default "cm33"

config MCUX_HW_CORE_ID_CM33
    bool
    default y

config MCUX_HW_DEVICE_CORE
    string
    default "K32W1480"

config MCUX_HW_FPU
    string
    default "SP_FPU"

config MCUX_HW_FPU_TYPE
    string
    default "fpv5_sp"

config MCUX_HW_FPV5_SP
    bool
    default y

config MCUX_HW_INT_PRIO_BITS
    int
    default 3

config MCUX_HW_DSP
    bool
    default y

config MCUX_HW_SAU
    bool
    default y

config MCUX_HW_SOC_SERIES_WIRELESS
    bool
    default y

config MCUX_HW_SOC_SINGLECORE_DEVICE
    bool
    default y

# device related

config MCUX_HW_DEVICE_ID_K32W1480xxxA
    bool

choice MCUX_HW_DEVICE_PART_K32W1480
    prompt "Device K32W1480 Part"
    config MCUX_HW_DEVICE_PART_K32W1480VFTA
    bool "Device part K32W1480VFTA"
    select MCUX_HW_DEVICE_ID_K32W1480xxxA
endchoice

config MCUX_HW_DEVICE_ID
    string
    default "K32W1480xxxA" if MCUX_HW_DEVICE_ID_K32W1480xxxA

config MCUX_HW_DEVICE_PART
    string
    default "K32W1480VFTA" if MCUX_HW_DEVICE_PART_K32W1480VFTA

# For chipmodel generated files
config MCUX_TOOLCHAIN_LINKER_DEVICE_PREFIX
    string
    default "K32W1480xxxA" if MCUX_HW_DEVICE_ID_K32W1480xxxA

config MCUX_TOOLCHAIN_MCUX_STARTUP
    string
    default "k32w148"

# Toolchain related

config MCUX_TOOLCHAIN_IAR_CPU_IDENTIFIER
    string
    default "K32W1480" if MCUX_HW_DEVICE_ID_K32W1480xxxA

config MCUX_TOOLCHAIN_MDK_CPU_IDENTIFIER
    string
    default "K32W1480VFTA" if MCUX_HW_DEVICE_PART_K32W1480VFTA

config MCUX_TOOLCHAIN_JLINK_CPU_IDENTIFIER
    string
    default "K32W1480" if MCUX_HW_DEVICE_ID_K32W1480xxxA

# ip information
config MCUX_HW_IP_DriverType_ATX
    bool
    default y
    depends on MCUX_HW_DEVICE_ID_K32W1480xxxA

config MCUX_HW_IP_DriverType_AXBS
    bool
    default y
    depends on MCUX_HW_DEVICE_ID_K32W1480xxxA

config MCUX_HW_IP_DriverType_BLE2_REG
    bool
    default y
    depends on MCUX_HW_DEVICE_ID_K32W1480xxxA

config MCUX_HW_IP_DriverType_BTLE_RF
    bool
    default y
    depends on MCUX_HW_DEVICE_ID_K32W1480xxxA

config MCUX_HW_IP_DriverType_BTRTU1
    bool
    default y
    depends on MCUX_HW_DEVICE_ID_K32W1480xxxA

config MCUX_HW_IP_DriverType_BTU2_REG
    bool
    default y
    depends on MCUX_HW_DEVICE_ID_K32W1480xxxA

config MCUX_HW_IP_DriverType_CCM32K
    bool
    default y
    depends on MCUX_HW_DEVICE_ID_K32W1480xxxA

config MCUX_HW_IP_DriverType_CMC
    bool
    default y
    depends on MCUX_HW_DEVICE_ID_K32W1480xxxA

config MCUX_HW_IP_DriverType_CRC
    bool
    default y
    depends on MCUX_HW_DEVICE_ID_K32W1480xxxA

config MCUX_HW_IP_DriverType_DSB
    bool
    default y
    depends on MCUX_HW_DEVICE_ID_K32W1480xxxA

config MCUX_HW_IP_DriverType_DMA3
    bool
    default y
    depends on MCUX_HW_DEVICE_ID_K32W1480xxxA

config MCUX_HW_IP_DriverType_ELEMU
    bool
    default y
    depends on MCUX_HW_DEVICE_ID_K32W1480xxxA

config MCUX_HW_IP_DriverType_EWM
    bool
    default y
    depends on MCUX_HW_DEVICE_ID_K32W1480xxxA

config MCUX_HW_IP_DriverType_FLASH_K4
    bool
    default y
    depends on MCUX_HW_DEVICE_ID_K32W1480xxxA

config MCUX_HW_IP_DriverType_FLEXIO
    bool
    default y
    depends on MCUX_HW_DEVICE_ID_K32W1480xxxA

config MCUX_HW_IP_DriverType_FMC
    bool
    default y
    depends on MCUX_HW_DEVICE_ID_K32W1480xxxA

config MCUX_HW_IP_DriverType_FRO192
    bool
    default y
    depends on MCUX_HW_DEVICE_ID_K32W1480xxxA

config MCUX_HW_IP_DriverType_GEN4PHY
    bool
    default y
    depends on MCUX_HW_DEVICE_ID_K32W1480xxxA

config MCUX_HW_IP_DriverType_GENFSK
    bool
    default y
    depends on MCUX_HW_DEVICE_ID_K32W1480xxxA

config MCUX_HW_IP_DriverType_GPIO
    bool
    default y
    depends on MCUX_HW_DEVICE_ID_K32W1480xxxA

config MCUX_HW_IP_DriverType_I3C
    bool
    default y
    depends on MCUX_HW_DEVICE_ID_K32W1480xxxA

config MCUX_HW_IP_DriverType_IMU
    bool
    default y
    depends on MCUX_HW_DEVICE_ID_K32W1480xxxA

config MCUX_HW_IP_DriverType_LPADC
    bool
    default y
    depends on MCUX_HW_DEVICE_ID_K32W1480xxxA

config MCUX_HW_IP_DriverType_LPCMP
    bool
    default y
    depends on MCUX_HW_DEVICE_ID_K32W1480xxxA

config MCUX_HW_IP_DriverType_LPI2C
    bool
    default y
    depends on MCUX_HW_DEVICE_ID_K32W1480xxxA

config MCUX_HW_IP_DriverType_LPIT
    bool
    default y
    depends on MCUX_HW_DEVICE_ID_K32W1480xxxA

config MCUX_HW_IP_DriverType_LPSPI
    bool
    default y
    depends on MCUX_HW_DEVICE_ID_K32W1480xxxA

config MCUX_HW_IP_DriverType_LPTMR
    bool
    default y
    depends on MCUX_HW_DEVICE_ID_K32W1480xxxA

config MCUX_HW_IP_DriverType_LPUART
    bool
    default y
    depends on MCUX_HW_DEVICE_ID_K32W1480xxxA

config MCUX_HW_IP_DriverType_LTC
    bool
    default y
    depends on MCUX_HW_DEVICE_ID_K32W1480xxxA

config MCUX_HW_IP_DriverType_MCM
    bool
    default y
    depends on MCUX_HW_DEVICE_ID_K32W1480xxxA

config MCUX_HW_IP_DriverType_MRCC
    bool
    default y
    depends on MCUX_HW_DEVICE_ID_K32W1480xxxA

config MCUX_HW_IP_DriverType_MSCM
    bool
    default y
    depends on MCUX_HW_DEVICE_ID_K32W1480xxxA

config MCUX_HW_IP_DriverType_MSF1
    bool
    default y
    depends on MCUX_HW_DEVICE_ID_K32W1480xxxA

config MCUX_HW_IP_DriverType_PORT
    bool
    default y
    depends on MCUX_HW_DEVICE_ID_K32W1480xxxA

config MCUX_HW_IP_DriverType_RADIO_CTRL
    bool
    default y
    depends on MCUX_HW_DEVICE_ID_K32W1480xxxA

config MCUX_HW_IP_DriverType_RADIO_PACKET_RAM
    bool
    default y
    depends on MCUX_HW_DEVICE_ID_K32W1480xxxA

config MCUX_HW_IP_DriverType_RBME
    bool
    default y
    depends on MCUX_HW_DEVICE_ID_K32W1480xxxA

config MCUX_HW_IP_DriverType_REGFILE
    bool
    default y
    depends on MCUX_HW_DEVICE_ID_K32W1480xxxA

config MCUX_HW_IP_DriverType_RFMC
    bool
    default y
    depends on MCUX_HW_DEVICE_ID_K32W1480xxxA

config MCUX_HW_IP_DriverType_RF_CMC
    bool
    default y
    depends on MCUX_HW_DEVICE_ID_K32W1480xxxA

config MCUX_HW_IP_DriverType_SCG
    bool
    default y
    depends on MCUX_HW_DEVICE_ID_K32W1480xxxA

config MCUX_HW_IP_DriverType_SFA
    bool
    default y
    depends on MCUX_HW_DEVICE_ID_K32W1480xxxA

config MCUX_HW_IP_DriverType_SEMA42
    bool
    default y
    depends on MCUX_HW_DEVICE_ID_K32W1480xxxA

config MCUX_HW_IP_DriverType_SMSCM
    bool
    default y
    depends on MCUX_HW_DEVICE_ID_K32W1480xxxA

config MCUX_HW_IP_DriverType_SPC
    bool
    default y
    depends on MCUX_HW_DEVICE_ID_K32W1480xxxA

config MCUX_HW_IP_DriverType_SRTC
    bool
    default y
    depends on MCUX_HW_DEVICE_ID_K32W1480xxxA

config MCUX_HW_IP_DriverType_SYSPM
    bool
    default y
    depends on MCUX_HW_DEVICE_ID_K32W1480xxxA

config MCUX_HW_IP_DriverType_TPIU
    bool
    default y
    depends on MCUX_HW_DEVICE_ID_K32W1480xxxA

config MCUX_HW_IP_DriverType_TPM
    bool
    default y
    depends on MCUX_HW_DEVICE_ID_K32W1480xxxA

config MCUX_HW_IP_DriverType_TRDC
    bool
    default y
    depends on MCUX_HW_DEVICE_ID_K32W1480xxxA

config MCUX_HW_IP_DriverType_TRGMUX
    bool
    default y
    depends on MCUX_HW_DEVICE_ID_K32W1480xxxA

config MCUX_HW_IP_DriverType_TSTMR
    bool
    default y
    depends on MCUX_HW_DEVICE_ID_K32W1480xxxA

config MCUX_HW_IP_DriverType_VBAT
    bool
    default y
    depends on MCUX_HW_DEVICE_ID_K32W1480xxxA

config MCUX_HW_IP_DriverType_VREF_1
    bool
    default y
    depends on MCUX_HW_DEVICE_ID_K32W1480xxxA

config MCUX_HW_IP_DriverType_WDOG32
    bool
    default y
    depends on MCUX_HW_DEVICE_ID_K32W1480xxxA

config MCUX_HW_IP_DriverType_WOR
    bool
    default y
    depends on MCUX_HW_DEVICE_ID_K32W1480xxxA

config MCUX_HW_IP_DriverType_WUU
    bool
    default y
    depends on MCUX_HW_DEVICE_ID_K32W1480xxxA

config MCUX_HW_IP_DriverType_XCVR_ANALOG
    bool
    default y
    depends on MCUX_HW_DEVICE_ID_K32W1480xxxA

config MCUX_HW_IP_DriverType_XCVR_MISC
    bool
    default y
    depends on MCUX_HW_DEVICE_ID_K32W1480xxxA

config MCUX_HW_IP_DriverType_XCVR_PLL_DIG
    bool
    default y
    depends on MCUX_HW_DEVICE_ID_K32W1480xxxA

config MCUX_HW_IP_DriverType_XCVR_RX_DIG
    bool
    default y
    depends on MCUX_HW_DEVICE_ID_K32W1480xxxA

config MCUX_HW_IP_DriverType_XCVR_TSM
    bool
    default y
    depends on MCUX_HW_DEVICE_ID_K32W1480xxxA

config MCUX_HW_IP_DriverType_XCVR_TX_DIG
    bool
    default y
    depends on MCUX_HW_DEVICE_ID_K32W1480xxxA

config MCUX_HW_IP_DriverType_XCVR_ZBDEMOD
    bool
    default y
    depends on MCUX_HW_DEVICE_ID_K32W1480xxxA

config MCUX_HW_IP_DriverType_ZLL
    bool
    default y
    depends on MCUX_HW_DEVICE_ID_K32W1480xxxA
```

## mcux/mcux-sdk-ng/devices/Wireless/K32W/K32W1480/drivers/Kconfig
```kconfig
# Copyright 2024 NXP
#  
#
# SPDX-License-Identifier: BSD-3-Clause

menu "Device specific drivers configuration"

    config MCUX_COMPONENT_driver.clock
         bool "Use driver clock"
         default y

    config MCUX_COMPONENT_driver.romapi_soc
         bool "Use driver ROMAPI"
         default n

endmenu
```

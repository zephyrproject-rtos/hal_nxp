## mcux/mcux-sdk-ng/devices/i.MX/i.MX8MN/MIMX8MN3/Kconfig.chip
```kconfig
# Copyright 2024 NXP
#
# SPDX-License-Identifier: BSD-3-Clause

# core related
config MCUX_HW_CORE
    string
    default "cm7f"

config MCUX_HW_CORE_CM7F
    bool
    default y

config MCUX_HW_CORE_ID
    string
    default "cm7"

config MCUX_HW_CORE_ID_CM7
    bool
    default y

config MCUX_HW_DEVICE_CORE
    string
    default "MIMX8MN3_cm7"

config MCUX_HW_FPU
    string
    default "SP_FPU"

config MCUX_HW_FPU_TYPE
    string
    default "fpv5_dp"

config MCUX_HW_FPV5_DP
    bool
    default y

config MCUX_HW_INT_PRIO_BITS
    int
    default 4

config MCUX_HW_SOC_SERIES_MIMX
    bool
    default y

config MCUX_HW_SOC_SINGLECORE_DEVICE
    bool
    default y

# device related

config MCUX_HW_DEVICE_ID_MIMX8MN3xxxJZ
    bool

config MCUX_HW_DEVICE_ID_MIMX8MN3xxxIZ
    bool

config MCUX_HW_DEVICE_DDR3
    prompt "Device Use DDR3"
    bool
    default y if $(board) = "evkmimx8mn"

config MCUX_HW_DEVICE_DDR3L
    prompt "Device Use DDR3L"
    bool
    default y if $(board) = "evkmimx8mnddr3l"

choice
    prompt "Device MIMX8MN3 Part"
    config MCUX_HW_DEVICE_PART_MIMX8MN3DVTJZ
    bool "Device part MIMX8MN3DVTJZ"
    select MCUX_HW_DEVICE_ID_MIMX8MN3xxxJZ
    config MCUX_HW_DEVICE_PART_MIMX8MN3CVTIZ
    bool "Device part MIMX8MN3CVTIZ"
    select MCUX_HW_DEVICE_ID_MIMX8MN3xxxIZ
    config MCUX_HW_DEVICE_PART_MIMX8MN3CVPIZ
    bool "Device part MIMX8MN3CVPIZ"
    select MCUX_HW_DEVICE_ID_MIMX8MN3xxxIZ
    config MCUX_HW_DEVICE_PART_MIMX8MN3DVPIZ
    bool "Device part MIMX8MN3DVPIZ"
    select MCUX_HW_DEVICE_ID_MIMX8MN3xxxIZ
endchoice

config MCUX_HW_DEVICE_ID
    string
    default "MIMX8MN3xxxJZ" if MCUX_HW_DEVICE_ID_MIMX8MN3xxxJZ
    default "MIMX8MN3xxxIZ" if MCUX_HW_DEVICE_ID_MIMX8MN3xxxIZ

config MCUX_HW_DEVICE_PART
    string
    default "MIMX8MN3DVTJZ" if MCUX_HW_DEVICE_PART_MIMX8MN3DVTJZ
    default "MIMX8MN3CVTIZ" if MCUX_HW_DEVICE_PART_MIMX8MN3CVTIZ
    default "MIMX8MN3CVPIZ" if MCUX_HW_DEVICE_PART_MIMX8MN3CVPIZ
    default "MIMX8MN3DVPIZ" if MCUX_HW_DEVICE_PART_MIMX8MN3DVPIZ

# For chipmodel generated files
config MCUX_TOOLCHAIN_LINKER_DEVICE_PREFIX
    string
    default "MIMX8MN3xxxJZ" if MCUX_HW_DEVICE_ID_MIMX8MN3xxxJZ
    default "MIMX8MN3xxxIZ" if MCUX_HW_DEVICE_ID_MIMX8MN3xxxIZ

config MCUX_TOOLCHAIN_MCUX_STARTUP
    string
    default "mimx8mn3"

# Toolchain related

config MCUX_TOOLCHAIN_IAR_CPU_IDENTIFIER
    string
    default "MIMX8MN3_M7" if MCUX_HW_DEVICE_ID_MIMX8MN3xxxJZ
    default "MIMX8MN3_M7" if MCUX_HW_DEVICE_ID_MIMX8MN3xxxIZ

config MCUX_TOOLCHAIN_MDK_CPU_IDENTIFIER
    string
    default "MIMX8MN3DVTJZ" if MCUX_HW_DEVICE_PART_MIMX8MN3DVTJZ
    default "MIMX8MN3CVTIZ" if MCUX_HW_DEVICE_PART_MIMX8MN3CVTIZ
    default "MIMX8MN3CVPIZ" if MCUX_HW_DEVICE_PART_MIMX8MN3CVPIZ
    default "MIMX8MN3DVPIZ" if MCUX_HW_DEVICE_PART_MIMX8MN3DVPIZ

# ip information
config MCUX_HW_IP_DriverType_APBH
    bool
    default y
    depends on MCUX_HW_DEVICE_ID_MIMX8MN3xxxJZ || MCUX_HW_DEVICE_ID_MIMX8MN3xxxIZ

config MCUX_HW_IP_DriverType_BCH
    bool
    default y
    depends on MCUX_HW_DEVICE_ID_MIMX8MN3xxxJZ || MCUX_HW_DEVICE_ID_MIMX8MN3xxxIZ

config MCUX_HW_IP_DriverType_CCM
    bool
    default y
    depends on MCUX_HW_DEVICE_ID_MIMX8MN3xxxJZ || MCUX_HW_DEVICE_ID_MIMX8MN3xxxIZ

config MCUX_HW_IP_DriverType_CCM_ANALOG
    bool
    default y
    depends on MCUX_HW_DEVICE_ID_MIMX8MN3xxxJZ || MCUX_HW_DEVICE_ID_MIMX8MN3xxxIZ

config MCUX_HW_IP_DriverType_DDRC_REGS
    bool
    default y
    depends on MCUX_HW_DEVICE_ID_MIMX8MN3xxxJZ || MCUX_HW_DEVICE_ID_MIMX8MN3xxxIZ

config MCUX_HW_IP_DriverType_DPH_DEF_DOMAIN
    bool
    default y
    depends on MCUX_HW_DEVICE_ID_MIMX8MN3xxxJZ || MCUX_HW_DEVICE_ID_MIMX8MN3xxxIZ

config MCUX_HW_IP_DriverType_DWC_DDRPHYA_ANIB
    bool
    default y
    depends on MCUX_HW_DEVICE_ID_MIMX8MN3xxxJZ || MCUX_HW_DEVICE_ID_MIMX8MN3xxxIZ

config MCUX_HW_IP_DriverType_DWC_DDRPHYA_APBONLY
    bool
    default y
    depends on MCUX_HW_DEVICE_ID_MIMX8MN3xxxJZ || MCUX_HW_DEVICE_ID_MIMX8MN3xxxIZ

config MCUX_HW_IP_DriverType_DWC_DDRPHYA_DBYTE
    bool
    default y
    depends on MCUX_HW_DEVICE_ID_MIMX8MN3xxxJZ || MCUX_HW_DEVICE_ID_MIMX8MN3xxxIZ

config MCUX_HW_IP_DriverType_DWC_DDRPHYA_DRTUB
    bool
    default y
    depends on MCUX_HW_DEVICE_ID_MIMX8MN3xxxJZ || MCUX_HW_DEVICE_ID_MIMX8MN3xxxIZ

config MCUX_HW_IP_DriverType_DWC_DDRPHYA_INITENG
    bool
    default y
    depends on MCUX_HW_DEVICE_ID_MIMX8MN3xxxJZ || MCUX_HW_DEVICE_ID_MIMX8MN3xxxIZ

config MCUX_HW_IP_DriverType_DWC_DDRPHYA_MASTER
    bool
    default y
    depends on MCUX_HW_DEVICE_ID_MIMX8MN3xxxJZ || MCUX_HW_DEVICE_ID_MIMX8MN3xxxIZ

config MCUX_HW_IP_DriverType_DWT
    bool
    default y
    depends on MCUX_HW_DEVICE_ID_MIMX8MN3xxxJZ || MCUX_HW_DEVICE_ID_MIMX8MN3xxxIZ

config MCUX_HW_IP_DriverType_EASRC
    bool
    default y
    depends on MCUX_HW_DEVICE_ID_MIMX8MN3xxxJZ || MCUX_HW_DEVICE_ID_MIMX8MN3xxxIZ

config MCUX_HW_IP_DriverType_ECSPI
    bool
    default y
    depends on MCUX_HW_DEVICE_ID_MIMX8MN3xxxJZ || MCUX_HW_DEVICE_ID_MIMX8MN3xxxIZ

config MCUX_HW_IP_DriverType_ENET
    bool
    default y
    depends on MCUX_HW_DEVICE_ID_MIMX8MN3xxxJZ || MCUX_HW_DEVICE_ID_MIMX8MN3xxxIZ

config MCUX_HW_IP_DriverType_ETM
    bool
    default y
    depends on MCUX_HW_DEVICE_ID_MIMX8MN3xxxJZ || MCUX_HW_DEVICE_ID_MIMX8MN3xxxIZ

config MCUX_HW_IP_DriverType_FlexSPI
    bool
    default y
    depends on MCUX_HW_DEVICE_ID_MIMX8MN3xxxJZ || MCUX_HW_DEVICE_ID_MIMX8MN3xxxIZ

config MCUX_HW_IP_DriverType_GPC_2
    bool
    default y
    depends on MCUX_HW_DEVICE_ID_MIMX8MN3xxxJZ || MCUX_HW_DEVICE_ID_MIMX8MN3xxxIZ

config MCUX_HW_IP_DriverType_GPC_PGC
    bool
    default y
    depends on MCUX_HW_DEVICE_ID_MIMX8MN3xxxJZ || MCUX_HW_DEVICE_ID_MIMX8MN3xxxIZ

config MCUX_HW_IP_DriverType_GPMI
    bool
    default y
    depends on MCUX_HW_DEVICE_ID_MIMX8MN3xxxJZ || MCUX_HW_DEVICE_ID_MIMX8MN3xxxIZ

config MCUX_HW_IP_DriverType_GPT
    bool
    default y
    depends on MCUX_HW_DEVICE_ID_MIMX8MN3xxxJZ || MCUX_HW_DEVICE_ID_MIMX8MN3xxxIZ

config MCUX_HW_IP_DriverType_IGPIO
    bool
    default y
    depends on MCUX_HW_DEVICE_ID_MIMX8MN3xxxJZ || MCUX_HW_DEVICE_ID_MIMX8MN3xxxIZ

config MCUX_HW_IP_DriverType_II2C
    bool
    default y
    depends on MCUX_HW_DEVICE_ID_MIMX8MN3xxxJZ || MCUX_HW_DEVICE_ID_MIMX8MN3xxxIZ

config MCUX_HW_IP_DriverType_IOMUXC
    bool
    default y
    depends on MCUX_HW_DEVICE_ID_MIMX8MN3xxxJZ || MCUX_HW_DEVICE_ID_MIMX8MN3xxxIZ

config MCUX_HW_IP_DriverType_IOMUXC_GPR
    bool
    default y
    depends on MCUX_HW_DEVICE_ID_MIMX8MN3xxxJZ || MCUX_HW_DEVICE_ID_MIMX8MN3xxxIZ

config MCUX_HW_IP_DriverType_IPWM
    bool
    default y
    depends on MCUX_HW_DEVICE_ID_MIMX8MN3xxxJZ || MCUX_HW_DEVICE_ID_MIMX8MN3xxxIZ

config MCUX_HW_IP_DriverType_ISI
    bool
    default y
    depends on MCUX_HW_DEVICE_ID_MIMX8MN3xxxJZ || MCUX_HW_DEVICE_ID_MIMX8MN3xxxIZ

config MCUX_HW_IP_DriverType_ITM
    bool
    default y
    depends on MCUX_HW_DEVICE_ID_MIMX8MN3xxxJZ || MCUX_HW_DEVICE_ID_MIMX8MN3xxxIZ

config MCUX_HW_IP_DriverType_IUART
    bool
    default y
    depends on MCUX_HW_DEVICE_ID_MIMX8MN3xxxJZ || MCUX_HW_DEVICE_ID_MIMX8MN3xxxIZ

config MCUX_HW_IP_DriverType_LCDIF
    bool
    default y
    depends on MCUX_HW_DEVICE_ID_MIMX8MN3xxxJZ || MCUX_HW_DEVICE_ID_MIMX8MN3xxxIZ

config MCUX_HW_IP_DriverType_MIPI_CSI
    bool
    default y
    depends on MCUX_HW_DEVICE_ID_MIMX8MN3xxxJZ || MCUX_HW_DEVICE_ID_MIMX8MN3xxxIZ

config MCUX_HW_IP_DriverType_MU
    bool
    default y
    depends on MCUX_HW_DEVICE_ID_MIMX8MN3xxxJZ || MCUX_HW_DEVICE_ID_MIMX8MN3xxxIZ

config MCUX_HW_IP_DriverType_OCOTP
    bool
    default y
    depends on MCUX_HW_DEVICE_ID_MIMX8MN3xxxJZ || MCUX_HW_DEVICE_ID_MIMX8MN3xxxIZ

config MCUX_HW_IP_DriverType_PDM
    bool
    default y
    depends on MCUX_HW_DEVICE_ID_MIMX8MN3xxxJZ || MCUX_HW_DEVICE_ID_MIMX8MN3xxxIZ

config MCUX_HW_IP_DriverType_RDC
    bool
    default y
    depends on MCUX_HW_DEVICE_ID_MIMX8MN3xxxJZ || MCUX_HW_DEVICE_ID_MIMX8MN3xxxIZ

config MCUX_HW_IP_DriverType_RDC_SEMAPHORE
    bool
    default y
    depends on MCUX_HW_DEVICE_ID_MIMX8MN3xxxJZ || MCUX_HW_DEVICE_ID_MIMX8MN3xxxIZ

config MCUX_HW_IP_DriverType_SAI
    bool
    default y
    depends on MCUX_HW_DEVICE_ID_MIMX8MN3xxxJZ || MCUX_HW_DEVICE_ID_MIMX8MN3xxxIZ

config MCUX_HW_IP_DriverType_SCB
    bool
    default y
    depends on MCUX_HW_DEVICE_ID_MIMX8MN3xxxJZ || MCUX_HW_DEVICE_ID_MIMX8MN3xxxIZ

config MCUX_HW_IP_DriverType_SDMAARM
    bool
    default y
    depends on MCUX_HW_DEVICE_ID_MIMX8MN3xxxJZ || MCUX_HW_DEVICE_ID_MIMX8MN3xxxIZ

config MCUX_HW_IP_DriverType_SEMA4
    bool
    default y
    depends on MCUX_HW_DEVICE_ID_MIMX8MN3xxxJZ || MCUX_HW_DEVICE_ID_MIMX8MN3xxxIZ

config MCUX_HW_IP_DriverType_SNVS
    bool
    default y
    depends on MCUX_HW_DEVICE_ID_MIMX8MN3xxxJZ || MCUX_HW_DEVICE_ID_MIMX8MN3xxxIZ

config MCUX_HW_IP_DriverType_SPBA
    bool
    default y
    depends on MCUX_HW_DEVICE_ID_MIMX8MN3xxxJZ || MCUX_HW_DEVICE_ID_MIMX8MN3xxxIZ

config MCUX_HW_IP_DriverType_SPDIF
    bool
    default y
    depends on MCUX_HW_DEVICE_ID_MIMX8MN3xxxJZ || MCUX_HW_DEVICE_ID_MIMX8MN3xxxIZ

config MCUX_HW_IP_DriverType_SRC
    bool
    default y
    depends on MCUX_HW_DEVICE_ID_MIMX8MN3xxxJZ || MCUX_HW_DEVICE_ID_MIMX8MN3xxxIZ

config MCUX_HW_IP_DriverType_SysTick
    bool
    default y
    depends on MCUX_HW_DEVICE_ID_MIMX8MN3xxxJZ || MCUX_HW_DEVICE_ID_MIMX8MN3xxxIZ

config MCUX_HW_IP_DriverType_TMU_1
    bool
    default y
    depends on MCUX_HW_DEVICE_ID_MIMX8MN3xxxJZ || MCUX_HW_DEVICE_ID_MIMX8MN3xxxIZ

config MCUX_HW_IP_DriverType_USB
    bool
    default y
    depends on MCUX_HW_DEVICE_ID_MIMX8MN3xxxJZ || MCUX_HW_DEVICE_ID_MIMX8MN3xxxIZ

config MCUX_HW_IP_DriverType_WDOG01
    bool
    default y
    depends on MCUX_HW_DEVICE_ID_MIMX8MN3xxxJZ || MCUX_HW_DEVICE_ID_MIMX8MN3xxxIZ

config MCUX_HW_IP_DriverType_XTALOSC
    bool
    default y
    depends on MCUX_HW_DEVICE_ID_MIMX8MN3xxxJZ || MCUX_HW_DEVICE_ID_MIMX8MN3xxxIZ

config MCUX_HW_IP_DriverType_interrupt
    bool
    default y
    depends on MCUX_HW_DEVICE_ID_MIMX8MN3xxxJZ || MCUX_HW_DEVICE_ID_MIMX8MN3xxxIZ
```

## mcux/mcux-sdk-ng/devices/i.MX/i.MX8MN/MIMX8MN3/drivers/Kconfig
```kconfig
# Copyright 2024 NXP
#
# SPDX-License-Identifier: BSD-3-Clause

rsource "../../../i.MX8MN/MIMX8MN6/drivers/Kconfig"
```

## mcux/mcux-sdk-ng/devices/i.MX/i.MX8MP/MIMX8ML6/drivers/Kconfig
```kconfig
# Copyright 2024 NXP
#
# SPDX-License-Identifier: BSD-3-Clause

rsource "../../../i.MX8MP/MIMX8ML8/drivers/Kconfig"
```

## mcux/mcux-sdk-ng/devices/i.MX/i.MX8MP/MIMX8ML8/Kconfig.chip
```kconfig
# Copyright 2024 NXP
#
# SPDX-License-Identifier: BSD-3-Clause

# core related
config MCUX_HW_CORE
    string
    default "cm7f"

config MCUX_HW_CORE_CM7F
    bool
    default y

config MCUX_HW_CORE_ID
    string
    default "cm7"

config MCUX_HW_CORE_ID_CM7
    bool
    default y

config MCUX_HW_DEVICE_CORE
    string
    default "MIMX8ML8_cm7"

config MCUX_HW_FPU
    string
    default "SP_FPU"

config MCUX_HW_FPU_TYPE
    string
    default "fpv5_dp"

config MCUX_HW_FPV5_DP
    bool
    default y

config MCUX_HW_INT_PRIO_BITS
    int
    default 4

config MCUX_HW_SOC_SERIES_MIMX
    bool
    default y

config MCUX_HW_SOC_SINGLECORE_DEVICE
    bool
    default y

# device related

config MCUX_HW_DEVICE_ID_MIMX8ML8xxxLZ
    bool

config MCUX_HW_DEVICE_ID_MIMX8ML8xxxKZ
    bool

choice
    prompt "Device MIMX8ML8 Part"
    config MCUX_HW_DEVICE_PART_MIMX8ML8DVNLZ
    bool "Device part MIMX8ML8DVNLZ"
    select MCUX_HW_DEVICE_ID_MIMX8ML8xxxLZ
    config MCUX_HW_DEVICE_PART_MIMX8ML8CVNKZ
    bool "Device part MIMX8ML8CVNKZ"
    select MCUX_HW_DEVICE_ID_MIMX8ML8xxxKZ
endchoice

config MCUX_HW_DEVICE_ID
    string
    default "MIMX8ML8xxxLZ" if MCUX_HW_DEVICE_ID_MIMX8ML8xxxLZ
    default "MIMX8ML8xxxKZ" if MCUX_HW_DEVICE_ID_MIMX8ML8xxxKZ

config MCUX_HW_DEVICE_PART
    string
    default "MIMX8ML8DVNLZ" if MCUX_HW_DEVICE_PART_MIMX8ML8DVNLZ
    default "MIMX8ML8CVNKZ" if MCUX_HW_DEVICE_PART_MIMX8ML8CVNKZ

# For chipmodel generated files
config MCUX_TOOLCHAIN_LINKER_DEVICE_PREFIX
    string
    default "MIMX8ML8xxxLZ" if MCUX_HW_DEVICE_ID_MIMX8ML8xxxLZ
    default "MIMX8ML8xxxKZ" if MCUX_HW_DEVICE_ID_MIMX8ML8xxxKZ

config MCUX_TOOLCHAIN_MCUX_STARTUP
    string
    default "mimx8ml8"

# Toolchain related

config MCUX_TOOLCHAIN_IAR_CPU_IDENTIFIER
    string
    default "MIMX8ML8_M7" if MCUX_HW_DEVICE_ID_MIMX8ML8xxxLZ
    default "MIMX8ML8_M7" if MCUX_HW_DEVICE_ID_MIMX8ML8xxxKZ

config MCUX_TOOLCHAIN_MDK_CPU_IDENTIFIER
    string
    default "MIMX8ML8DVNLZ" if MCUX_HW_DEVICE_PART_MIMX8ML8DVNLZ
    default "MIMX8ML8CVNKZ" if MCUX_HW_DEVICE_PART_MIMX8ML8CVNKZ

# ip information
config MCUX_HW_IP_DriverType_AIPSTZ
    bool
    default y
    depends on MCUX_HW_DEVICE_ID_MIMX8ML8xxxLZ || MCUX_HW_DEVICE_ID_MIMX8ML8xxxKZ

config MCUX_HW_IP_DriverType_APBH
    bool
    default y
    depends on MCUX_HW_DEVICE_ID_MIMX8ML8xxxLZ || MCUX_HW_DEVICE_ID_MIMX8ML8xxxKZ

config MCUX_HW_IP_DriverType_AUDIOMIX
    bool
    default y
    depends on MCUX_HW_DEVICE_ID_MIMX8ML8xxxLZ || MCUX_HW_DEVICE_ID_MIMX8ML8xxxKZ

config MCUX_HW_IP_DriverType_BCH
    bool
    default y
    depends on MCUX_HW_DEVICE_ID_MIMX8ML8xxxLZ || MCUX_HW_DEVICE_ID_MIMX8ML8xxxKZ

config MCUX_HW_IP_DriverType_CCM
    bool
    default y
    depends on MCUX_HW_DEVICE_ID_MIMX8ML8xxxLZ || MCUX_HW_DEVICE_ID_MIMX8ML8xxxKZ

config MCUX_HW_IP_DriverType_CCM_ANALOG
    bool
    default y
    depends on MCUX_HW_DEVICE_ID_MIMX8ML8xxxLZ || MCUX_HW_DEVICE_ID_MIMX8ML8xxxKZ

config MCUX_HW_IP_DriverType_DDRC
    bool
    default y
    depends on MCUX_HW_DEVICE_ID_MIMX8ML8xxxLZ || MCUX_HW_DEVICE_ID_MIMX8ML8xxxKZ

config MCUX_HW_IP_DriverType_DDR_BLK_CTL
    bool
    default y
    depends on MCUX_HW_DEVICE_ID_MIMX8ML8xxxLZ || MCUX_HW_DEVICE_ID_MIMX8ML8xxxKZ

config MCUX_HW_IP_DriverType_DISPMIX
    bool
    default y
    depends on MCUX_HW_DEVICE_ID_MIMX8ML8xxxLZ || MCUX_HW_DEVICE_ID_MIMX8ML8xxxKZ

config MCUX_HW_IP_DriverType_DMA3
    bool
    default y
    depends on MCUX_HW_DEVICE_ID_MIMX8ML8xxxLZ || MCUX_HW_DEVICE_ID_MIMX8ML8xxxKZ

config MCUX_HW_IP_DriverType_DPH_DEF_DOMAIN
    bool
    default y
    depends on MCUX_HW_DEVICE_ID_MIMX8ML8xxxLZ || MCUX_HW_DEVICE_ID_MIMX8ML8xxxKZ

config MCUX_HW_IP_DriverType_DWC_DDRPHYA_ANIB
    bool
    default y
    depends on MCUX_HW_DEVICE_ID_MIMX8ML8xxxLZ || MCUX_HW_DEVICE_ID_MIMX8ML8xxxKZ

config MCUX_HW_IP_DriverType_DWC_DDRPHYA_APBONLY
    bool
    default y
    depends on MCUX_HW_DEVICE_ID_MIMX8ML8xxxLZ || MCUX_HW_DEVICE_ID_MIMX8ML8xxxKZ

config MCUX_HW_IP_DriverType_DWC_DDRPHYA_DBYTE
    bool
    default y
    depends on MCUX_HW_DEVICE_ID_MIMX8ML8xxxLZ || MCUX_HW_DEVICE_ID_MIMX8ML8xxxKZ

config MCUX_HW_IP_DriverType_DWC_DDRPHYA_DRTUB
    bool
    default y
    depends on MCUX_HW_DEVICE_ID_MIMX8ML8xxxLZ || MCUX_HW_DEVICE_ID_MIMX8ML8xxxKZ

config MCUX_HW_IP_DriverType_DWC_DDRPHYA_INITENG
    bool
    default y
    depends on MCUX_HW_DEVICE_ID_MIMX8ML8xxxLZ || MCUX_HW_DEVICE_ID_MIMX8ML8xxxKZ

config MCUX_HW_IP_DriverType_DWC_DDRPHYA_MASTER
    bool
    default y
    depends on MCUX_HW_DEVICE_ID_MIMX8ML8xxxLZ || MCUX_HW_DEVICE_ID_MIMX8ML8xxxKZ

config MCUX_HW_IP_DriverType_DWT
    bool
    default y
    depends on MCUX_HW_DEVICE_ID_MIMX8ML8xxxLZ || MCUX_HW_DEVICE_ID_MIMX8ML8xxxKZ

config MCUX_HW_IP_DriverType_EARC
    bool
    default y
    depends on MCUX_HW_DEVICE_ID_MIMX8ML8xxxLZ || MCUX_HW_DEVICE_ID_MIMX8ML8xxxKZ

config MCUX_HW_IP_DriverType_EASRC
    bool
    default y
    depends on MCUX_HW_DEVICE_ID_MIMX8ML8xxxLZ || MCUX_HW_DEVICE_ID_MIMX8ML8xxxKZ

config MCUX_HW_IP_DriverType_ECSPI
    bool
    default y
    depends on MCUX_HW_DEVICE_ID_MIMX8ML8xxxLZ || MCUX_HW_DEVICE_ID_MIMX8ML8xxxKZ

config MCUX_HW_IP_DriverType_ENET
    bool
    default y
    depends on MCUX_HW_DEVICE_ID_MIMX8ML8xxxLZ || MCUX_HW_DEVICE_ID_MIMX8ML8xxxKZ

config MCUX_HW_IP_DriverType_ENET_QOS
    bool
    default y
    depends on MCUX_HW_DEVICE_ID_MIMX8ML8xxxLZ || MCUX_HW_DEVICE_ID_MIMX8ML8xxxKZ

config MCUX_HW_IP_DriverType_ETM
    bool
    default y
    depends on MCUX_HW_DEVICE_ID_MIMX8ML8xxxLZ || MCUX_HW_DEVICE_ID_MIMX8ML8xxxKZ

config MCUX_HW_IP_DriverType_FLEXCAN
    bool
    default y
    depends on MCUX_HW_DEVICE_ID_MIMX8ML8xxxLZ || MCUX_HW_DEVICE_ID_MIMX8ML8xxxKZ

config MCUX_HW_IP_DriverType_FLEXSPI
    bool
    default y
    depends on MCUX_HW_DEVICE_ID_MIMX8ML8xxxLZ || MCUX_HW_DEVICE_ID_MIMX8ML8xxxKZ

config MCUX_HW_IP_DriverType_GLUE_USB
    bool
    default y
    depends on MCUX_HW_DEVICE_ID_MIMX8ML8xxxLZ || MCUX_HW_DEVICE_ID_MIMX8ML8xxxKZ

config MCUX_HW_IP_DriverType_GPC_2
    bool
    default y
    depends on MCUX_HW_DEVICE_ID_MIMX8ML8xxxLZ || MCUX_HW_DEVICE_ID_MIMX8ML8xxxKZ

config MCUX_HW_IP_DriverType_GPC_PGC
    bool
    default y
    depends on MCUX_HW_DEVICE_ID_MIMX8ML8xxxLZ || MCUX_HW_DEVICE_ID_MIMX8ML8xxxKZ

config MCUX_HW_IP_DriverType_GPMI
    bool
    default y
    depends on MCUX_HW_DEVICE_ID_MIMX8ML8xxxLZ || MCUX_HW_DEVICE_ID_MIMX8ML8xxxKZ

config MCUX_HW_IP_DriverType_GPT
    bool
    default y
    depends on MCUX_HW_DEVICE_ID_MIMX8ML8xxxLZ || MCUX_HW_DEVICE_ID_MIMX8ML8xxxKZ

config MCUX_HW_IP_DriverType_HDMI_TRNG
    bool
    default y
    depends on MCUX_HW_DEVICE_ID_MIMX8ML8xxxLZ || MCUX_HW_DEVICE_ID_MIMX8ML8xxxKZ

config MCUX_HW_IP_DriverType_HDMI_TX
    bool
    default y
    depends on MCUX_HW_DEVICE_ID_MIMX8ML8xxxLZ || MCUX_HW_DEVICE_ID_MIMX8ML8xxxKZ

config MCUX_HW_IP_DriverType_HDMI_TX_BLK_CTL
    bool
    default y
    depends on MCUX_HW_DEVICE_ID_MIMX8ML8xxxLZ || MCUX_HW_DEVICE_ID_MIMX8ML8xxxKZ

config MCUX_HW_IP_DriverType_HSIO_BLK_CTRL
    bool
    default y
    depends on MCUX_HW_DEVICE_ID_MIMX8ML8xxxLZ || MCUX_HW_DEVICE_ID_MIMX8ML8xxxKZ

config MCUX_HW_IP_DriverType_HTX_PAI
    bool
    default y
    depends on MCUX_HW_DEVICE_ID_MIMX8ML8xxxLZ || MCUX_HW_DEVICE_ID_MIMX8ML8xxxKZ

config MCUX_HW_IP_DriverType_HTX_PVI
    bool
    default y
    depends on MCUX_HW_DEVICE_ID_MIMX8ML8xxxLZ || MCUX_HW_DEVICE_ID_MIMX8ML8xxxKZ

config MCUX_HW_IP_DriverType_IGPIO
    bool
    default y
    depends on MCUX_HW_DEVICE_ID_MIMX8ML8xxxLZ || MCUX_HW_DEVICE_ID_MIMX8ML8xxxKZ

config MCUX_HW_IP_DriverType_II2C
    bool
    default y
    depends on MCUX_HW_DEVICE_ID_MIMX8ML8xxxLZ || MCUX_HW_DEVICE_ID_MIMX8ML8xxxKZ

config MCUX_HW_IP_DriverType_IOMUXC
    bool
    default y
    depends on MCUX_HW_DEVICE_ID_MIMX8ML8xxxLZ || MCUX_HW_DEVICE_ID_MIMX8ML8xxxKZ

config MCUX_HW_IP_DriverType_IOMUXC_GPR
    bool
    default y
    depends on MCUX_HW_DEVICE_ID_MIMX8ML8xxxLZ || MCUX_HW_DEVICE_ID_MIMX8ML8xxxKZ

config MCUX_HW_IP_DriverType_IPWM
    bool
    default y
    depends on MCUX_HW_DEVICE_ID_MIMX8ML8xxxLZ || MCUX_HW_DEVICE_ID_MIMX8ML8xxxKZ

config MCUX_HW_IP_DriverType_IRQSTEER
    bool
    default y
    depends on MCUX_HW_DEVICE_ID_MIMX8ML8xxxLZ || MCUX_HW_DEVICE_ID_MIMX8ML8xxxKZ

config MCUX_HW_IP_DriverType_ISI
    bool
    default y
    depends on MCUX_HW_DEVICE_ID_MIMX8ML8xxxLZ || MCUX_HW_DEVICE_ID_MIMX8ML8xxxKZ

config MCUX_HW_IP_DriverType_ITM
    bool
    default y
    depends on MCUX_HW_DEVICE_ID_MIMX8ML8xxxLZ || MCUX_HW_DEVICE_ID_MIMX8ML8xxxKZ

config MCUX_HW_IP_DriverType_IUART
    bool
    default y
    depends on MCUX_HW_DEVICE_ID_MIMX8ML8xxxLZ || MCUX_HW_DEVICE_ID_MIMX8ML8xxxKZ

config MCUX_HW_IP_DriverType_LCDIF
    bool
    default y
    depends on MCUX_HW_DEVICE_ID_MIMX8ML8xxxLZ || MCUX_HW_DEVICE_ID_MIMX8ML8xxxKZ

config MCUX_HW_IP_DriverType_MIPI_CSI
    bool
    default y
    depends on MCUX_HW_DEVICE_ID_MIMX8ML8xxxLZ || MCUX_HW_DEVICE_ID_MIMX8ML8xxxKZ

config MCUX_HW_IP_DriverType_MU
    bool
    default y
    depends on MCUX_HW_DEVICE_ID_MIMX8ML8xxxLZ || MCUX_HW_DEVICE_ID_MIMX8ML8xxxKZ

config MCUX_HW_IP_DriverType_NPU
    bool
    default y
    depends on MCUX_HW_DEVICE_ID_MIMX8ML8xxxLZ || MCUX_HW_DEVICE_ID_MIMX8ML8xxxKZ

config MCUX_HW_IP_DriverType_OCOTP
    bool
    default y
    depends on MCUX_HW_DEVICE_ID_MIMX8ML8xxxLZ || MCUX_HW_DEVICE_ID_MIMX8ML8xxxKZ

config MCUX_HW_IP_DriverType_PCIE
    bool
    default y
    depends on MCUX_HW_DEVICE_ID_MIMX8ML8xxxLZ || MCUX_HW_DEVICE_ID_MIMX8ML8xxxKZ

config MCUX_HW_IP_DriverType_PCIe_PHY
    bool
    default n
    depends on MCUX_HW_DEVICE_ID_MIMX8ML8xxxLZ || MCUX_HW_DEVICE_ID_MIMX8ML8xxxKZ

config MCUX_HW_IP_DriverType_PDM
    bool
    default y
    depends on MCUX_HW_DEVICE_ID_MIMX8ML8xxxLZ || MCUX_HW_DEVICE_ID_MIMX8ML8xxxKZ

config MCUX_HW_IP_DriverType_RDC
    bool
    default y
    depends on MCUX_HW_DEVICE_ID_MIMX8ML8xxxLZ || MCUX_HW_DEVICE_ID_MIMX8ML8xxxKZ

config MCUX_HW_IP_DriverType_RDC_SEMAPHORE
    bool
    default y
    depends on MCUX_HW_DEVICE_ID_MIMX8ML8xxxLZ || MCUX_HW_DEVICE_ID_MIMX8ML8xxxKZ

config MCUX_HW_IP_DriverType_SAI
    bool
    default y
    depends on MCUX_HW_DEVICE_ID_MIMX8ML8xxxLZ || MCUX_HW_DEVICE_ID_MIMX8ML8xxxKZ

config MCUX_HW_IP_DriverType_SCB
    bool
    default y
    depends on MCUX_HW_DEVICE_ID_MIMX8ML8xxxLZ || MCUX_HW_DEVICE_ID_MIMX8ML8xxxKZ

config MCUX_HW_IP_DriverType_SDMAARM
    bool
    default y
    depends on MCUX_HW_DEVICE_ID_MIMX8ML8xxxLZ || MCUX_HW_DEVICE_ID_MIMX8ML8xxxKZ

config MCUX_HW_IP_DriverType_SEMA4
    bool
    default y
    depends on MCUX_HW_DEVICE_ID_MIMX8ML8xxxLZ || MCUX_HW_DEVICE_ID_MIMX8ML8xxxKZ

config MCUX_HW_IP_DriverType_SNVS
    bool
    default y
    depends on MCUX_HW_DEVICE_ID_MIMX8ML8xxxLZ || MCUX_HW_DEVICE_ID_MIMX8ML8xxxKZ

config MCUX_HW_IP_DriverType_SPBA
    bool
    default y
    depends on MCUX_HW_DEVICE_ID_MIMX8ML8xxxLZ || MCUX_HW_DEVICE_ID_MIMX8ML8xxxKZ

config MCUX_HW_IP_DriverType_SRC
    bool
    default y
    depends on MCUX_HW_DEVICE_ID_MIMX8ML8xxxLZ || MCUX_HW_DEVICE_ID_MIMX8ML8xxxKZ

config MCUX_HW_IP_DriverType_SYS_CTR_COMPARE
    bool
    default y
    depends on MCUX_HW_DEVICE_ID_MIMX8ML8xxxLZ || MCUX_HW_DEVICE_ID_MIMX8ML8xxxKZ

config MCUX_HW_IP_DriverType_SYS_CTR_CONTROL
    bool
    default y
    depends on MCUX_HW_DEVICE_ID_MIMX8ML8xxxLZ || MCUX_HW_DEVICE_ID_MIMX8ML8xxxKZ

config MCUX_HW_IP_DriverType_SYS_CTR_READ
    bool
    default y
    depends on MCUX_HW_DEVICE_ID_MIMX8ML8xxxLZ || MCUX_HW_DEVICE_ID_MIMX8ML8xxxKZ

config MCUX_HW_IP_DriverType_SysTick
    bool
    default y
    depends on MCUX_HW_DEVICE_ID_MIMX8ML8xxxLZ || MCUX_HW_DEVICE_ID_MIMX8ML8xxxKZ

config MCUX_HW_IP_DriverType_TMU_2
    bool
    default y
    depends on MCUX_HW_DEVICE_ID_MIMX8ML8xxxLZ || MCUX_HW_DEVICE_ID_MIMX8ML8xxxKZ

config MCUX_HW_IP_DriverType_USB
    bool
    default y
    depends on MCUX_HW_DEVICE_ID_MIMX8ML8xxxLZ || MCUX_HW_DEVICE_ID_MIMX8ML8xxxKZ

config MCUX_HW_IP_DriverType_USDHC
    bool
    default y
    depends on MCUX_HW_DEVICE_ID_MIMX8ML8xxxLZ || MCUX_HW_DEVICE_ID_MIMX8ML8xxxKZ

config MCUX_HW_IP_DriverType_VPU_BLK_CTL
    bool
    default y
    depends on MCUX_HW_DEVICE_ID_MIMX8ML8xxxLZ || MCUX_HW_DEVICE_ID_MIMX8ML8xxxKZ

config MCUX_HW_IP_DriverType_VPU_H264
    bool
    default y
    depends on MCUX_HW_DEVICE_ID_MIMX8ML8xxxLZ || MCUX_HW_DEVICE_ID_MIMX8ML8xxxKZ

config MCUX_HW_IP_DriverType_VPU_HEVC
    bool
    default y
    depends on MCUX_HW_DEVICE_ID_MIMX8ML8xxxLZ || MCUX_HW_DEVICE_ID_MIMX8ML8xxxKZ

config MCUX_HW_IP_DriverType_VPU_LEGACY_REGS
    bool
    default y
    depends on MCUX_HW_DEVICE_ID_MIMX8ML8xxxLZ || MCUX_HW_DEVICE_ID_MIMX8ML8xxxKZ

config MCUX_HW_IP_DriverType_VPU_REGS
    bool
    default y
    depends on MCUX_HW_DEVICE_ID_MIMX8ML8xxxLZ || MCUX_HW_DEVICE_ID_MIMX8ML8xxxKZ

config MCUX_HW_IP_DriverType_WDOG01
    bool
    default y
    depends on MCUX_HW_DEVICE_ID_MIMX8ML8xxxLZ || MCUX_HW_DEVICE_ID_MIMX8ML8xxxKZ

config MCUX_HW_IP_DriverType_XTALOSC
    bool
    default y
    depends on MCUX_HW_DEVICE_ID_MIMX8ML8xxxLZ || MCUX_HW_DEVICE_ID_MIMX8ML8xxxKZ

config MCUX_HW_IP_DriverType_interrupt
    bool
    default y
    depends on MCUX_HW_DEVICE_ID_MIMX8ML8xxxLZ || MCUX_HW_DEVICE_ID_MIMX8ML8xxxKZ
```

## mcux/mcux-sdk-ng/devices/i.MX/i.MX8ULP/MIMX8UD3/Kconfig
```kconfig
# Copyright 2024 NXP
# All rights reserved.
#
# SPDX-License-Identifier: BSD-3-Clause

rsource "Kconfig.chip"
rsource "drivers/Kconfig"
rsource "drivers/upower/Kconfig"
rsource "../../../arm/Kconfig.common"
rsource "Kconfig.defconfig"

## pinmux dependency
config MCUX_DEPENDENCY_PINMUX
    bool
    default n

    imply MCUX_COMPONENT_driver.rgpio
    imply MCUX_COMPONENT_driver.port

## Project segment and component dependency data
config MCUX_HW_DEVICE_MIMX8UD3
    # bool "Device MIMX8UD3 Configuration"
    bool
    default y
    ## Project segment dependency data

    select MCUX_COMPONENT_driver.port if MCUX_PRJSEG_module.board.pinmux
    select MCUX_COMPONENT_driver.rgpio if MCUX_PRJSEG_module.board.pinmux
    select MCUX_COMPONENT_driver.clock if MCUX_PRJSEG_module.board.clock
    select MCUX_COMPONENT_component.lpuart_adapter if MCUX_PRJSEG_module.board.console_lite
    select MCUX_COMPONENT_driver.lpuart if MCUX_PRJSEG_module.board.console_lite
    select MCUX_COMPONENT_driver.cache_cache64
    select MCUX_COMPONENT_driver.upower
    select MCUX_COMPONENT_driver.upowerlib
    select MCUX_COMPONENT_driver.mu1
    select MCUX_COMPONENT_driver.flexspi
    select MCUX_COMPONENT_driver.trdc

    # component dependency
    select MCUX_COMPONENT_driver.dma3 if MCUX_COMPONENT_driver.sai_edma
    select MCUX_COMPONENT_driver.dma3 if MCUX_COMPONENT_driver.lpi2c_edma
    select MCUX_COMPONENT_driver.dma3 if MCUX_COMPONENT_driver.lpspi_edma
    select MCUX_COMPONENT_driver.dma3 if MCUX_COMPONENT_driver.lpuart_edma
    select MCUX_COMPONENT_driver.dma3 if MCUX_COMPONENT_driver.flexspi_dma3
    select MCUX_COMPONENT_component.lpuart_adapter if MCUX_COMPONENT_component.serial_manager_uart
    select MCUX_COMPONENT_component.lpuart_adapter if MCUX_COMPONENT_utility.debug_console_lite
```

## mcux/mcux-sdk-ng/devices/i.MX/i.MX8MM/MIMX8MM1/Kconfig.chip
```kconfig
# Copyright 2024 NXP
#
# SPDX-License-Identifier: BSD-3-Clause

# core related
config MCUX_HW_CORE
    string
    default "cm4f"

config MCUX_HW_CORE_CM4F
    bool
    default y

config MCUX_HW_CORE_ID
    string
    default "cm4"

config MCUX_HW_CORE_ID_CM4
    bool
    default y

config MCUX_HW_DEVICE_CORE
    string
    default "MIMX8MM1_cm4"

config MCUX_HW_FPU
    string
    default "SP_FPU"

config MCUX_HW_FPU_TYPE
    string
    default "fpv4_sp"

config MCUX_HW_FPV4_SP
    bool
    default y

config MCUX_HW_INT_PRIO_BITS
    int
    default 4

config MCUX_HW_SOC_SERIES_MIMX
    bool
    default y

config MCUX_HW_SOC_SINGLECORE_DEVICE
    bool
    default y

# device related

config MCUX_HW_DEVICE_ID_MIMX8MM1xxxLZ
    bool

config MCUX_HW_DEVICE_ID_MIMX8MM1xxxKZ
    bool

choice
    prompt "Device MIMX8MM1 Part"
    config MCUX_HW_DEVICE_PART_MIMX8MM1DVTLZ
    bool "Device part MIMX8MM1DVTLZ"
    select MCUX_HW_DEVICE_ID_MIMX8MM1xxxLZ
    config MCUX_HW_DEVICE_PART_MIMX8MM1CVTKZ
    bool "Device part MIMX8MM1CVTKZ"
    select MCUX_HW_DEVICE_ID_MIMX8MM1xxxKZ
endchoice

config MCUX_HW_DEVICE_ID
    string
    default "MIMX8MM1xxxLZ" if MCUX_HW_DEVICE_ID_MIMX8MM1xxxLZ
    default "MIMX8MM1xxxKZ" if MCUX_HW_DEVICE_ID_MIMX8MM1xxxKZ

config MCUX_HW_DEVICE_PART
    string
    default "MIMX8MM1DVTLZ" if MCUX_HW_DEVICE_PART_MIMX8MM1DVTLZ
    default "MIMX8MM1CVTKZ" if MCUX_HW_DEVICE_PART_MIMX8MM1CVTKZ

# For chipmodel generated files
config MCUX_TOOLCHAIN_LINKER_DEVICE_PREFIX
    string
    default "MIMX8MM1xxxLZ" if MCUX_HW_DEVICE_ID_MIMX8MM1xxxLZ
    default "MIMX8MM1xxxKZ" if MCUX_HW_DEVICE_ID_MIMX8MM1xxxKZ

config MCUX_TOOLCHAIN_MCUX_STARTUP
    string
    default "mimx8mm1"

# Toolchain related

config MCUX_TOOLCHAIN_IAR_CPU_IDENTIFIER
    string
    default "MIMX8MM1_M4" if MCUX_HW_DEVICE_ID_MIMX8MM1xxxLZ
    default "MIMX8MM1_M4" if MCUX_HW_DEVICE_ID_MIMX8MM1xxxKZ

config MCUX_TOOLCHAIN_MDK_CPU_IDENTIFIER
    string
    default "MIMX8MM1DVTLZ" if MCUX_HW_DEVICE_PART_MIMX8MM1DVTLZ
    default "MIMX8MM1CVTKZ" if MCUX_HW_DEVICE_PART_MIMX8MM1CVTKZ

# ip information
config MCUX_HW_IP_DriverType_APBH
    bool
    default y
    depends on MCUX_HW_DEVICE_ID_MIMX8MM1xxxLZ || MCUX_HW_DEVICE_ID_MIMX8MM1xxxKZ

config MCUX_HW_IP_DriverType_BCH
    bool
    default y
    depends on MCUX_HW_DEVICE_ID_MIMX8MM1xxxLZ || MCUX_HW_DEVICE_ID_MIMX8MM1xxxKZ

config MCUX_HW_IP_DriverType_CCM
    bool
    default y
    depends on MCUX_HW_DEVICE_ID_MIMX8MM1xxxLZ || MCUX_HW_DEVICE_ID_MIMX8MM1xxxKZ

config MCUX_HW_IP_DriverType_CCM_ANALOG
    bool
    default y
    depends on MCUX_HW_DEVICE_ID_MIMX8MM1xxxLZ || MCUX_HW_DEVICE_ID_MIMX8MM1xxxKZ

config MCUX_HW_IP_DriverType_DDRC
    bool
    default y
    depends on MCUX_HW_DEVICE_ID_MIMX8MM1xxxLZ || MCUX_HW_DEVICE_ID_MIMX8MM1xxxKZ

config MCUX_HW_IP_DriverType_DPH_DEF_DOMAIN
    bool
    default y
    depends on MCUX_HW_DEVICE_ID_MIMX8MM1xxxLZ || MCUX_HW_DEVICE_ID_MIMX8MM1xxxKZ

config MCUX_HW_IP_DriverType_DWC_DDRPHYA_ANIB
    bool
    default y
    depends on MCUX_HW_DEVICE_ID_MIMX8MM1xxxLZ || MCUX_HW_DEVICE_ID_MIMX8MM1xxxKZ

config MCUX_HW_IP_DriverType_DWC_DDRPHYA_APBONLY
    bool
    default y
    depends on MCUX_HW_DEVICE_ID_MIMX8MM1xxxLZ || MCUX_HW_DEVICE_ID_MIMX8MM1xxxKZ

config MCUX_HW_IP_DriverType_DWC_DDRPHYA_DBYTE
    bool
    default y
    depends on MCUX_HW_DEVICE_ID_MIMX8MM1xxxLZ || MCUX_HW_DEVICE_ID_MIMX8MM1xxxKZ

config MCUX_HW_IP_DriverType_DWC_DDRPHYA_DRTUB
    bool
    default y
    depends on MCUX_HW_DEVICE_ID_MIMX8MM1xxxLZ || MCUX_HW_DEVICE_ID_MIMX8MM1xxxKZ

config MCUX_HW_IP_DriverType_DWC_DDRPHYA_INITENG
    bool
    default y
    depends on MCUX_HW_DEVICE_ID_MIMX8MM1xxxLZ || MCUX_HW_DEVICE_ID_MIMX8MM1xxxKZ

config MCUX_HW_IP_DriverType_DWC_DDRPHYA_MASTER
    bool
    default y
    depends on MCUX_HW_DEVICE_ID_MIMX8MM1xxxLZ || MCUX_HW_DEVICE_ID_MIMX8MM1xxxKZ

config MCUX_HW_IP_DriverType_DWT
    bool
    default y
    depends on MCUX_HW_DEVICE_ID_MIMX8MM1xxxLZ || MCUX_HW_DEVICE_ID_MIMX8MM1xxxKZ

config MCUX_HW_IP_DriverType_ECSPI
    bool
    default y
    depends on MCUX_HW_DEVICE_ID_MIMX8MM1xxxLZ || MCUX_HW_DEVICE_ID_MIMX8MM1xxxKZ

config MCUX_HW_IP_DriverType_ENET
    bool
    default y
    depends on MCUX_HW_DEVICE_ID_MIMX8MM1xxxLZ || MCUX_HW_DEVICE_ID_MIMX8MM1xxxKZ

config MCUX_HW_IP_DriverType_ETM
    bool
    default y
    depends on MCUX_HW_DEVICE_ID_MIMX8MM1xxxLZ || MCUX_HW_DEVICE_ID_MIMX8MM1xxxKZ

config MCUX_HW_IP_DriverType_FlexSPI
    bool
    default y
    depends on MCUX_HW_DEVICE_ID_MIMX8MM1xxxLZ || MCUX_HW_DEVICE_ID_MIMX8MM1xxxKZ

config MCUX_HW_IP_DriverType_GPC_2
    bool
    default y
    depends on MCUX_HW_DEVICE_ID_MIMX8MM1xxxLZ || MCUX_HW_DEVICE_ID_MIMX8MM1xxxKZ

config MCUX_HW_IP_DriverType_GPC_PGC
    bool
    default y
    depends on MCUX_HW_DEVICE_ID_MIMX8MM1xxxLZ || MCUX_HW_DEVICE_ID_MIMX8MM1xxxKZ

config MCUX_HW_IP_DriverType_GPMI
    bool
    default y
    depends on MCUX_HW_DEVICE_ID_MIMX8MM1xxxLZ || MCUX_HW_DEVICE_ID_MIMX8MM1xxxKZ

config MCUX_HW_IP_DriverType_GPT
    bool
    default y
    depends on MCUX_HW_DEVICE_ID_MIMX8MM1xxxLZ || MCUX_HW_DEVICE_ID_MIMX8MM1xxxKZ

config MCUX_HW_IP_DriverType_IGPIO
    bool
    default y
    depends on MCUX_HW_DEVICE_ID_MIMX8MM1xxxLZ || MCUX_HW_DEVICE_ID_MIMX8MM1xxxKZ

config MCUX_HW_IP_DriverType_II2C
    bool
    default y
    depends on MCUX_HW_DEVICE_ID_MIMX8MM1xxxLZ || MCUX_HW_DEVICE_ID_MIMX8MM1xxxKZ

config MCUX_HW_IP_DriverType_IOMUXC
    bool
    default y
    depends on MCUX_HW_DEVICE_ID_MIMX8MM1xxxLZ || MCUX_HW_DEVICE_ID_MIMX8MM1xxxKZ

config MCUX_HW_IP_DriverType_IOMUXC_GPR
    bool
    default y
    depends on MCUX_HW_DEVICE_ID_MIMX8MM1xxxLZ || MCUX_HW_DEVICE_ID_MIMX8MM1xxxKZ

config MCUX_HW_IP_DriverType_IPWM
    bool
    default y
    depends on MCUX_HW_DEVICE_ID_MIMX8MM1xxxLZ || MCUX_HW_DEVICE_ID_MIMX8MM1xxxKZ

config MCUX_HW_IP_DriverType_ITM
    bool
    default y
    depends on MCUX_HW_DEVICE_ID_MIMX8MM1xxxLZ || MCUX_HW_DEVICE_ID_MIMX8MM1xxxKZ

config MCUX_HW_IP_DriverType_IUART
    bool
    default y
    depends on MCUX_HW_DEVICE_ID_MIMX8MM1xxxLZ || MCUX_HW_DEVICE_ID_MIMX8MM1xxxKZ

config MCUX_HW_IP_DriverType_LCDIF
    bool
    default y
    depends on MCUX_HW_DEVICE_ID_MIMX8MM1xxxLZ || MCUX_HW_DEVICE_ID_MIMX8MM1xxxKZ

config MCUX_HW_IP_DriverType_LMEM
    bool
    default y
    depends on MCUX_HW_DEVICE_ID_MIMX8MM1xxxLZ || MCUX_HW_DEVICE_ID_MIMX8MM1xxxKZ

config MCUX_HW_IP_DriverType_MCM
    bool
    default y
    depends on MCUX_HW_DEVICE_ID_MIMX8MM1xxxLZ || MCUX_HW_DEVICE_ID_MIMX8MM1xxxKZ

config MCUX_HW_IP_DriverType_MIPI_CSI
    bool
    default y
    depends on MCUX_HW_DEVICE_ID_MIMX8MM1xxxLZ || MCUX_HW_DEVICE_ID_MIMX8MM1xxxKZ

config MCUX_HW_IP_DriverType_MU
    bool
    default y
    depends on MCUX_HW_DEVICE_ID_MIMX8MM1xxxLZ || MCUX_HW_DEVICE_ID_MIMX8MM1xxxKZ

config MCUX_HW_IP_DriverType_OCOTP
    bool
    default y
    depends on MCUX_HW_DEVICE_ID_MIMX8MM1xxxLZ || MCUX_HW_DEVICE_ID_MIMX8MM1xxxKZ

config MCUX_HW_IP_DriverType_PCIE
    bool
    default y
    depends on MCUX_HW_DEVICE_ID_MIMX8MM1xxxLZ || MCUX_HW_DEVICE_ID_MIMX8MM1xxxKZ

config MCUX_HW_IP_DriverType_PCIE_PHY
    bool
    default y
    depends on MCUX_HW_DEVICE_ID_MIMX8MM1xxxLZ || MCUX_HW_DEVICE_ID_MIMX8MM1xxxKZ

config MCUX_HW_IP_DriverType_PDM
    bool
    default y
    depends on MCUX_HW_DEVICE_ID_MIMX8MM1xxxLZ || MCUX_HW_DEVICE_ID_MIMX8MM1xxxKZ

config MCUX_HW_IP_DriverType_RDC
    bool
    default y
    depends on MCUX_HW_DEVICE_ID_MIMX8MM1xxxLZ || MCUX_HW_DEVICE_ID_MIMX8MM1xxxKZ

config MCUX_HW_IP_DriverType_RDC_SEMAPHORE
    bool
    default y
    depends on MCUX_HW_DEVICE_ID_MIMX8MM1xxxLZ || MCUX_HW_DEVICE_ID_MIMX8MM1xxxKZ

config MCUX_HW_IP_DriverType_SAI
    bool
    default y
    depends on MCUX_HW_DEVICE_ID_MIMX8MM1xxxLZ || MCUX_HW_DEVICE_ID_MIMX8MM1xxxKZ

config MCUX_HW_IP_DriverType_SCB
    bool
    default y
    depends on MCUX_HW_DEVICE_ID_MIMX8MM1xxxLZ || MCUX_HW_DEVICE_ID_MIMX8MM1xxxKZ

config MCUX_HW_IP_DriverType_SDMAARM
    bool
    default y
    depends on MCUX_HW_DEVICE_ID_MIMX8MM1xxxLZ || MCUX_HW_DEVICE_ID_MIMX8MM1xxxKZ

config MCUX_HW_IP_DriverType_SEMA4
    bool
    default y
    depends on MCUX_HW_DEVICE_ID_MIMX8MM1xxxLZ || MCUX_HW_DEVICE_ID_MIMX8MM1xxxKZ

config MCUX_HW_IP_DriverType_SNVS
    bool
    default y
    depends on MCUX_HW_DEVICE_ID_MIMX8MM1xxxLZ || MCUX_HW_DEVICE_ID_MIMX8MM1xxxKZ

config MCUX_HW_IP_DriverType_SPBA
    bool
    default y
    depends on MCUX_HW_DEVICE_ID_MIMX8MM1xxxLZ || MCUX_HW_DEVICE_ID_MIMX8MM1xxxKZ

config MCUX_HW_IP_DriverType_SPDIF
    bool
    default y
    depends on MCUX_HW_DEVICE_ID_MIMX8MM1xxxLZ || MCUX_HW_DEVICE_ID_MIMX8MM1xxxKZ

config MCUX_HW_IP_DriverType_SRC
    bool
    default y
    depends on MCUX_HW_DEVICE_ID_MIMX8MM1xxxLZ || MCUX_HW_DEVICE_ID_MIMX8MM1xxxKZ

config MCUX_HW_IP_DriverType_SysTick
    bool
    default y
    depends on MCUX_HW_DEVICE_ID_MIMX8MM1xxxLZ || MCUX_HW_DEVICE_ID_MIMX8MM1xxxKZ

config MCUX_HW_IP_DriverType_TMU_1
    bool
    default y
    depends on MCUX_HW_DEVICE_ID_MIMX8MM1xxxLZ || MCUX_HW_DEVICE_ID_MIMX8MM1xxxKZ

config MCUX_HW_IP_DriverType_VPU
    bool
    default y
    depends on MCUX_HW_DEVICE_ID_MIMX8MM1xxxLZ || MCUX_HW_DEVICE_ID_MIMX8MM1xxxKZ

config MCUX_HW_IP_DriverType_VPU_H1
    bool
    default y
    depends on MCUX_HW_DEVICE_ID_MIMX8MM1xxxLZ || MCUX_HW_DEVICE_ID_MIMX8MM1xxxKZ

config MCUX_HW_IP_DriverType_VPU_LEGACY
    bool
    default y
    depends on MCUX_HW_DEVICE_ID_MIMX8MM1xxxLZ || MCUX_HW_DEVICE_ID_MIMX8MM1xxxKZ

config MCUX_HW_IP_DriverType_WDOG01
    bool
    default y
    depends on MCUX_HW_DEVICE_ID_MIMX8MM1xxxLZ || MCUX_HW_DEVICE_ID_MIMX8MM1xxxKZ

config MCUX_HW_IP_DriverType_XTALOSC
    bool
    default y
    depends on MCUX_HW_DEVICE_ID_MIMX8MM1xxxLZ || MCUX_HW_DEVICE_ID_MIMX8MM1xxxKZ

config MCUX_HW_IP_DriverType_interrupt
    bool
    default y
    depends on MCUX_HW_DEVICE_ID_MIMX8MM1xxxLZ || MCUX_HW_DEVICE_ID_MIMX8MM1xxxKZ
```

## mcux/mcux-sdk-ng/devices/i.MX/i.MX8MM/MIMX8MM1/drivers/Kconfig
```kconfig
# Copyright 2024 NXP
#
# SPDX-License-Identifier: BSD-3-Clause

rsource "../../../i.MX8MM/MIMX8MM6/drivers/Kconfig"
```

## mcux/mcux-sdk-ng/devices/i.MX/i.MX8MM/MIMX8MM3/Kconfig
```kconfig
# Copyright 2024 NXP
# All rights reserved.
#
# SPDX-License-Identifier: BSD-3-Clause

rsource "Kconfig.chip"
rsource "drivers/Kconfig"
rsource "../../../arm/Kconfig.common"
rsource "Kconfig.defconfig"

## pinmux dependency
config MCUX_DEPENDENCY_PINMUX
    bool
    default n

    imply MCUX_COMPONENT_driver.gpio
    imply MCUX_COMPONENT_driver.port

## Project segment and component dependency data
config MCUX_HW_DEVICE_MIMX8MM3
    # bool "Device MIMX8MM3 Configuration"
    bool
    default y
    ## Project segment dependency data

    select MCUX_COMPONENT_driver.port if MCUX_PRJSEG_module.board.pinmux
    select MCUX_COMPONENT_driver.gpio if MCUX_PRJSEG_module.board.pinmux
    select MCUX_COMPONENT_driver.clock if MCUX_PRJSEG_module.board.clock
    select MCUX_COMPONENT_component.iuart_adapter if MCUX_PRJSEG_module.board.console_lite
    select MCUX_COMPONENT_driver.iuart if MCUX_PRJSEG_module.board.console_lite
    select MCUX_COMPONENT_driver.rdc

    # component dependency
    select MCUX_COMPONENT_driver.memory if MCUX_COMPONENT_driver.sdma
    select MCUX_COMPONENT_driver.memory if MCUX_COMPONENT_driver.enet
    select MCUX_COMPONENT_component.iuart_adapter if MCUX_COMPONENT_component.serial_manager_uart
    select MCUX_COMPONENT_component.iuart_adapter if MCUX_COMPONENT_utility.debug_console_lite
    select MCUX_COMPONENT_driver.sdma if MCUX_COMPONENT_driver.ecspi_sdma
    select MCUX_COMPONENT_driver.sdma if MCUX_COMPONENT_driver.iuart_sdma
    select MCUX_COMPONENT_driver.sdma if MCUX_COMPONENT_driver.sai_sdma
```

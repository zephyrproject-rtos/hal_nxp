## mcux/mcux-sdk-ng/devices/i.MX/i.MX8ULP/MIMX8UD5/Kconfig.chip
```kconfig
# Copyright 2024 NXP
#
# SPDX-License-Identifier: BSD-3-Clause


# device related

config MCUX_HW_DEVICE_ID_MIMX8UD5xxx08
    bool

choice
    prompt "Device MIMX8UD5 Part"
    config MCUX_HW_DEVICE_PART_MIMX8UD5CVP08
    bool "Device part MIMX8UD5CVP08"
    select MCUX_HW_DEVICE_ID_MIMX8UD5xxx08
    config MCUX_HW_DEVICE_PART_MIMX8UD5DVP08
    bool "Device part MIMX8UD5DVP08"
    select MCUX_HW_DEVICE_ID_MIMX8UD5xxx08
    config MCUX_HW_DEVICE_PART_MIMX8UD5DVK08
    bool "Device part MIMX8UD5DVK08"
    select MCUX_HW_DEVICE_ID_MIMX8UD5xxx08
endchoice

config MCUX_HW_DEVICE_ID
    string
    default "MIMX8UD5xxx08" if MCUX_HW_DEVICE_ID_MIMX8UD5xxx08

config MCUX_HW_DEVICE_PART
    string
    default "MIMX8UD5CVP08" if MCUX_HW_DEVICE_PART_MIMX8UD5CVP08
    default "MIMX8UD5DVP08" if MCUX_HW_DEVICE_PART_MIMX8UD5DVP08
    default "MIMX8UD5DVK08" if MCUX_HW_DEVICE_PART_MIMX8UD5DVK08

# For chipmodel generated files
config MCUX_TOOLCHAIN_LINKER_DEVICE_PREFIX
    string
    default "MIMX8UD5xxxxx"

config MCUX_TOOLCHAIN_MCUX_STARTUP
    string
    default "mimx8ud5"

# Toolchain related

config MCUX_TOOLCHAIN_IAR_CPU_IDENTIFIER
    string
    default "MIMX8UD5_M33" if MCUX_HW_DEVICE_ID_MIMX8UD5xxx08

config MCUX_TOOLCHAIN_MDK_CPU_IDENTIFIER
    string
    default "MIMX8UD5CVP08" if MCUX_HW_DEVICE_PART_MIMX8UD5CVP08
    default "MIMX8UD5DVP08" if MCUX_HW_DEVICE_PART_MIMX8UD5DVP08
    default "MIMX8UD5DVK08" if MCUX_HW_DEVICE_PART_MIMX8UD5DVK08

# ip information
config MCUX_HW_IP_DriverType_ACMP
    bool
    default y
    depends on MCUX_HW_DEVICE_ID_MIMX8UD5xxx08

config MCUX_HW_IP_DriverType_ADDR_REMAP
    bool
    default y
    depends on MCUX_HW_DEVICE_ID_MIMX8UD5xxx08

config MCUX_HW_IP_DriverType_AXBS
    bool
    default y
    depends on MCUX_HW_DEVICE_ID_MIMX8UD5xxx08

config MCUX_HW_IP_DriverType_BBNSM
    bool
    default y
    depends on MCUX_HW_DEVICE_ID_MIMX8UD5xxx08

config MCUX_HW_IP_DriverType_CACHE64_CTRL
    bool
    default y
    depends on MCUX_HW_DEVICE_ID_MIMX8UD5xxx08

config MCUX_HW_IP_DriverType_CACHEC
    bool
    default y
    depends on MCUX_HW_DEVICE_ID_MIMX8UD5xxx08

config MCUX_HW_IP_DriverType_CASPER
    bool
    default y
    depends on MCUX_HW_DEVICE_ID_MIMX8UD5xxx08

config MCUX_HW_IP_DriverType_CGC
    bool
    default y
    depends on MCUX_HW_DEVICE_ID_MIMX8UD5xxx08

config MCUX_HW_IP_DriverType_CMC
    bool
    default y
    depends on MCUX_HW_DEVICE_ID_MIMX8UD5xxx08

config MCUX_HW_IP_DriverType_DAC12
    bool
    default y
    depends on MCUX_HW_DEVICE_ID_MIMX8UD5xxx08

config MCUX_HW_IP_DriverType_AD_DMA3
    bool
    default y
    depends on MCUX_HW_DEVICE_ID_MIMX8UD5xxx08

config MCUX_HW_IP_DriverType_DMA3
    bool
    default y
    depends on MCUX_HW_DEVICE_ID_MIMX8UD5xxx08

config MCUX_HW_IP_DriverType_DMA_TCD
    bool
    default y
    depends on MCUX_HW_DEVICE_ID_MIMX8UD5xxx08

config MCUX_HW_IP_DriverType_EDGELOCK
    bool
    default y
    depends on MCUX_HW_DEVICE_ID_MIMX8UD5xxx08

config MCUX_HW_IP_DriverType_ENET
    bool
    default y
    depends on MCUX_HW_DEVICE_ID_MIMX8UD5xxx08

config MCUX_HW_IP_DriverType_EWM
    bool
    default y
    depends on MCUX_HW_DEVICE_ID_MIMX8UD5xxx08

config MCUX_HW_IP_DriverType_FLEXCAN
    bool
    default y
    depends on MCUX_HW_DEVICE_ID_MIMX8UD5xxx08

config MCUX_HW_IP_DriverType_FLEXIO
    bool
    default y
    depends on MCUX_HW_DEVICE_ID_MIMX8UD5xxx08

config MCUX_HW_IP_DriverType_FLEXSPI
    bool
    default y
    depends on MCUX_HW_DEVICE_ID_MIMX8UD5xxx08

config MCUX_HW_IP_DriverType_I3C
    bool
    default y
    depends on MCUX_HW_DEVICE_ID_MIMX8UD5xxx08

config MCUX_HW_IP_DriverType_IOMUXC0
    bool
    default y
    depends on MCUX_HW_DEVICE_ID_MIMX8UD5xxx08

config MCUX_HW_IP_DriverType_IOMUXC1
    bool
    default y
    depends on MCUX_HW_DEVICE_ID_MIMX8UD5xxx08

config MCUX_HW_IP_DriverType_ISI
    bool
    default y
    depends on MCUX_HW_DEVICE_ID_MIMX8UD5xxx08

config MCUX_HW_IP_DriverType_JTAGC
    bool
    default y
    depends on MCUX_HW_DEVICE_ID_MIMX8UD5xxx08

config MCUX_HW_IP_DriverType_LCDIF
    bool
    default y
    depends on MCUX_HW_DEVICE_ID_MIMX8UD5xxx08

config MCUX_HW_IP_DriverType_LPADC
    bool
    default y
    depends on MCUX_HW_DEVICE_ID_MIMX8UD5xxx08

config MCUX_HW_IP_DriverType_LPC_OTP
    bool
    default y
    depends on MCUX_HW_DEVICE_ID_MIMX8UD5xxx08

config MCUX_HW_IP_DriverType_LPDDR
    bool
    default y
    depends on MCUX_HW_DEVICE_ID_MIMX8UD5xxx08

config MCUX_HW_IP_DriverType_LPI2C
    bool
    default y
    depends on MCUX_HW_DEVICE_ID_MIMX8UD5xxx08

config MCUX_HW_IP_DriverType_LPIT
    bool
    default y
    depends on MCUX_HW_DEVICE_ID_MIMX8UD5xxx08

config MCUX_HW_IP_DriverType_LPSPI
    bool
    default y
    depends on MCUX_HW_DEVICE_ID_MIMX8UD5xxx08

config MCUX_HW_IP_DriverType_LPTMR
    bool
    default y
    depends on MCUX_HW_DEVICE_ID_MIMX8UD5xxx08

config MCUX_HW_IP_DriverType_LPUART
    bool
    default y
    depends on MCUX_HW_DEVICE_ID_MIMX8UD5xxx08

config MCUX_HW_IP_DriverType_MCM
    bool
    default y
    depends on MCUX_HW_DEVICE_ID_MIMX8UD5xxx08

config MCUX_HW_IP_DriverType_MEMORY
    bool
    default y
    depends on MCUX_HW_DEVICE_ID_MIMX8UD5xxx08

config MCUX_HW_IP_DriverType_MIPI_CSI2RX
    bool
    default y
    depends on MCUX_HW_DEVICE_ID_MIMX8UD5xxx08

config MCUX_HW_IP_DriverType_MIPI_CSI_CSR
    bool
    default y
    depends on MCUX_HW_DEVICE_ID_MIMX8UD5xxx08

config MCUX_HW_IP_DriverType_MIPI_DSI
    bool
    default y
    depends on MCUX_HW_DEVICE_ID_MIMX8UD5xxx08

config MCUX_HW_IP_DriverType_MIPI_DSI_DPI_INTFC
    bool
    default y
    depends on MCUX_HW_DEVICE_ID_MIMX8UD5xxx08

config MCUX_HW_IP_DriverType_MIPI_DSI_HOST_APB_PKT_IF
    bool
    default y
    depends on MCUX_HW_DEVICE_ID_MIMX8UD5xxx08

config MCUX_HW_IP_DriverType_MIPI_DSI_HOST_DBI_INTFC
    bool
    default y
    depends on MCUX_HW_DEVICE_ID_MIMX8UD5xxx08

config MCUX_HW_IP_DriverType_MIPI_DSI_HOST_NXP_IP2B_DPHY_INTFC
    bool
    default y
    depends on MCUX_HW_DEVICE_ID_MIMX8UD5xxx08

config MCUX_HW_IP_DriverType_MQS
    bool
    default y
    depends on MCUX_HW_DEVICE_ID_MIMX8UD5xxx08

config MCUX_HW_IP_DriverType_MRT
    bool
    default y
    depends on MCUX_HW_DEVICE_ID_MIMX8UD5xxx08

config MCUX_HW_IP_DriverType_MU
    bool
    default y
    depends on MCUX_HW_DEVICE_ID_MIMX8UD5xxx08

config MCUX_HW_IP_DriverType_MUTRA
    bool
    default y
    depends on MCUX_HW_DEVICE_ID_MIMX8UD5xxx08

config MCUX_HW_IP_DriverType_MUTRB
    bool
    default y
    depends on MCUX_HW_DEVICE_ID_MIMX8UD5xxx08

config MCUX_HW_IP_DriverType_MU_1
    bool
    default y
    depends on MCUX_HW_DEVICE_ID_MIMX8UD5xxx08

config MCUX_HW_IP_DriverType_PCC
    bool
    default y
    depends on MCUX_HW_DEVICE_ID_MIMX8UD5xxx08

config MCUX_HW_IP_DriverType_PDM
    bool
    default y
    depends on MCUX_HW_DEVICE_ID_MIMX8UD5xxx08

config MCUX_HW_IP_DriverType_POWERQUAD
    bool
    default y
    depends on MCUX_HW_DEVICE_ID_MIMX8UD5xxx08

config MCUX_HW_IP_DriverType_PXP
    bool
    default y
    depends on MCUX_HW_DEVICE_ID_MIMX8UD5xxx08

config MCUX_HW_IP_DriverType_RGPIO
    bool
    default y
    depends on MCUX_HW_DEVICE_ID_MIMX8UD5xxx08

config MCUX_HW_IP_DriverType_RTD_CMC
    bool
    default y
    depends on MCUX_HW_DEVICE_ID_MIMX8UD5xxx08

config MCUX_HW_IP_DriverType_SAI
    bool
    default y
    depends on MCUX_HW_DEVICE_ID_MIMX8UD5xxx08

config MCUX_HW_IP_DriverType_SEMA42
    bool
    default y
    depends on MCUX_HW_DEVICE_ID_MIMX8UD5xxx08

config MCUX_HW_IP_DriverType_SFA
    bool
    default y
    depends on MCUX_HW_DEVICE_ID_MIMX8UD5xxx08

config MCUX_HW_IP_DriverType_SIM
    bool
    default y
    depends on MCUX_HW_DEVICE_ID_MIMX8UD5xxx08

config MCUX_HW_IP_DriverType_SPDIF
    bool
    default y
    depends on MCUX_HW_DEVICE_ID_MIMX8UD5xxx08

config MCUX_HW_IP_DriverType_SSL
    bool
    default y
    depends on MCUX_HW_DEVICE_ID_MIMX8UD5xxx08

config MCUX_HW_IP_DriverType_SYSPM
    bool
    default y
    depends on MCUX_HW_DEVICE_ID_MIMX8UD5xxx08

config MCUX_HW_IP_DriverType_TPM
    bool
    default y
    depends on MCUX_HW_DEVICE_ID_MIMX8UD5xxx08

config MCUX_HW_IP_DriverType_TRDC
    bool
    default y
    depends on MCUX_HW_DEVICE_ID_MIMX8UD5xxx08

config MCUX_HW_IP_DriverType_TRGMUX
    bool
    default y
    depends on MCUX_HW_DEVICE_ID_MIMX8UD5xxx08

config MCUX_HW_IP_DriverType_TSTMR
    bool
    default y
    depends on MCUX_HW_DEVICE_ID_MIMX8UD5xxx08

config MCUX_HW_IP_DriverType_USBNC
    bool
    default y
    depends on MCUX_HW_DEVICE_ID_MIMX8UD5xxx08

config MCUX_HW_IP_DriverType_USB_HOST_DEVICE_EHCI
    bool
    default y
    depends on MCUX_HW_DEVICE_ID_MIMX8UD5xxx08

config MCUX_HW_IP_DriverType_USB_HSDCD
    bool
    default y
    depends on MCUX_HW_DEVICE_ID_MIMX8UD5xxx08

config MCUX_HW_IP_DriverType_USB_PHY
    bool
    default y
    depends on MCUX_HW_DEVICE_ID_MIMX8UD5xxx08

config MCUX_HW_IP_DriverType_USDHC
    bool
    default y
    depends on MCUX_HW_DEVICE_ID_MIMX8UD5xxx08

config MCUX_HW_IP_DriverType_WDOG32
    bool
    default y
    depends on MCUX_HW_DEVICE_ID_MIMX8UD5xxx08

config MCUX_HW_IP_DriverType_WUU
    bool
    default y
    depends on MCUX_HW_DEVICE_ID_MIMX8UD5xxx08

config MCUX_HW_IP_DriverType_XRDC
    bool
    default y
    depends on MCUX_HW_DEVICE_ID_MIMX8UD5xxx08
```

## mcux/mcux-sdk-ng/devices/i.MX/i.MX8ULP/MIMX8UD5/cm33/Kconfig.chip
```kconfig
# Copyright 2024 NXP
#
# SPDX-License-Identifier: BSD-3-Clause

# core related
config MCUX_HW_CORE
    string
    default "cm33"

config MCUX_HW_CORE_CM33
    bool
    default y

config MCUX_HW_CORE_ID
    string
    default "cm33"

config MCUX_HW_CORE_ID_CM33
    bool
    default y

config MCUX_HW_DEVICE_CORE
    string
    default "MIMX8UD5_cm33"

config MCUX_HW_FPU
    string
    default "SP_FPU"

config MCUX_HW_FPU_TYPE
    string
    default "fpv5_sp"

config MCUX_HW_FPV5_SP
    bool
    default y

config MCUX_HW_INT_PRIO_BITS
    int
    default 3

config MCUX_HW_DSP
    bool
    default y

config MCUX_HW_SAU
    bool
    default y

config MCUX_HW_SOC_SERIES_MIMX
    bool
    default y

config MCUX_HW_SOC_SINGLECORE_DEVICE
    bool
    default y
 
```

## mcux/mcux-sdk-ng/devices/i.MX/i.MX8ULP/MIMX8UD7/cm33/Kconfig
```kconfig
# Copyright 2024 NXP
# All rights reserved.
#
# SPDX-License-Identifier: BSD-3-Clause

config MCUX_HW_DEVICE_MIMX8ULP_CORE_ID_cm33
    bool
    default y

rsource "Kconfig.chip"
rsource "../../../../arm/Kconfig.common"
```

## mcux/mcux-sdk-ng/devices/i.MX/i.MX8ULP/MIMX8UD7/cm33/Kconfig.chip
```kconfig
# Copyright 2024 NXP
#
# SPDX-License-Identifier: BSD-3-Clause

# core related
config MCUX_HW_CORE
    string
    default "cm33"

config MCUX_HW_CORE_CM33
    bool
    default y

config MCUX_HW_CORE_ID
    string
    default "cm33"

config MCUX_HW_CORE_ID_CM33
    bool
    default y

config MCUX_HW_DEVICE_CORE
    string
    default "MIMX8UD7_cm33"

config MCUX_HW_FPU
    string
    default "SP_FPU"

config MCUX_HW_FPU_TYPE
    string
    default "fpv5_sp"

config MCUX_HW_FPV5_SP
    bool
    default y

config MCUX_HW_INT_PRIO_BITS
    int
    default 3

config MCUX_HW_DSP
    bool
    default y

config MCUX_HW_SAU
    bool
    default y

config MCUX_HW_SOC_SERIES_MIMX
    bool
    default y

config MCUX_HW_SOC_SINGLECORE_DEVICE
    bool
    default y

# device related

# For chipmodel generated files
config MCUX_TOOLCHAIN_LINKER_DEVICE_PREFIX
    string
    default "MIMX8UD7xxxxx"

config MCUX_TOOLCHAIN_MCUX_STARTUP
    string
    default "mimx8ud7"

# Toolchain related

config MCUX_TOOLCHAIN_IAR_CPU_IDENTIFIER
    string
    default "MIMX8UD7_M33" if MCUX_HW_DEVICE_ID_MIMX8UD7xxx08

config MCUX_TOOLCHAIN_MDK_CPU_IDENTIFIER
    string
    default "MIMX8UD7CVP08" if MCUX_HW_DEVICE_PART_MIMX8UD7CVP08
    default "MIMX8UD7DVP08" if MCUX_HW_DEVICE_PART_MIMX8UD7DVP08
    default "MIMX8UD7DVK08" if MCUX_HW_DEVICE_PART_MIMX8UD7DVK08
```

## mcux/mcux-sdk-ng/devices/i.MX/i.MX8ULP/MIMX8UD7/drivers/Kconfig
```kconfig
# Copyright 2024 NXP
# All rights reserved.
#
# SPDX-License-Identifier: BSD-3-Clause

menu "Device specific drivers configuration"

    config MCUX_COMPONENT_driver.clock
         bool "Use driver clock"
         default y

    config MCUX_COMPONENT_driver.fusion
         bool "Use driver fusion"
         default n

    config MCUX_COMPONENT_driver.iomuxc
         bool "Use driver iomuxc"
         default y

    config MCUX_COMPONENT_driver.memory
         bool "Use driver memory"
         default y

    config MCUX_COMPONENT_driver.reset
         bool "Use driver reset"
         default y

    config MCUX_COMPONENT_driver.sentinel
         bool "Use driver sentinel"
         default y

    config MCUX_COMPONENT_driver.mipi_dsi_soc
         bool "Use driver mipi_dsi_soc"
         default y

    config MCUX_COMPONENT_driver.upower
         bool "Use driver upower"
         default y

endmenu
```

## mcux/mcux-sdk-ng/devices/i.MX/i.MX8ULP/MIMX8UD7/drivers/upower/Kconfig
```kconfig
# Copyright 2024 NXP
# All rights reserved.
#
# SPDX-License-Identifier: BSD-3-Clause

menu "Device specific drivers configuration"


    config MCUX_COMPONENT_driver.upowerlib
         bool "Use driver upowerlib"
         default y

endmenu
```

## mcux/mcux-sdk-ng/devices/i.MX/i.MX8ULP/MIMX8UD7/fusionf1/Kconfig.chip
```kconfig
# Copyright 2024 NXP
# All rights reserved.
#
# SPDX-License-Identifier: BSD-3-Clause
# core related
config MCUX_HW_CORE
    string
    default "dsp"

config MCUX_HW_CORE_DSP
    bool
    default y

config MCUX_HW_CORE_ID
    string
    default "fusionf1"

config MCUX_HW_CORE_ID_FUSIONF1
    bool
    default y

config MCUX_HW_DEVICE_CORE
    string
    default "MIMX8UD7_dsp0"

config MCUX_HW_SOC_SERIES_KINETIS
    bool
    default y

# For chipmodel generated files
config MCUX_TOOLCHAIN_LINKER_DEVICE_PREFIX
    string
    default "MIMX8UD7xxx08_fusionf1" if MCUX_HW_DEVICE_ID_MIMX8UD7xxx08

config MCUX_TOOLCHAIN_MCUX_STARTUP
    string
    default "mimx8ud7_fusionf1"

# Toolchain related

config MCUX_TOOLCHAIN_IAR_CPU_IDENTIFIER
    string
    default "MIMX8UD7xxx08_fusionf1" if MCUX_HW_DEVICE_ID_MIMX8UD7xxx08

config MCUX_TOOLCHAIN_MDK_CPU_IDENTIFIER
    string
    default "MIMX8UD7CVP08:fusionf1" if MCUX_HW_DEVICE_PART_MIMX8UD7CVP08
    default "MIMX8UD7DVP08:fusionf1" if MCUX_HW_DEVICE_PART_MIMX8UD7DVP08
    default "MIMX8UD7DVK08:fusionf1" if MCUX_HW_DEVICE_PART_MIMX8UD7DVK08
```

## mcux/mcux-sdk-ng/devices/i.MX/i.MX8ULP/MIMX8US3/fusionf1/Kconfig
```kconfig
# Copyright 2024 NXP
# All rights reserved.
#
# SPDX-License-Identifier: BSD-3-Clause

config MCUX_HW_DEVICE_MIMX8US3_CORE_ID_fusionf1
    bool
    default y

rsource "Kconfig.chip"
```

## mcux/mcux-sdk-ng/devices/i.MX/i.MX8ULP/MIMX8US3/fusionf1/Kconfig.chip
```kconfig
# Copyright 2024 NXP
# All rights reserved.
#
# SPDX-License-Identifier: BSD-3-Clause
# core related
config MCUX_HW_CORE
    string
    default "dsp"

config MCUX_HW_CORE_DSP
    bool
    default y

config MCUX_HW_CORE_ID
    string
    default "fusionf1"

config MCUX_HW_CORE_ID_FUSIONF1
    bool
    default y

config MCUX_HW_DEVICE_CORE
    string
    default "MIMX8US3_dsp0"

config MCUX_HW_SOC_SERIES_KINETIS
    bool
    default y

# For chipmodel generated files
config MCUX_TOOLCHAIN_LINKER_DEVICE_PREFIX
    string
    default "MIMX8US3xxx08_fusionf1" if MCUX_HW_DEVICE_ID_MIMX8US3xxx08

config MCUX_TOOLCHAIN_MCUX_STARTUP
    string
    default "mimx8us3_fusionf1"

# Toolchain related

config MCUX_TOOLCHAIN_IAR_CPU_IDENTIFIER
    string
    default "MIMX8US3xxx08_fusionf1" if MCUX_HW_DEVICE_ID_MIMX8US3xxx08

config MCUX_TOOLCHAIN_MDK_CPU_IDENTIFIER
    string
    default "MIMX8US3CVP08:fusionf1" if MCUX_HW_DEVICE_PART_MIMX8US3CVP08
    default "MIMX8US3DVP08:fusionf1" if MCUX_HW_DEVICE_PART_MIMX8US3DVP08
    default "MIMX8US3DVK08:fusionf1" if MCUX_HW_DEVICE_PART_MIMX8US3DVK08
```

## mcux/mcux-sdk-ng/devices/i.MX/i.MX8M/MIMX8MD7/Kconfig.chip
```kconfig
# Copyright 2024 NXP
#
# SPDX-License-Identifier: BSD-3-Clause

# core related
config MCUX_HW_CORE
    string
    default "cm4f"

config MCUX_HW_CORE_CM4F
    bool
    default y

config MCUX_HW_CORE_ID
    string
    default "cm4"

config MCUX_HW_CORE_ID_CM4
    bool
    default y

config MCUX_HW_DEVICE_CORE
    string
    default "MIMX8MD7_cm4"

config MCUX_HW_FPU
    string
    default "SP_FPU"

config MCUX_HW_FPU_TYPE
    string
    default "fpv4_sp"

config MCUX_HW_FPV4_SP
    bool
    default y

config MCUX_HW_INT_PRIO_BITS
    int
    default 4

config MCUX_HW_SOC_SERIES_MIMX
    bool
    default y

config MCUX_HW_SOC_SINGLECORE_DEVICE
    bool
    default y

# device related

config MCUX_HW_DEVICE_ID_MIMX8MD7xxxJZ
    bool

config MCUX_HW_DEVICE_ID_MIMX8MD7xxxHZ
    bool

choice
    prompt "Device MIMX8MD7 Part"
    config MCUX_HW_DEVICE_PART_MIMX8MD7DVAJZ
    bool "Device part MIMX8MD7DVAJZ"
    select MCUX_HW_DEVICE_ID_MIMX8MD7xxxJZ
    config MCUX_HW_DEVICE_PART_MIMX8MD7CVAHZ
    bool "Device part MIMX8MD7CVAHZ"
    select MCUX_HW_DEVICE_ID_MIMX8MD7xxxHZ
endchoice

config MCUX_HW_DEVICE_ID
    string
    default "MIMX8MD7xxxJZ" if MCUX_HW_DEVICE_ID_MIMX8MD7xxxJZ
    default "MIMX8MD7xxxHZ" if MCUX_HW_DEVICE_ID_MIMX8MD7xxxHZ

config MCUX_HW_DEVICE_PART
    string
    default "MIMX8MD7DVAJZ" if MCUX_HW_DEVICE_PART_MIMX8MD7DVAJZ
    default "MIMX8MD7CVAHZ" if MCUX_HW_DEVICE_PART_MIMX8MD7CVAHZ

# For chipmodel generated files
config MCUX_TOOLCHAIN_LINKER_DEVICE_PREFIX
    string
    default "MIMX8MD7xxxJZ" if MCUX_HW_DEVICE_ID_MIMX8MD7xxxJZ
    default "MIMX8MD7xxxHZ" if MCUX_HW_DEVICE_ID_MIMX8MD7xxxHZ

config MCUX_TOOLCHAIN_MCUX_STARTUP
    string
    default "mimx8md7"

# Toolchain related

config MCUX_TOOLCHAIN_IAR_CPU_IDENTIFIER
    string
    default "MIMX8MD7_M4" if MCUX_HW_DEVICE_ID_MIMX8MD7xxxJZ
    default "MIMX8MD7_M4" if MCUX_HW_DEVICE_ID_MIMX8MD7xxxHZ

config MCUX_TOOLCHAIN_MDK_CPU_IDENTIFIER
    string
    default "MIMX8MD7DVAJZ" if MCUX_HW_DEVICE_PART_MIMX8MD7DVAJZ
    default "MIMX8MD7CVAHZ" if MCUX_HW_DEVICE_PART_MIMX8MD7CVAHZ

# ip information
config MCUX_HW_IP_DriverType_APBH
    bool
    default y
    depends on MCUX_HW_DEVICE_ID_MIMX8MD7xxxJZ || MCUX_HW_DEVICE_ID_MIMX8MD7xxxHZ

config MCUX_HW_IP_DriverType_BCH
    bool
    default y
    depends on MCUX_HW_DEVICE_ID_MIMX8MD7xxxJZ || MCUX_HW_DEVICE_ID_MIMX8MD7xxxHZ

config MCUX_HW_IP_DriverType_CCM
    bool
    default y
    depends on MCUX_HW_DEVICE_ID_MIMX8MD7xxxJZ || MCUX_HW_DEVICE_ID_MIMX8MD7xxxHZ

config MCUX_HW_IP_DriverType_CCM_ANALOG
    bool
    default y
    depends on MCUX_HW_DEVICE_ID_MIMX8MD7xxxJZ || MCUX_HW_DEVICE_ID_MIMX8MD7xxxHZ

config MCUX_HW_IP_DriverType_DDRC
    bool
    default y
    depends on MCUX_HW_DEVICE_ID_MIMX8MD7xxxJZ || MCUX_HW_DEVICE_ID_MIMX8MD7xxxHZ

config MCUX_HW_IP_DriverType_DEC400D
    bool
    default y
    depends on MCUX_HW_DEVICE_ID_MIMX8MD7xxxJZ || MCUX_HW_DEVICE_ID_MIMX8MD7xxxHZ

config MCUX_HW_IP_DriverType_DTRC
    bool
    default y
    depends on MCUX_HW_DEVICE_ID_MIMX8MD7xxxJZ || MCUX_HW_DEVICE_ID_MIMX8MD7xxxHZ

config MCUX_HW_IP_DriverType_DWT
    bool
    default y
    depends on MCUX_HW_DEVICE_ID_MIMX8MD7xxxJZ || MCUX_HW_DEVICE_ID_MIMX8MD7xxxHZ

config MCUX_HW_IP_DriverType_ECSPI
    bool
    default y
    depends on MCUX_HW_DEVICE_ID_MIMX8MD7xxxJZ || MCUX_HW_DEVICE_ID_MIMX8MD7xxxHZ

config MCUX_HW_IP_DriverType_ETM
    bool
    default y
    depends on MCUX_HW_DEVICE_ID_MIMX8MD7xxxJZ || MCUX_HW_DEVICE_ID_MIMX8MD7xxxHZ

config MCUX_HW_IP_DriverType_GPC
    bool
    default y
    depends on MCUX_HW_DEVICE_ID_MIMX8MD7xxxJZ || MCUX_HW_DEVICE_ID_MIMX8MD7xxxHZ

config MCUX_HW_IP_DriverType_GPC_PGC
    bool
    default y
    depends on MCUX_HW_DEVICE_ID_MIMX8MD7xxxJZ || MCUX_HW_DEVICE_ID_MIMX8MD7xxxHZ

config MCUX_HW_IP_DriverType_GPMI
    bool
    default y
    depends on MCUX_HW_DEVICE_ID_MIMX8MD7xxxJZ || MCUX_HW_DEVICE_ID_MIMX8MD7xxxHZ

config MCUX_HW_IP_DriverType_GPT
    bool
    default y
    depends on MCUX_HW_DEVICE_ID_MIMX8MD7xxxJZ || MCUX_HW_DEVICE_ID_MIMX8MD7xxxHZ

config MCUX_HW_IP_DriverType_HDMI_TX
    bool
    default y
    depends on MCUX_HW_DEVICE_ID_MIMX8MD7xxxJZ || MCUX_HW_DEVICE_ID_MIMX8MD7xxxHZ

config MCUX_HW_IP_DriverType_IGPIO
    bool
    default y
    depends on MCUX_HW_DEVICE_ID_MIMX8MD7xxxJZ || MCUX_HW_DEVICE_ID_MIMX8MD7xxxHZ

config MCUX_HW_IP_DriverType_II2C
    bool
    default y
    depends on MCUX_HW_DEVICE_ID_MIMX8MD7xxxJZ || MCUX_HW_DEVICE_ID_MIMX8MD7xxxHZ

config MCUX_HW_IP_DriverType_IOMUXC
    bool
    default y
    depends on MCUX_HW_DEVICE_ID_MIMX8MD7xxxJZ || MCUX_HW_DEVICE_ID_MIMX8MD7xxxHZ

config MCUX_HW_IP_DriverType_IOMUXC_GPR
    bool
    default y
    depends on MCUX_HW_DEVICE_ID_MIMX8MD7xxxJZ || MCUX_HW_DEVICE_ID_MIMX8MD7xxxHZ

config MCUX_HW_IP_DriverType_IPWM
    bool
    default y
    depends on MCUX_HW_DEVICE_ID_MIMX8MD7xxxJZ || MCUX_HW_DEVICE_ID_MIMX8MD7xxxHZ

config MCUX_HW_IP_DriverType_IRQSTEER
    bool
    default y
    depends on MCUX_HW_DEVICE_ID_MIMX8MD7xxxJZ || MCUX_HW_DEVICE_ID_MIMX8MD7xxxHZ

config MCUX_HW_IP_DriverType_ITM
    bool
    default y
    depends on MCUX_HW_DEVICE_ID_MIMX8MD7xxxJZ || MCUX_HW_DEVICE_ID_MIMX8MD7xxxHZ

config MCUX_HW_IP_DriverType_IUART
    bool
    default y
    depends on MCUX_HW_DEVICE_ID_MIMX8MD7xxxJZ || MCUX_HW_DEVICE_ID_MIMX8MD7xxxHZ

config MCUX_HW_IP_DriverType_LCDIF
    bool
    default y
    depends on MCUX_HW_DEVICE_ID_MIMX8MD7xxxJZ || MCUX_HW_DEVICE_ID_MIMX8MD7xxxHZ

config MCUX_HW_IP_DriverType_LMEM
    bool
    default y
    depends on MCUX_HW_DEVICE_ID_MIMX8MD7xxxJZ || MCUX_HW_DEVICE_ID_MIMX8MD7xxxHZ

config MCUX_HW_IP_DriverType_MCM
    bool
    default y
    depends on MCUX_HW_DEVICE_ID_MIMX8MD7xxxJZ || MCUX_HW_DEVICE_ID_MIMX8MD7xxxHZ

config MCUX_HW_IP_DriverType_MIPI_CSI2RX
    bool
    default y
    depends on MCUX_HW_DEVICE_ID_MIMX8MD7xxxJZ || MCUX_HW_DEVICE_ID_MIMX8MD7xxxHZ

config MCUX_HW_IP_DriverType_MIPI_DSI
    bool
    default y
    depends on MCUX_HW_DEVICE_ID_MIMX8MD7xxxJZ || MCUX_HW_DEVICE_ID_MIMX8MD7xxxHZ

config MCUX_HW_IP_DriverType_MIPI_DSI_HOST_APB_PKT_IF
    bool
    default y
    depends on MCUX_HW_DEVICE_ID_MIMX8MD7xxxJZ || MCUX_HW_DEVICE_ID_MIMX8MD7xxxHZ

config MCUX_HW_IP_DriverType_MIPI_DSI_HOST_DPI_INTFC
    bool
    default y
    depends on MCUX_HW_DEVICE_ID_MIMX8MD7xxxJZ || MCUX_HW_DEVICE_ID_MIMX8MD7xxxHZ

config MCUX_HW_IP_DriverType_MIPI_DSI_HOST_FSL_IP1_DPHY_INTFC
    bool
    default y
    depends on MCUX_HW_DEVICE_ID_MIMX8MD7xxxJZ || MCUX_HW_DEVICE_ID_MIMX8MD7xxxHZ

config MCUX_HW_IP_DriverType_MU
    bool
    default y
    depends on MCUX_HW_DEVICE_ID_MIMX8MD7xxxJZ || MCUX_HW_DEVICE_ID_MIMX8MD7xxxHZ

config MCUX_HW_IP_DriverType_OCOTP
    bool
    default y
    depends on MCUX_HW_DEVICE_ID_MIMX8MD7xxxJZ || MCUX_HW_DEVICE_ID_MIMX8MD7xxxHZ

config MCUX_HW_IP_DriverType_QUADSPI
    bool
    default y
    depends on MCUX_HW_DEVICE_ID_MIMX8MD7xxxJZ || MCUX_HW_DEVICE_ID_MIMX8MD7xxxHZ

config MCUX_HW_IP_DriverType_RDC
    bool
    default y
    depends on MCUX_HW_DEVICE_ID_MIMX8MD7xxxJZ || MCUX_HW_DEVICE_ID_MIMX8MD7xxxHZ

config MCUX_HW_IP_DriverType_RDC_SEMAPHORE
    bool
    default y
    depends on MCUX_HW_DEVICE_ID_MIMX8MD7xxxJZ || MCUX_HW_DEVICE_ID_MIMX8MD7xxxHZ

config MCUX_HW_IP_DriverType_ROMC
    bool
    default y
    depends on MCUX_HW_DEVICE_ID_MIMX8MD7xxxJZ || MCUX_HW_DEVICE_ID_MIMX8MD7xxxHZ

config MCUX_HW_IP_DriverType_SAI
    bool
    default y
    depends on MCUX_HW_DEVICE_ID_MIMX8MD7xxxJZ || MCUX_HW_DEVICE_ID_MIMX8MD7xxxHZ

config MCUX_HW_IP_DriverType_SCB
    bool
    default y
    depends on MCUX_HW_DEVICE_ID_MIMX8MD7xxxJZ || MCUX_HW_DEVICE_ID_MIMX8MD7xxxHZ

config MCUX_HW_IP_DriverType_SDMAARM
    bool
    default y
    depends on MCUX_HW_DEVICE_ID_MIMX8MD7xxxJZ || MCUX_HW_DEVICE_ID_MIMX8MD7xxxHZ

config MCUX_HW_IP_DriverType_SEMA4
    bool
    default y
    depends on MCUX_HW_DEVICE_ID_MIMX8MD7xxxJZ || MCUX_HW_DEVICE_ID_MIMX8MD7xxxHZ

config MCUX_HW_IP_DriverType_SNVS
    bool
    default y
    depends on MCUX_HW_DEVICE_ID_MIMX8MD7xxxJZ || MCUX_HW_DEVICE_ID_MIMX8MD7xxxHZ

config MCUX_HW_IP_DriverType_SPBA
    bool
    default y
    depends on MCUX_HW_DEVICE_ID_MIMX8MD7xxxJZ || MCUX_HW_DEVICE_ID_MIMX8MD7xxxHZ

config MCUX_HW_IP_DriverType_SPDIF
    bool
    default y
    depends on MCUX_HW_DEVICE_ID_MIMX8MD7xxxJZ || MCUX_HW_DEVICE_ID_MIMX8MD7xxxHZ

config MCUX_HW_IP_DriverType_SRC
    bool
    default y
    depends on MCUX_HW_DEVICE_ID_MIMX8MD7xxxJZ || MCUX_HW_DEVICE_ID_MIMX8MD7xxxHZ

config MCUX_HW_IP_DriverType_SysTick
    bool
    default y
    depends on MCUX_HW_DEVICE_ID_MIMX8MD7xxxJZ || MCUX_HW_DEVICE_ID_MIMX8MD7xxxHZ

config MCUX_HW_IP_DriverType_TMU
    bool
    default y
    depends on MCUX_HW_DEVICE_ID_MIMX8MD7xxxJZ || MCUX_HW_DEVICE_ID_MIMX8MD7xxxHZ

config MCUX_HW_IP_DriverType_USDHC
    bool
    default y
    depends on MCUX_HW_DEVICE_ID_MIMX8MD7xxxJZ || MCUX_HW_DEVICE_ID_MIMX8MD7xxxHZ

config MCUX_HW_IP_DriverType_WDOG01
    bool
    default y
    depends on MCUX_HW_DEVICE_ID_MIMX8MD7xxxJZ || MCUX_HW_DEVICE_ID_MIMX8MD7xxxHZ

config MCUX_HW_IP_DriverType_XTALOSC
    bool
    default y
    depends on MCUX_HW_DEVICE_ID_MIMX8MD7xxxJZ || MCUX_HW_DEVICE_ID_MIMX8MD7xxxHZ

config MCUX_HW_IP_DriverType_interrupt
    bool
    default y
    depends on MCUX_HW_DEVICE_ID_MIMX8MD7xxxJZ || MCUX_HW_DEVICE_ID_MIMX8MD7xxxHZ
```

## mcux/mcux-sdk-ng/devices/i.MX/i.MX8M/MIMX8MD7/drivers/Kconfig
```kconfig
# Copyright 2024 NXP
#
# SPDX-License-Identifier: BSD-3-Clause

rsource "../../../i.MX8M/MIMX8MQ6/drivers/Kconfig"
```

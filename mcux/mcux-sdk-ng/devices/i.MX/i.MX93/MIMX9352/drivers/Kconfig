## mcux/mcux-sdk-ng/devices/i.MX/i.MX93/MIMX9352/drivers/Kconfig
```kconfig
# Copyright 2024 NXP
# All rights reserved.
#
# SPDX-License-Identifier: BSD-3-Clause

menu "Device specific drivers configuration"

    config MCUX_COMPONENT_driver.clock
         bool "Use driver clock"
         default y

    config MCUX_COMPONENT_driver.edma_soc
         bool "Use driver edma_soc"
         default n

    config MCUX_COMPONENT_driver.iomuxc
         bool "Use driver iomuxc"
         default y

    config MCUX_COMPONENT_driver.memory
         bool "Use driver memory"
         default y

    config MCUX_COMPONENT_driver.misc_soc
         bool "Use driver misc_soc"
         default n

    config MCUX_COMPONENT_driver.sentinel
         bool "Use driver sentinel"
         default n

    config MCUX_COMPONENT_driver.mipi_dsi_soc
         bool "Use driver soc_mipi_dsi_soc"
         default n

    config MCUX_COMPONENT_driver.trdc_soc
         bool "Use driver trdc_soc"
         default n

endmenu
```

## mcux/mcux-sdk-ng/devices/i.MX/i.MX95/MIMX9596/Kconfig
```kconfig
# Copyright 2024 NXP
# All rights reserved.
#
# SPDX-License-Identifier: BSD-3-Clause
#rsource "${core_id}/Kconfig"

rsource "Kconfig.chip"
rsource "drivers/Kconfig"
rsource "../../../arm/Kconfig.common"
rsource "Kconfig.defconfig"

## Project segment and component dependency data
config MCUX_HW_DEVICE_MIMX9596
    # bool "Device MIMX9596 Configuration"
    bool
    default y

    # component dependency
    select MCUX_COMPONENT_driver.edma4 if MCUX_COMPONENT_driver.sai_edma
    select MCUX_COMPONENT_driver.edma4 if MCUX_COMPONENT_driver.lpi2c_edma
    select MCUX_COMPONENT_driver.edma4 if MCUX_COMPONENT_driver.lpspi_edma
    select MCUX_COMPONENT_driver.edma4 if MCUX_COMPONENT_driver.lpuart_edma
    select MCUX_COMPONENT_driver.memory if MCUX_COMPONENT_driver.netc
    select MCUX_COMPONENT_component.software_crc_adapter if MCUX_COMPONENT_driver.netc
    select MCUX_COMPONENT_driver.edma4 if MCUX_COMPONENT_driver.flexspi_edma
    select MCUX_COMPONENT_component.lpuart_adapter if MCUX_COMPONENT_component.serial_manager_uart
    select MCUX_COMPONENT_component.lpuart_adapter if MCUX_COMPONENT_utility.debug_console_lite
    select MCUX_COMPONENT_driver.edma_soc if MCUX_COMPONENT_driver.edma4
    select MCUX_COMPONENT_driver.memory if MCUX_COMPONENT_driver.edma4
    select MCUX_COMPONENT_driver.memory if MCUX_COMPONENT_driver.enet
    select MCUX_COMPONENT_driver.memory if MCUX_COMPONENT_driver.enet_qos
```

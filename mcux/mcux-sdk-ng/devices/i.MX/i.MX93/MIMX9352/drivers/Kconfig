## mcux/mcux-sdk-ng/devices/i.MX/i.MX95/MIMX9596/drivers/Kconfig
```kconfig
# Copyright 2024 NXP
# All rights reserved.
#
# SPDX-License-Identifier: BSD-3-Clause

menu "Device specific drivers configuration"

    config MCUX_COMPONENT_driver.clock
         bool "Use driver clock"
         default y

    config MCUX_COMPONENT_driver.edma_soc
         bool "Use driver edma_soc"

    config MCUX_COMPONENT_driver.iomuxc
         bool "Use driver iomuxc"
         default y

    config MCUX_COMPONENT_driver.memory
         bool "Use driver memory"
         default y

    config MCUX_COMPONENT_driver.trdc_soc
         bool "Use driver trdc_soc"

endmenu
```

## mcux/mcux-sdk-ng/devices/xtensa/Kconfig.common
```kconfig
# FIXME improved shared arch files
rsource "../../arch/xtensa/configuration/Kconfig"
rsource "../../arch/xtensa/core/Kconfig"

menu "Device CMSIS system drivers"
    config MCUX_COMPONENT_device.CMSIS
        bool "Use device CMSIS"

    config MCUX_COMPONENT_device.system
        bool "Use device.system"
        imply MCUX_COMPONENT_device.CMSIS

    config MCUX_COMPONENT_device.RTE
        bool "Use device.rte driver"        
endmenu

menu "Device Suite"
    config MCUX_PRJSEG_module.device.suite
        bool "Use default device suite"
endmenu
```

## mcux/mcux-sdk-ng/drivers/acmp/Kconfig
```kconfig
# Copyright 2024 NXP
#
# SPDX-License-Identifier: BSD-3-Clause

config MCUX_HAS_COMPONENT_driver.acmp
    bool
    default y if MCUX_HW_IP_DriverType_ACMP

config MCUX_COMPONENT_driver.acmp
    bool "acmp"
    select MCUX_COMPONENT_driver.common
    depends on MCUX_HAS_COMPONENT_driver.acmp
```

## mcux/mcux-sdk-ng/drivers/adc12/Kconfig
```kconfig
# Copyright 2024 NXP
#
# SPDX-License-Identifier: BSD-3-Clause

config MCUX_HAS_COMPONENT_driver.adc12
    bool
    default y if MCUX_HW_IP_DriverType_ADC12

config MCUX_COMPONENT_driver.adc12
    bool "adc12"
    select MCUX_COMPONENT_driver.common
    depends on MCUX_HAS_COMPONENT_driver.adc12
```

## mcux/mcux-sdk-ng/drivers/adc_12b1msps_sar/Kconfig
```kconfig
# Copyright 2024 NXP
#
# SPDX-License-Identifier: BSD-3-Clause

config MCUX_HAS_COMPONENT_driver.adc_12b1msps_sar
    bool
    default y if MCUX_HW_IP_DriverType_ADC

config MCUX_COMPONENT_driver.adc_12b1msps_sar
    bool "adc_12b1msps_sar"
    select MCUX_COMPONENT_driver.common
    depends on MCUX_HAS_COMPONENT_driver.adc_12b1msps_sar
```

## mcux/mcux-sdk-ng/drivers/adc_5hc/Kconfig
```kconfig
# Copyright 2024 NXP
#
# SPDX-License-Identifier: BSD-3-Clause

config MCUX_HAS_COMPONENT_driver.adc_5hc
    bool
    default y if MCUX_HW_IP_DriverType_ADC12_3V

config MCUX_COMPONENT_driver.adc_5hc
    bool "adc_5hc"
    depends on MCUX_HAS_COMPONENT_driver.adc_5hc
```

## mcux/mcux-sdk-ng/drivers/adc_5v12b_ll18_015/Kconfig
```kconfig
# Copyright 2024 NXP
#
# SPDX-License-Identifier: BSD-3-Clause

config MCUX_HAS_COMPONENT_driver.adc_5v12b_ll18_015
    bool
    default y if MCUX_HW_IP_DriverType_ADC12_5V

config MCUX_COMPONENT_driver.adc_5v12b_ll18_015
    bool "adc_5v12b_ll18_015"
    select MCUX_COMPONENT_driver.common
    depends on MCUX_HAS_COMPONENT_driver.adc_5v12b_ll18_015
```

## mcux/mcux-sdk-ng/drivers/adc_etc/Kconfig
```kconfig
# Copyright 2024 NXP
#
# SPDX-License-Identifier: BSD-3-Clause

config MCUX_HAS_COMPONENT_driver.adc_etc
    bool
    default y if MCUX_HW_IP_DriverType_ADC_ETC

config MCUX_COMPONENT_driver.adc_etc
    bool "adc_etc"
    select MCUX_COMPONENT_driver.common
    depends on MCUX_HAS_COMPONENT_driver.adc_etc
```

## mcux/mcux-sdk-ng/drivers/aes/Kconfig
```kconfig
# Copyright 2024 NXP
#
# SPDX-License-Identifier: BSD-3-Clause

config MCUX_HAS_COMPONENT_driver.aes
    bool
    default y if MCUX_HW_IP_DriverType_AES

config MCUX_COMPONENT_driver.aes
    bool "aes"
    select MCUX_COMPONENT_driver.common
    depends on MCUX_HAS_COMPONENT_driver.aes
```

## mcux/mcux-sdk-ng/drivers/afe/Kconfig
```kconfig
# Copyright 2024 NXP
#
# SPDX-License-Identifier: BSD-3-Clause

config MCUX_HAS_COMPONENT_driver.afe
    bool
    default y if MCUX_HW_IP_DriverType_AFE

config MCUX_COMPONENT_driver.afe
    bool "afe"
    select MCUX_COMPONENT_driver.common
    depends on MCUX_HAS_COMPONENT_driver.afe
```

## mcux/mcux-sdk-ng/drivers/aipstz/Kconfig
```kconfig
# Copyright 2024 NXP
#
# SPDX-License-Identifier: BSD-3-Clause

config MCUX_HAS_COMPONENT_driver.aipstz
    bool
    default y if MCUX_HW_IP_DriverType_AIPSTZ

config MCUX_COMPONENT_driver.aipstz
    bool "aipstz"
    select MCUX_COMPONENT_driver.common
    depends on MCUX_HAS_COMPONENT_driver.aipstz
```

## mcux/mcux-sdk-ng/drivers/asmc/Kconfig
```kconfig
# Copyright 2024 NXP
#
# SPDX-License-Identifier: BSD-3-Clause

config MCUX_HAS_COMPONENT_driver.asmc
    bool
    default y if MCUX_HW_IP_DriverType_ASMC

config MCUX_COMPONENT_driver.asmc
    bool "asmc"
    select MCUX_COMPONENT_driver.common
    depends on MCUX_HAS_COMPONENT_driver.asmc
```

## mcux/mcux-sdk-ng/drivers/asrc/Kconfig
```kconfig
# Copyright 2024 NXP
#
# SPDX-License-Identifier: BSD-3-Clause

config MCUX_HAS_COMPONENT_driver.asrc_edma
    bool
    default y if MCUX_HAS_COMPONENT_driver.asrc && (MCUX_HAS_COMPONENT_driver.edma || MCUX_HAS_COMPONENT_driver.edma4)

config MCUX_HAS_COMPONENT_driver.asrc
    bool
    default y if MCUX_HW_IP_DriverType_ASRC

config MCUX_COMPONENT_driver.asrc_edma
    bool "asrc_edma"
    select MCUX_COMPONENT_driver.asrc
    select MCUX_COMPONENT_driver.edma if MCUX_HAS_COMPONENT_driver.edma
    select MCUX_COMPONENT_driver.edma4 if MCUX_HAS_COMPONENT_driver.edma4
    depends on MCUX_HAS_COMPONENT_driver.asrc_edma

config MCUX_COMPONENT_driver.asrc
    bool "asrc"
    select MCUX_COMPONENT_driver.common
    depends on MCUX_HAS_COMPONENT_driver.asrc
```

## mcux/mcux-sdk-ng/drivers/cache/Kconfig
```kconfig
# Copyright 2024 NXP
#
# SPDX-License-Identifier: BSD-3-Clause

rsource "./*/Kconfig"

config MCUX_PRJSEG_driver.cache
    bool "cache"
    default n
    select MCUX_COMPONENT_driver.cache_xcache if MCUX_HAS_COMPONENT_driver.cache_xcache
    select MCUX_COMPONENT_driver.cache_lplmem if MCUX_HAS_COMPONENT_driver.cache_lplmem
    select MCUX_COMPONENT_driver.cache_lpcac if MCUX_HAS_COMPONENT_driver.cache_lpcac
    select MCUX_COMPONENT_driver.cache_lmem if MCUX_HAS_COMPONENT_driver.cache_lmem
    select MCUX_COMPONENT_driver.cache_armv7_m7 if MCUX_HAS_COMPONENT_driver.cache_armv7_m7
    select MCUX_COMPONENT_driver.cache_lpcac_n4a_mcxn if MCUX_HAS_COMPONENT_driver.cache_lpcac_n4a_mcxn


config MCUX_PRJSEG_driver.flash_cache
    bool "flash cache"
    select MCUX_COMPONENT_driver.cache_cache64 if MCUX_HAS_COMPONENT_driver.cache_cache64
```

## mcux/mcux-sdk-ng/drivers/cache/armv7-m7/Kconfig
```kconfig
# Copyright 2024 NXP
#
# SPDX-License-Identifier: BSD-3-Clause

config MCUX_HAS_COMPONENT_driver.cache_armv7_m7
    bool
    default y if MCUX_HW_CORE_CM7F

config MCUX_COMPONENT_driver.cache_armv7_m7
    bool "cache_armv7_m7"
    select MCUX_COMPONENT_driver.common
    depends on MCUX_HAS_COMPONENT_driver.cache_armv7_m7
```

## mcux/mcux-sdk-ng/drivers/cache/cache64/Kconfig
```kconfig
# Copyright 2024 NXP
#
# SPDX-License-Identifier: BSD-3-Clause

config MCUX_HAS_COMPONENT_driver.cache_cache64
    bool
    default y if MCUX_HW_IP_DriverType_CACHE64_CTRL

config MCUX_COMPONENT_driver.cache_cache64
    bool "cache_cache64"
    select MCUX_COMPONENT_driver.common
    depends on MCUX_HAS_COMPONENT_driver.cache_cache64
```

## mcux/mcux-sdk-ng/drivers/cache/lmem/Kconfig
```kconfig
# Copyright 2024 NXP
#
# SPDX-License-Identifier: BSD-3-Clause

config MCUX_HAS_COMPONENT_driver.cache_lmem
    bool
    default y if MCUX_HW_IP_DriverType_LMEM || MCUX_HW_IP_DriverType_AHB_LMEM

config MCUX_COMPONENT_driver.cache_lmem
    bool "cache_lmem"
    select MCUX_COMPONENT_driver.common
    depends on MCUX_HAS_COMPONENT_driver.cache_lmem
```

## mcux/mcux-sdk-ng/drivers/cache/lpcac/Kconfig
```kconfig
# Copyright 2024 NXP
#
# SPDX-License-Identifier: BSD-3-Clause

config MCUX_HAS_COMPONENT_driver.cache_lpcac
    bool
    default y if MCUX_HW_IP_DriverType_LPCAC

config MCUX_COMPONENT_driver.cache_lpcac
    bool "cache_lpcac"
    select MCUX_COMPONENT_driver.common
    depends on MCUX_HAS_COMPONENT_driver.cache_lpcac
```

## mcux/mcux-sdk-ng/drivers/cache/lpcac_n4a_mcxn/Kconfig
```kconfig
# Copyright 2024 NXP
#
# SPDX-License-Identifier: BSD-3-Clause

config MCUX_HAS_COMPONENT_driver.cache_lpcac_n4a_mcxn
    bool
    default y if MCUX_HW_IP_DriverType_SYSCON_LPCAC || MCUX_HW_IP_DriverType_SYSCON_CMP_LPCAC

config MCUX_COMPONENT_driver.cache_lpcac_n4a_mcxn
    bool "cache_lpcac_n4a_mcxn"
    select MCUX_COMPONENT_driver.common
    depends on MCUX_HAS_COMPONENT_driver.cache_lpcac_n4a_mcxn
```

## mcux/mcux-sdk-ng/drivers/cadc/Kconfig
```kconfig
# Copyright 2024 NXP
#
# SPDX-License-Identifier: BSD-3-Clause

config MCUX_HAS_COMPONENT_driver.cadc
    bool
    default y if MCUX_HW_IP_DriverType_CADC

config MCUX_COMPONENT_driver.cadc
    bool "cadc"
    select MCUX_COMPONENT_driver.common
    depends on MCUX_HAS_COMPONENT_driver.cadc
```

## mcux/mcux-sdk-ng/drivers/camera_csr/Kconfig
```kconfig
# Copyright 2024 NXP
#
# SPDX-License-Identifier: BSD-3-Clause

config MCUX_HAS_COMPONENT_driver.camera_csr
    bool
    default y if MCUX_HW_IP_DriverType_BLK_CTRL_CAMERAMIX

config MCUX_COMPONENT_driver.camera_csr
    bool "camera_csr"
    select MCUX_COMPONENT_driver.common
    depends on MCUX_HAS_COMPONENT_driver.camera_csr
```

## mcux/mcux-sdk-ng/drivers/capt/Kconfig
```kconfig
# Copyright 2024 NXP
#
# SPDX-License-Identifier: BSD-3-Clause

config MCUX_HAS_COMPONENT_driver.capt
    bool
    default y if MCUX_HW_IP_DriverType_CAPT

config MCUX_COMPONENT_driver.capt
    bool "capt"
    select MCUX_COMPONENT_driver.common
    depends on MCUX_HAS_COMPONENT_driver.capt
```

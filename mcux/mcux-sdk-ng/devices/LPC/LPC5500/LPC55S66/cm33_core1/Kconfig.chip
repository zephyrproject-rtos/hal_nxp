## mcux/mcux-sdk-ng/devices/MCX/MCXA/MCXA276/Kconfig.chip
```kconfig
# Copyright 2024 NXP
#
# SPDX-License-Identifier: BSD-3-Clause

# core related
config MCUX_HW_CORE
    string
    default "cm33"

config MCUX_HW_CORE_CM33
    bool
    default y

config MCUX_HW_CORE_ID
    string
    default "cm33_core0"

config MCUX_HW_CORE_ID_CM33_CORE0
    bool
    default y

config MCUX_HW_DEVICE_CORE
    string
    default "MCXA276"

config MCUX_HW_FPU
    string
    default "SP_FPU"

config MCUX_HW_FPU_TYPE
    string
    default "fpv5_sp"

config MCUX_HW_FPV5_SP
    bool
    default y

config MCUX_HW_INT_PRIO_BITS
    int
    default 3

config MCUX_HW_DSP
    bool
    default y

config MCUX_HW_SAU
    bool
    default n

config MCUX_HW_SOC_SERIES_MCX
    bool
    default y

config MCUX_HW_SOC_SINGLECORE_DEVICE
    bool
    default y

# device related

config MCUX_HW_DEVICE_ID_MCXA276
    bool

choice MCUX_HW_DEVICE_PART_MCXA276
    prompt "Device MCXA276 Part"
    config MCUX_HW_DEVICE_PART_MCXA276VLQ
    bool "Device part MCXA276VLQ"
    select MCUX_HW_DEVICE_ID_MCXA276
    config MCUX_HW_DEVICE_PART_MCXA276VLL
    bool "Device part MCXA276VLL"
    select MCUX_HW_DEVICE_ID_MCXA276
    config MCUX_HW_DEVICE_PART_MCXA276VLH
    bool "Device part MCXA276VLH"
    select MCUX_HW_DEVICE_ID_MCXA276
    config MCUX_HW_DEVICE_PART_MCXA276VPN
    bool "Device part MCXA276VPN"
    select MCUX_HW_DEVICE_ID_MCXA276
endchoice

config MCUX_HW_DEVICE_ID
    string
    default "MCXA276" if MCUX_HW_DEVICE_ID_MCXA276

config MCUX_HW_DEVICE_PART
    string
    default "MCXA276VLQ" if MCUX_HW_DEVICE_PART_MCXA276VLQ
    default "MCXA276VLL" if MCUX_HW_DEVICE_PART_MCXA276VLL
    default "MCXA276VLH" if MCUX_HW_DEVICE_PART_MCXA276VLH
    default "MCXA276VPN" if MCUX_HW_DEVICE_PART_MCXA276VPN

# For chipmodel generated files
config MCUX_TOOLCHAIN_LINKER_DEVICE_PREFIX
    string
    default "MCXA276" if MCUX_HW_DEVICE_ID_MCXA276

config MCUX_TOOLCHAIN_MCUX_STARTUP
    string
    default "mcxa276"

# Toolchain related

config MCUX_TOOLCHAIN_IAR_CPU_IDENTIFIER
    string
    default "MCXA276" if MCUX_HW_DEVICE_ID_MCXA276

config MCUX_TOOLCHAIN_MDK_CPU_IDENTIFIER
    string
    default "MCXA276VLQ" if MCUX_HW_DEVICE_PART_MCXA276VLQ
    default "MCXA276VLL" if MCUX_HW_DEVICE_PART_MCXA276VLL
    default "MCXA276VLH" if MCUX_HW_DEVICE_PART_MCXA276VLH
    default "MCXA276VPN" if MCUX_HW_DEVICE_PART_MCXA276VPN

config MCUX_TOOLCHAIN_JLINK_CPU_IDENTIFIER
    string
    default "MCXA276" if MCUX_HW_DEVICE_ID_MCXA276

# ip information
config MCUX_HW_IP_DriverType_AOI
    bool
    default y
    depends on MCUX_HW_DEVICE_ID_MCXA276

config MCUX_HW_IP_DriverType_CDOG
    bool
    default y
    depends on MCUX_HW_DEVICE_ID_MCXA276

config MCUX_HW_IP_DriverType_CRC
    bool
    default y
    depends on MCUX_HW_DEVICE_ID_MCXA276

config MCUX_HW_IP_DriverType_CTIMER
    bool
    default y
    depends on MCUX_HW_DEVICE_ID_MCXA276

config MCUX_HW_IP_DriverType_DBGMB
    bool
    default y
    depends on MCUX_HW_DEVICE_ID_MCXA276

config MCUX_HW_IP_DriverType_DIGTMP
    bool
    default y
    depends on MCUX_HW_DEVICE_ID_MCXA276

config MCUX_HW_IP_DriverType_EDMA3
    bool
    default y
    depends on MCUX_HW_DEVICE_ID_MCXA276

config MCUX_HW_IP_DriverType_EIM
    bool
    default y
    depends on MCUX_HW_DEVICE_ID_MCXA276

config MCUX_HW_IP_DriverType_EQDC
    bool
    default y
    depends on MCUX_HW_DEVICE_ID_MCXA276

config MCUX_HW_IP_DriverType_ERM
    bool
    default y
    depends on MCUX_HW_DEVICE_ID_MCXA276

config MCUX_HW_IP_DriverType_FLEXCAN
    bool
    default y
    depends on MCUX_HW_DEVICE_ID_MCXA276

config MCUX_HW_IP_DriverType_FLEXIO
    bool
    default y
    depends on MCUX_HW_DEVICE_ID_MCXA276

config MCUX_HW_IP_DriverType_FMC
    bool
    default y
    depends on MCUX_HW_DEVICE_ID_MCXA276

config MCUX_HW_IP_DriverType_FMU
    bool
    default y
    depends on MCUX_HW_DEVICE_ID_MCXA276

config MCUX_HW_IP_DriverType_FREQME
    bool
    default y
    depends on MCUX_HW_DEVICE_ID_MCXA276

config MCUX_HW_IP_DriverType_GLIKEY
    bool
    default y
    depends on MCUX_HW_DEVICE_ID_MCXA276

config MCUX_HW_IP_DriverType_GPIO
    bool
    default y
    depends on MCUX_HW_DEVICE_ID_MCXA276

config MCUX_HW_IP_DriverType_I3C
    bool
    default y
    depends on MCUX_HW_DEVICE_ID_MCXA276

config MCUX_HW_IP_DriverType_INPUTMUX
    bool
    default y
    depends on MCUX_HW_DEVICE_ID_MCXA276

config MCUX_HW_IP_DriverType_LPADC
    bool
    default y
    depends on MCUX_HW_DEVICE_ID_MCXA276

config MCUX_HW_IP_DriverType_LPCMP
    bool
    default y
    depends on MCUX_HW_DEVICE_ID_MCXA276

config MCUX_HW_IP_DriverType_LPC_SYSCON
    bool
    default y
    depends on MCUX_HW_DEVICE_ID_MCXA276

config MCUX_HW_IP_DriverType_LPDAC
    bool
    default y
    depends on MCUX_HW_DEVICE_ID_MCXA276

config MCUX_HW_IP_DriverType_LPI2C
    bool
    default y
    depends on MCUX_HW_DEVICE_ID_MCXA276

config MCUX_HW_IP_DriverType_LPSPI
    bool
    default y
    depends on MCUX_HW_DEVICE_ID_MCXA276

config MCUX_HW_IP_DriverType_LPTMR
    bool
    default y
    depends on MCUX_HW_DEVICE_ID_MCXA276

config MCUX_HW_IP_DriverType_LPUART
    bool
    default y
    depends on MCUX_HW_DEVICE_ID_MCXA276

config MCUX_HW_IP_DriverType_MAU
    bool
    default y
    depends on MCUX_HW_DEVICE_ID_MCXA276

config MCUX_HW_IP_DriverType_MCX_CMC
    bool
    default y
    depends on MCUX_HW_DEVICE_ID_MCXA276

config MCUX_HW_IP_DriverType_MCX_SPC
    bool
    default y
    depends on MCUX_HW_DEVICE_ID_MCXA276

config MCUX_HW_IP_DriverType_MCX_VBAT
    bool
    default y
    depends on MCUX_HW_DEVICE_ID_MCXA276

config MCUX_HW_IP_DriverType_MRCC
    bool
    default y
    depends on MCUX_HW_DEVICE_ID_MCXA276

config MCUX_HW_IP_DriverType_OPAMP_FAST
    bool
    default y
    depends on MCUX_HW_DEVICE_ID_MCXA276

config MCUX_HW_IP_DriverType_OSTIMER
    bool
    default y
    depends on MCUX_HW_DEVICE_ID_MCXA276

config MCUX_HW_IP_DriverType_PORT
    bool
    default y
    depends on MCUX_HW_DEVICE_ID_MCXA276

config MCUX_HW_IP_DriverType_PKC
    bool
    default y
    depends on MCUX_HW_DEVICE_ID_MCXA276

config MCUX_HW_IP_DriverType_PWM
    bool
    default y
    depends on MCUX_HW_DEVICE_ID_MCXA276

config MCUX_HW_IP_DriverType_SRTC
    bool
    default y
    depends on MCUX_HW_DEVICE_ID_MCXA276

config MCUX_HW_IP_DriverType_SCG
    bool
    default y
    depends on MCUX_HW_DEVICE_ID_MCXA276

config MCUX_HW_IP_DriverType_SGI
    bool
    default y
    depends on MCUX_HW_DEVICE_ID_MCXA276

config MCUX_HW_IP_DriverType_SLCD
    bool
    default y
    depends on MCUX_HW_DEVICE_ID_MCXA276

config MCUX_HW_IP_DriverType_TRDC_1
    bool
    default y
    depends on MCUX_HW_DEVICE_ID_MCXA276

config MCUX_HW_IP_DriverType_USB_HOST_DEVICE_KHCI
    bool
    default y
    depends on MCUX_HW_DEVICE_ID_MCXA276

config MCUX_HW_IP_DriverType_UTICK
    bool
    default y
    depends on MCUX_HW_DEVICE_ID_MCXA276

config MCUX_HW_IP_DriverType_WAKETIMER
    bool
    default y
    depends on MCUX_HW_DEVICE_ID_MCXA276

config MCUX_HW_IP_DriverType_WUU
    bool
    default y
    depends on MCUX_HW_DEVICE_ID_MCXA276

config MCUX_HW_IP_DriverType_WWDT
    bool
    default y
    depends on MCUX_HW_DEVICE_ID_MCXA276

config MCUX_HW_IP_DriverType_TRNG
    bool
    default y
    depends on MCUX_HW_DEVICE_ID_MCXA276
```

## mcux/mcux-sdk-ng/devices/MCX/MCXC/MCXC041/Kconfig
```kconfig
# Copyright 2024 NXP
# All rights reserved.
#
# SPDX-License-Identifier: BSD-3-Clause

rsource "Kconfig.chip"
rsource "drivers/Kconfig"
rsource "../../../arm/Kconfig.common"
rsource "Kconfig.defconfig"

## Project segment and component dependency data
config MCUX_HW_DEVICE_MCXC041
    # bool "Device MCXC041 Configuration"
    bool
    default y

    # component dependency
    select MCUX_COMPONENT_component.lpuart_adapter if MCUX_COMPONENT_component.serial_manager_uart
    select MCUX_COMPONENT_component.lpuart_adapter if MCUX_COMPONENT_utility.debug_console_lite
```

## mcux/mcux-sdk-ng/devices/MCX/MCXC/MCXC242/Kconfig
```kconfig
# Copyright 2024 NXP
# All rights reserved.
#
# SPDX-License-Identifier: BSD-3-Clause

rsource "Kconfig.chip"
rsource "drivers/Kconfig"
rsource "../../../arm/Kconfig.common"
rsource "Kconfig.defconfig"

## Project segment and component dependency data
config MCUX_HW_DEVICE_MCXC242
    # bool "Device MCXC242 Configuration"
    bool
    default y

    # component dependency
    select MCUX_COMPONENT_driver.dma if MCUX_COMPONENT_device.RTE
    select MCUX_COMPONENT_driver.dmamux if MCUX_COMPONENT_device.RTE
    select MCUX_COMPONENT_component.lpuart_adapter if MCUX_COMPONENT_component.serial_manager_uart
    select MCUX_COMPONENT_component.lpuart_adapter if MCUX_COMPONENT_utility.debug_console_lite
    select MCUX_COMPONENT_driver.spi_dma if MCUX_COMPONENT_driver.cmsis_spi
    select MCUX_COMPONENT_driver.i2c_dma if MCUX_COMPONENT_driver.cmsis_i2c
    select MCUX_COMPONENT_driver.lpuart_dma if MCUX_COMPONENT_driver.cmsis_lpuart
    select MCUX_COMPONENT_driver.uart_dma if MCUX_COMPONENT_driver.cmsis_uart
    select MCUX_COMPONENT_driver.dma if MCUX_COMPONENT_driver.flexio_i2s_dma
    select MCUX_COMPONENT_driver.dma if MCUX_COMPONENT_driver.flexio_spi_dma
    select MCUX_COMPONENT_driver.dma if MCUX_COMPONENT_driver.flexio_uart_dma
    select MCUX_COMPONENT_driver.dma if MCUX_COMPONENT_driver.i2c_dma
    select MCUX_COMPONENT_driver.dma if MCUX_COMPONENT_driver.lpuart_dma
    select MCUX_COMPONENT_driver.dma if MCUX_COMPONENT_driver.spi_dma
    select MCUX_COMPONENT_driver.dma if MCUX_COMPONENT_driver.uart_dma
```

## mcux/mcux-sdk-ng/devices/MCX/MCXC/MCXC244/Kconfig.chip
```kconfig
# Copyright 2024 NXP
#
# SPDX-License-Identifier: BSD-3-Clause

# core related
config MCUX_HW_CORE
    string
    default "cm0p"

config MCUX_HW_CORE_CM0P
    bool
    default y

config MCUX_HW_CORE_ID
    string
    default "core0"

config MCUX_HW_CORE_ID_CORE0
    bool
    default y

config MCUX_HW_DEVICE_CORE
    string
    default "MCXC244"

config MCUX_HW_FPU
    string
    default "NO_FPU"

config MCUX_HW_FPU_TYPE
    string
    default "no_fpu"

config MCUX_HW_NO_FPU
    bool
    default y

config MCUX_HW_INT_PRIO_BITS
    int
    default 2

config MCUX_HW_SOC_SERIES_MCX
    bool
    default y

config MCUX_HW_SOC_SINGLECORE_DEVICE
    bool
    default y

# device related

config MCUX_HW_DEVICE_ID_MCXC244
    bool

choice MCUX_HW_DEVICE_PART_MCXC244
    prompt "Device MCXC244 Part"
    config MCUX_HW_DEVICE_PART_MCXC244VFT
    bool "Device part MCXC244VFT"
    select MCUX_HW_DEVICE_ID_MCXC244
    config MCUX_HW_DEVICE_PART_MCXC244VFM
    bool "Device part MCXC244VFM"
    select MCUX_HW_DEVICE_ID_MCXC244
endchoice

config MCUX_HW_DEVICE_ID
    string
    default "MCXC244" if MCUX_HW_DEVICE_ID_MCXC244

config MCUX_HW_DEVICE_PART
    string
    default "MCXC244VFT" if MCUX_HW_DEVICE_PART_MCXC244VFT
    default "MCXC244VFM" if MCUX_HW_DEVICE_PART_MCXC244VFM

# For chipmodel generated files
config MCUX_TOOLCHAIN_LINKER_DEVICE_PREFIX
    string
    default "MCXC244" if MCUX_HW_DEVICE_ID_MCXC244

config MCUX_TOOLCHAIN_MCUX_STARTUP
    string
    default "mcxc244"

# Toolchain related

config MCUX_TOOLCHAIN_IAR_CPU_IDENTIFIER
    string
    default "MCXC244" if MCUX_HW_DEVICE_ID_MCXC244

config MCUX_TOOLCHAIN_MDK_CPU_IDENTIFIER
    string
    default "MCXC244VFT" if MCUX_HW_DEVICE_PART_MCXC244VFT
    default "MCXC244VFM" if MCUX_HW_DEVICE_PART_MCXC244VFM

config MCUX_TOOLCHAIN_JLINK_CPU_IDENTIFIER
    string
    default "MCXC244" if MCUX_HW_DEVICE_ID_MCXC244

# ip information
config MCUX_HW_IP_DriverType_ADC16
    bool
    default y
    depends on MCUX_HW_DEVICE_ID_MCXC244

config MCUX_HW_IP_DriverType_CMP
    bool
    default y
    depends on MCUX_HW_DEVICE_ID_MCXC244

config MCUX_HW_IP_DriverType_COP
    bool
    default y
    depends on MCUX_HW_DEVICE_ID_MCXC244

config MCUX_HW_IP_DriverType_DAC
    bool
    default y
    depends on MCUX_HW_DEVICE_ID_MCXC244

config MCUX_HW_IP_DriverType_DMA
    bool
    default y
    depends on MCUX_HW_DEVICE_ID_MCXC244

config MCUX_HW_IP_DriverType_DMAMUX
    bool
    default y
    depends on MCUX_HW_DEVICE_ID_MCXC244

config MCUX_HW_IP_DriverType_FGPIO
    bool
    default y
    depends on MCUX_HW_DEVICE_ID_MCXC244

config MCUX_HW_IP_DriverType_FLEXIO
    bool
    default y
    depends on MCUX_HW_DEVICE_ID_MCXC244

config MCUX_HW_IP_DriverType_FTFA
    bool
    default y
    depends on MCUX_HW_DEVICE_ID_MCXC244

config MCUX_HW_IP_DriverType_FTFE
    bool
    default y
    depends on MCUX_HW_DEVICE_ID_MCXC244

config MCUX_HW_IP_DriverType_GPIO
    bool
    default y
    depends on MCUX_HW_DEVICE_ID_MCXC244

config MCUX_HW_IP_DriverType_I2C
    bool
    default y
    depends on MCUX_HW_DEVICE_ID_MCXC244

config MCUX_HW_IP_DriverType_LLWU
    bool
    default y
    depends on MCUX_HW_DEVICE_ID_MCXC244

config MCUX_HW_IP_DriverType_LPTMR
    bool
    default y
    depends on MCUX_HW_DEVICE_ID_MCXC244

config MCUX_HW_IP_DriverType_LPUART
    bool
    default y
    depends on MCUX_HW_DEVICE_ID_MCXC244

config MCUX_HW_IP_DriverType_MCGLITE
    bool
    default y
    depends on MCUX_HW_DEVICE_ID_MCXC244

config MCUX_HW_IP_DriverType_MCM
    bool
    default y
    depends on MCUX_HW_DEVICE_ID_MCXC244

config MCUX_HW_IP_DriverType_MTB
    bool
    default y
    depends on MCUX_HW_DEVICE_ID_MCXC244

config MCUX_HW_IP_DriverType_MTBDWT
    bool
    default y
    depends on MCUX_HW_DEVICE_ID_MCXC244

config MCUX_HW_IP_DriverType_NV
    bool
    default y
    depends on MCUX_HW_DEVICE_ID_MCXC244

config MCUX_HW_IP_DriverType_OSC
    bool
    default y
    depends on MCUX_HW_DEVICE_ID_MCXC244

config MCUX_HW_IP_DriverType_PIT
    bool
    default y
    depends on MCUX_HW_DEVICE_ID_MCXC244

config MCUX_HW_IP_DriverType_PMC
    bool
    default y
    depends on MCUX_HW_DEVICE_ID_MCXC244

config MCUX_HW_IP_DriverType_PORT
    bool
    default y
    depends on MCUX_HW_DEVICE_ID_MCXC244

config MCUX_HW_IP_DriverType_RCM
    bool
    default y
    depends on MCUX_HW_DEVICE_ID_MCXC244

config MCUX_HW_IP_DriverType_RFSYS
    bool
    default y
    depends on MCUX_HW_DEVICE_ID_MCXC244

config MCUX_HW_IP_DriverType_ROM
    bool
    default y
    depends on MCUX_HW_DEVICE_ID_MCXC244

config MCUX_HW_IP_DriverType_SAI
    bool
    default y
    depends on MCUX_HW_DEVICE_ID_MCXC244

config MCUX_HW_IP_DriverType_SIM
    bool
    default y
    depends on MCUX_HW_DEVICE_ID_MCXC244

config MCUX_HW_IP_DriverType_SIM_COP
    bool
    default y
    depends on MCUX_HW_DEVICE_ID_MCXC244

config MCUX_HW_IP_DriverType_SMC
    bool
    default y
    depends on MCUX_HW_DEVICE_ID_MCXC244

config MCUX_HW_IP_DriverType_SPI
    bool
    default y
    depends on MCUX_HW_DEVICE_ID_MCXC244

config MCUX_HW_IP_DriverType_SRTC
    bool
    default y
    depends on MCUX_HW_DEVICE_ID_MCXC244

config MCUX_HW_IP_DriverType_TPM
    bool
    default y
    depends on MCUX_HW_DEVICE_ID_MCXC244

config MCUX_HW_IP_DriverType_UART_ISO7816
    bool
    default y
    depends on MCUX_HW_DEVICE_ID_MCXC244

config MCUX_HW_IP_DriverType_USB_DEVICE_KHCI
    bool
    default y
    depends on MCUX_HW_DEVICE_ID_MCXC244

config MCUX_HW_IP_DriverType_VREF
    bool
    default y
    depends on MCUX_HW_DEVICE_ID_MCXC244
```

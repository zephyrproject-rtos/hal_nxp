## mcux/mcux-sdk-ng/devices/LPC/LPC5500/LPC55S66/cm33_core1/Kconfig.chip
```kconfig
# Copyright 2024 NXP
# All rights reserved.
#
# SPDX-License-Identifier: BSD-3-Clause
# core related
config MCUX_HW_CORE
    string
    default "cm33"

config MCUX_HW_CORE_CM33
    bool
    default y

config MCUX_HW_CORE_ID
    string
    default "cm33_core1"

config MCUX_HW_CORE_ID_CM33_CORE1
    bool
    default y

config MCUX_HW_DEVICE_CORE
    string
    default "LPC55S66_cm33_core1"

config MCUX_HW_FPU
    string
    default "NO_FPU"

config MCUX_HW_FPU_TYPE
    string
    default "no_fpu"

config MCUX_HW_NO_FPU
    bool
    default y

config MCUX_HW_INT_PRIO_BITS
    int
    default 3

config MCUX_HW_DSP
    bool
    default n

config MCUX_HW_SAU
    bool
    default n

config MCUX_HW_SOC_SERIES_LPC
    bool
    default y

# For chipmodel generated files
config MCUX_TOOLCHAIN_LINKER_DEVICE_PREFIX
    string
    default "LPC55S66_cm33_core1" if MCUX_HW_DEVICE_ID_LPC55S66

config MCUX_TOOLCHAIN_MCUX_STARTUP
    string
    default "lpc55s66_cm33_core1"

# Toolchain related

config MCUX_TOOLCHAIN_IAR_CPU_IDENTIFIER
    string
    default "LPC55S66_core1" if MCUX_HW_DEVICE_ID_LPC55S66

config MCUX_TOOLCHAIN_MDK_CPU_IDENTIFIER
    string
    default "LPC55S66JBD100:cm33_core1" if MCUX_HW_DEVICE_PART_LPC55S66JBD100
    default "LPC55S66JEV98:cm33_core1" if MCUX_HW_DEVICE_PART_LPC55S66JEV98
    default "LPC55S66JBD64:cm33_core1" if MCUX_HW_DEVICE_PART_LPC55S66JBD64

config MCUX_TOOLCHAIN_JLINK_CPU_IDENTIFIER
    string
    default "LPC55S66_M33_1" if MCUX_HW_DEVICE_ID_LPC55S66
```

## mcux/mcux-sdk-ng/devices/LPC/LPC5500/LPC55S69/Kconfig
```kconfig
# Copyright 2024 NXP
# All rights reserved.
#
# SPDX-License-Identifier: BSD-3-Clause
rsource "${core_id}/Kconfig"

rsource "Kconfig.chip"
rsource "drivers/Kconfig"
rsource "../../../arm/Kconfig.common"
rsource "Kconfig.defconfig"

## Project segment and component dependency data
config MCUX_HW_DEVICE_LPC55S69
    # bool "Device LPC55S69 Configuration"
    bool
    default y

    # component dependency
    select MCUX_COMPONENT_driver.power if MCUX_COMPONENT_driver.clock
    select MCUX_COMPONENT_driver.lpc_dma if MCUX_COMPONENT_device.RTE
    select MCUX_COMPONENT_component.usart_adapter if MCUX_COMPONENT_component.serial_manager_uart
    select MCUX_COMPONENT_component.usart_adapter if MCUX_COMPONENT_utility.debug_console_lite
    select MCUX_COMPONENT_driver.iap1 if MCUX_COMPONENT_driver.prince
    select MCUX_COMPONENT_driver.puf if MCUX_COMPONENT_driver.prince
    select MCUX_COMPONENT_driver.lpc_dma if MCUX_COMPONENT_driver.flexcomm_i2c_dma
    select MCUX_COMPONENT_driver.lpc_dma if MCUX_COMPONENT_driver.flexcomm_i2s_dma
    select MCUX_COMPONENT_driver.lpc_dma if MCUX_COMPONENT_driver.flexcomm_spi_dma
    select MCUX_COMPONENT_driver.lpc_dma if MCUX_COMPONENT_driver.flexcomm_usart_dma
```

## mcux/mcux-sdk-ng/devices/LPC/LPC5500/LPC55S69/cm33_core0/Kconfig.chip
```kconfig
# Copyright 2024 NXP
# All rights reserved.
#
# SPDX-License-Identifier: BSD-3-Clause
# core related
config MCUX_HW_CORE
    string
    default "cm33"

config MCUX_HW_CORE_CM33
    bool
    default y

config MCUX_HW_CORE_ID
    string
    default "cm33_core0"

config MCUX_HW_CORE_ID_CM33_CORE0
    bool
    default y

config MCUX_HW_DEVICE_CORE
    string
    default "LPC55S69_cm33_core0"

config MCUX_HW_FPU
    string
    default "SP_FPU"

config MCUX_HW_FPU_TYPE
    string
    default "fpv5_sp"

config MCUX_HW_FPV5_SP
    bool
    default y

config MCUX_HW_INT_PRIO_BITS
    int
    default 3

config MCUX_HW_DSP
    bool
    default y

config MCUX_HW_SAU
    bool
    default y

config MCUX_HW_SOC_SERIES_LPC
    bool
    default y

# For chipmodel generated files
config MCUX_TOOLCHAIN_LINKER_DEVICE_PREFIX
    string
    default "LPC55S69_cm33_core0" if MCUX_HW_DEVICE_ID_LPC55S69

config MCUX_TOOLCHAIN_MCUX_STARTUP
    string
    default "lpc55s69_cm33_core0"

# Toolchain related

config MCUX_TOOLCHAIN_IAR_CPU_IDENTIFIER
    string
    default "LPC55S69_core0" if MCUX_HW_DEVICE_ID_LPC55S69

config MCUX_TOOLCHAIN_MDK_CPU_IDENTIFIER
    string
    default "LPC55S69JBD100:cm33_core0" if MCUX_HW_DEVICE_PART_LPC55S69JBD100
    default "LPC55S69JEV98:cm33_core0" if MCUX_HW_DEVICE_PART_LPC55S69JEV98
    default "LPC55S69JBD64:cm33_core0" if MCUX_HW_DEVICE_PART_LPC55S69JBD64
    default "LPC55S69JEV59:cm33_core0" if MCUX_HW_DEVICE_PART_LPC55S69JEV59

config MCUX_TOOLCHAIN_JLINK_CPU_IDENTIFIER
    string
    default "LPC55S69_M33_0" if MCUX_HW_DEVICE_ID_LPC55S69
```

## mcux/mcux-sdk-ng/devices/LPC/LPC800/LPC802/Kconfig
```kconfig
# Copyright 2024 NXP
# All rights reserved.
#
# SPDX-License-Identifier: BSD-3-Clause

rsource "Kconfig.chip"
rsource "drivers/Kconfig"
rsource "../../../arm/Kconfig.common"
rsource "Kconfig.defconfig"

## Project segment and component dependency data
config MCUX_HW_DEVICE_LPC802
    # bool "Device LPC802 Configuration"
    bool
    default y

    # component dependency
    select MCUX_COMPONENT_driver.romapi if MCUX_COMPONENT_driver.clock
    select MCUX_COMPONENT_driver.syscon if MCUX_COMPONENT_component.lpc_gpio_adapter
    select MCUX_COMPONENT_component.miniusart_adapter if MCUX_COMPONENT_utility.debug_console_lite
```

## mcux/mcux-sdk-ng/devices/LPC/LPC800/LPC802/Kconfig.chip
```kconfig
# Copyright 2024 NXP
#
# SPDX-License-Identifier: BSD-3-Clause

# core related
config MCUX_HW_CORE
    string
    default "cm0p"

config MCUX_HW_CORE_CM0P
    bool
    default y

config MCUX_HW_CORE_ID
    string
    default "core0"

config MCUX_HW_CORE_ID_CORE0
    bool
    default y

config MCUX_HW_DEVICE_CORE
    string
    default "LPC802"

config MCUX_HW_FPU
    string
    default "NO_FPU"

config MCUX_HW_FPU_TYPE
    string
    default "no_fpu"

config MCUX_HW_NO_FPU
    bool
    default y

config MCUX_HW_INT_PRIO_BITS
    int
    default 2

config MCUX_HW_SOC_SERIES_LPC
    bool
    default y

config MCUX_HW_SOC_SINGLECORE_DEVICE
    bool
    default y

# device related

config MCUX_HW_DEVICE_ID_LPC802
    bool

choice
    prompt "Device LPC802 Part"
    config MCUX_HW_DEVICE_PART_LPC802M011JDH20
    bool "Device part LPC802M011JDH20"
    select MCUX_HW_DEVICE_ID_LPC802
    config MCUX_HW_DEVICE_PART_LPC802M001JDH16
    bool "Device part LPC802M001JDH16"
    select MCUX_HW_DEVICE_ID_LPC802
    config MCUX_HW_DEVICE_PART_LPC802M001JDH20
    bool "Device part LPC802M001JDH20"
    select MCUX_HW_DEVICE_ID_LPC802
    config MCUX_HW_DEVICE_PART_LPC802M001JHI33
    bool "Device part LPC802M001JHI33"
    select MCUX_HW_DEVICE_ID_LPC802
    config MCUX_HW_DEVICE_PART_LPC802UK
    bool "Device part LPC802UK"
    select MCUX_HW_DEVICE_ID_LPC802
endchoice

config MCUX_HW_DEVICE_ID
    string
    default "LPC802" if MCUX_HW_DEVICE_ID_LPC802

config MCUX_HW_DEVICE_PART
    string
    default "LPC802M011JDH20" if MCUX_HW_DEVICE_PART_LPC802M011JDH20
    default "LPC802M001JDH16" if MCUX_HW_DEVICE_PART_LPC802M001JDH16
    default "LPC802M001JDH20" if MCUX_HW_DEVICE_PART_LPC802M001JDH20
    default "LPC802M001JHI33" if MCUX_HW_DEVICE_PART_LPC802M001JHI33
    default "LPC802UK" if MCUX_HW_DEVICE_PART_LPC802UK

# For chipmodel generated files
config MCUX_TOOLCHAIN_LINKER_DEVICE_PREFIX
    string
    default "LPC802" if MCUX_HW_DEVICE_ID_LPC802

config MCUX_TOOLCHAIN_MCUX_STARTUP
    string
    default "lpc802"

# Toolchain related

config MCUX_TOOLCHAIN_IAR_CPU_IDENTIFIER
    string
    default "LPC802M001" if MCUX_HW_DEVICE_ID_LPC802

config MCUX_TOOLCHAIN_MDK_CPU_IDENTIFIER
    string
    default "LPC802M011JDH20" if MCUX_HW_DEVICE_PART_LPC802M011JDH20
    default "LPC802M001JDH16" if MCUX_HW_DEVICE_PART_LPC802M001JDH16
    default "LPC802M001JDH20" if MCUX_HW_DEVICE_PART_LPC802M001JDH20
    default "LPC802M001JHI33" if MCUX_HW_DEVICE_PART_LPC802M001JHI33
    default "LPC802UK" if MCUX_HW_DEVICE_PART_LPC802UK

config MCUX_TOOLCHAIN_JLINK_CPU_IDENTIFIER
    string
    default "LPC802" if MCUX_HW_DEVICE_ID_LPC802

# ip information
config MCUX_HW_IP_DriverType_ACOMP
    bool
    default y
    depends on MCUX_HW_DEVICE_ID_LPC802

config MCUX_HW_IP_DriverType_ADC12_5M
    bool
    default y
    depends on MCUX_HW_DEVICE_ID_LPC802

config MCUX_HW_IP_DriverType_CTIMER
    bool
    default y
    depends on MCUX_HW_DEVICE_ID_LPC802

config MCUX_HW_IP_DriverType_GPIO_PORT
    bool
    default y
    depends on MCUX_HW_DEVICE_ID_LPC802

config MCUX_HW_IP_DriverType_I2C_SERIALIF
    bool
    default y
    depends on MCUX_HW_DEVICE_ID_LPC802

config MCUX_HW_IP_DriverType_IAP
    bool
    default y
    depends on MCUX_HW_DEVICE_ID_LPC802

config MCUX_HW_IP_DriverType_IOCON_LITE
    bool
    default y
    depends on MCUX_HW_DEVICE_ID_LPC802

config MCUX_HW_IP_DriverType_LPC_CLOCK
    bool
    default y
    depends on MCUX_HW_DEVICE_ID_LPC802

config MCUX_HW_IP_DriverType_LPC_NVIC
    bool
    default y
    depends on MCUX_HW_DEVICE_ID_LPC802

config MCUX_HW_IP_DriverType_LPC_PMU
    bool
    default y
    depends on MCUX_HW_DEVICE_ID_LPC802

config MCUX_HW_IP_DriverType_MCO_CRC
    bool
    default y
    depends on MCUX_HW_DEVICE_ID_LPC802

config MCUX_HW_IP_DriverType_MINI_SPI
    bool
    default y
    depends on MCUX_HW_DEVICE_ID_LPC802

config MCUX_HW_IP_DriverType_MINI_USART
    bool
    default y
    depends on MCUX_HW_DEVICE_ID_LPC802

config MCUX_HW_IP_DriverType_MRT
    bool
    default y
    depends on MCUX_HW_DEVICE_ID_LPC802

config MCUX_HW_IP_DriverType_PINT
    bool
    default y
    depends on MCUX_HW_DEVICE_ID_LPC802

config MCUX_HW_IP_DriverType_SWM
    bool
    default y
    depends on MCUX_HW_DEVICE_ID_LPC802

config MCUX_HW_IP_DriverType_SYSCON
    bool
    default y
    depends on MCUX_HW_DEVICE_ID_LPC802

config MCUX_HW_IP_DriverType_WKT
    bool
    default y
    depends on MCUX_HW_DEVICE_ID_LPC802

config MCUX_HW_IP_DriverType_WWDT
    bool
    default y
    depends on MCUX_HW_DEVICE_ID_LPC802
```

## mcux/mcux-sdk-ng/devices/LPC/LPC800/LPC804/Kconfig.chip
```kconfig
# Copyright 2024 NXP
#
# SPDX-License-Identifier: BSD-3-Clause

# core related
config MCUX_HW_CORE
    string
    default "cm0p"

config MCUX_HW_CORE_CM0P
    bool
    default y

config MCUX_HW_CORE_ID
    string
    default "core0"

config MCUX_HW_CORE_ID_CORE0
    bool
    default y

config MCUX_HW_DEVICE_CORE
    string
    default "LPC804"

config MCUX_HW_FPU
    string
    default "NO_FPU"

config MCUX_HW_FPU_TYPE
    string
    default "no_fpu"

config MCUX_HW_NO_FPU
    bool
    default y

config MCUX_HW_INT_PRIO_BITS
    int
    default 2

config MCUX_HW_SOC_SERIES_LPC
    bool
    default y

config MCUX_HW_SOC_SINGLECORE_DEVICE
    bool
    default y

# device related

config MCUX_HW_DEVICE_ID_LPC804
    bool

choice MCUX_HW_DEVICE_PART_LPC804
    prompt "Device LPC804 Part"
    config MCUX_HW_DEVICE_PART_LPC804M101JDH24
    bool "Device part LPC804M101JDH24"
    select MCUX_HW_DEVICE_ID_LPC804
    config MCUX_HW_DEVICE_PART_LPC804M101JDH20
    bool "Device part LPC804M101JDH20"
    select MCUX_HW_DEVICE_ID_LPC804
    config MCUX_HW_DEVICE_PART_LPC804M111JDH24
    bool "Device part LPC804M111JDH24"
    select MCUX_HW_DEVICE_ID_LPC804
    config MCUX_HW_DEVICE_PART_LPC804M101JHI33
    bool "Device part LPC804M101JHI33"
    select MCUX_HW_DEVICE_ID_LPC804
    config MCUX_HW_DEVICE_PART_LPC804UK
    bool "Device part LPC804UK"
    select MCUX_HW_DEVICE_ID_LPC804
endchoice

config MCUX_HW_DEVICE_ID
    string
    default "LPC804" if MCUX_HW_DEVICE_ID_LPC804

config MCUX_HW_DEVICE_PART
    string
    default "LPC804M101JDH24" if MCUX_HW_DEVICE_PART_LPC804M101JDH24
    default "LPC804M101JDH20" if MCUX_HW_DEVICE_PART_LPC804M101JDH20
    default "LPC804M111JDH24" if MCUX_HW_DEVICE_PART_LPC804M111JDH24
    default "LPC804M101JHI33" if MCUX_HW_DEVICE_PART_LPC804M101JHI33
    default "LPC804UK" if MCUX_HW_DEVICE_PART_LPC804UK

# For chipmodel generated files
config MCUX_TOOLCHAIN_LINKER_DEVICE_PREFIX
    string
    default "LPC804" if MCUX_HW_DEVICE_ID_LPC804

config MCUX_TOOLCHAIN_MCUX_STARTUP
    string
    default "lpc804"

# Toolchain related

config MCUX_TOOLCHAIN_IAR_CPU_IDENTIFIER
    string
    default "LPC804M101" if MCUX_HW_DEVICE_ID_LPC804

config MCUX_TOOLCHAIN_MDK_CPU_IDENTIFIER
    string
    default "LPC804M101JDH24" if MCUX_HW_DEVICE_PART_LPC804M101JDH24
    default "LPC804M101JDH20" if MCUX_HW_DEVICE_PART_LPC804M101JDH20
    default "LPC804M111JDH24" if MCUX_HW_DEVICE_PART_LPC804M111JDH24
    default "LPC804M101JHI33" if MCUX_HW_DEVICE_PART_LPC804M101JHI33
    default "LPC804UK" if MCUX_HW_DEVICE_PART_LPC804UK

config MCUX_TOOLCHAIN_JLINK_CPU_IDENTIFIER
    string
    default "LPC804" if MCUX_HW_DEVICE_ID_LPC804

# ip information
config MCUX_HW_IP_DriverType_ACOMP
    bool
    default y
    depends on MCUX_HW_DEVICE_ID_LPC804

config MCUX_HW_IP_DriverType_ADC12_5M
    bool
    default y
    depends on MCUX_HW_DEVICE_ID_LPC804

config MCUX_HW_IP_DriverType_CAPT
    bool
    default y
    depends on MCUX_HW_DEVICE_ID_LPC804

config MCUX_HW_IP_DriverType_CTIMER
    bool
    default y
    depends on MCUX_HW_DEVICE_ID_LPC804

config MCUX_HW_IP_DriverType_DAC10
    bool
    default y
    depends on MCUX_HW_DEVICE_ID_LPC804

config MCUX_HW_IP_DriverType_GPIO_PORT
    bool
    default y
    depends on MCUX_HW_DEVICE_ID_LPC804

config MCUX_HW_IP_DriverType_I2C_SERIALIF
    bool
    default y
    depends on MCUX_HW_DEVICE_ID_LPC804

config MCUX_HW_IP_DriverType_IAP
    bool
    default y
    depends on MCUX_HW_DEVICE_ID_LPC804

config MCUX_HW_IP_DriverType_IOCON_LITE
    bool
    default y
    depends on MCUX_HW_DEVICE_ID_LPC804

config MCUX_HW_IP_DriverType_LPC_CLOCK
    bool
    default y
    depends on MCUX_HW_DEVICE_ID_LPC804

config MCUX_HW_IP_DriverType_LPC_NVIC
    bool
    default y
    depends on MCUX_HW_DEVICE_ID_LPC804

config MCUX_HW_IP_DriverType_LPC_PMU
    bool
    default y
    depends on MCUX_HW_DEVICE_ID_LPC804

config MCUX_HW_IP_DriverType_MCO_CRC
    bool
    default y
    depends on MCUX_HW_DEVICE_ID_LPC804

config MCUX_HW_IP_DriverType_MINI_SPI
    bool
    default y
    depends on MCUX_HW_DEVICE_ID_LPC804

config MCUX_HW_IP_DriverType_MINI_USART
    bool
    default y
    depends on MCUX_HW_DEVICE_ID_LPC804

config MCUX_HW_IP_DriverType_MRT
    bool
    default y
    depends on MCUX_HW_DEVICE_ID_LPC804

config MCUX_HW_IP_DriverType_PINT
    bool
    default y
    depends on MCUX_HW_DEVICE_ID_LPC804

config MCUX_HW_IP_DriverType_PLU
    bool
    default y
    depends on MCUX_HW_DEVICE_ID_LPC804

config MCUX_HW_IP_DriverType_SWM
    bool
    default y
    depends on MCUX_HW_DEVICE_ID_LPC804

config MCUX_HW_IP_DriverType_SYSCON
    bool
    default y
    depends on MCUX_HW_DEVICE_ID_LPC804

config MCUX_HW_IP_DriverType_WKT
    bool
    default y
    depends on MCUX_HW_DEVICE_ID_LPC804

config MCUX_HW_IP_DriverType_WWDT
    bool
    default y
    depends on MCUX_HW_DEVICE_ID_LPC804
```

## mcux/mcux-sdk-ng/devices/LPC/LPC800/LPC844/Kconfig.chip
```kconfig
# Copyright 2024 NXP
#
# SPDX-License-Identifier: BSD-3-Clause

# core related
config MCUX_HW_CORE
    string
    default "cm0p"

config MCUX_HW_CORE_CM0P
    bool
    default y

config MCUX_HW_CORE_ID
    string
    default "core0"

config MCUX_HW_CORE_ID_CORE0
    bool
    default y

config MCUX_HW_DEVICE_CORE
    string
    default "LPC844"

config MCUX_HW_FPU
    string
    default "NO_FPU"

config MCUX_HW_FPU_TYPE
    string
    default "no_fpu"

config MCUX_HW_NO_FPU
    bool
    default y

config MCUX_HW_INT_PRIO_BITS
    int
    default 2

config MCUX_HW_SOC_SERIES_LPC
    bool
    default y

config MCUX_HW_SOC_SINGLECORE_DEVICE
    bool
    default y

# device related

config MCUX_HW_DEVICE_ID_LPC844
    bool

choice MCUX_HW_DEVICE_PART_LPC844
    prompt "Device LPC844 Part"
    config MCUX_HW_DEVICE_PART_LPC844M201JBD64
    bool "Device part LPC844M201JBD64"
    select MCUX_HW_DEVICE_ID_LPC844
    config MCUX_HW_DEVICE_PART_LPC844M201JBD48
    bool "Device part LPC844M201JBD48"
    select MCUX_HW_DEVICE_ID_LPC844
    config MCUX_HW_DEVICE_PART_LPC844M201JHI48
    bool "Device part LPC844M201JHI48"
    select MCUX_HW_DEVICE_ID_LPC844
    config MCUX_HW_DEVICE_PART_LPC844M201JHI33
    bool "Device part LPC844M201JHI33"
    select MCUX_HW_DEVICE_ID_LPC844
endchoice

config MCUX_HW_DEVICE_ID
    string
    default "LPC844" if MCUX_HW_DEVICE_ID_LPC844

config MCUX_HW_DEVICE_PART
    string
    default "LPC844M201JBD64" if MCUX_HW_DEVICE_PART_LPC844M201JBD64
    default "LPC844M201JBD48" if MCUX_HW_DEVICE_PART_LPC844M201JBD48
    default "LPC844M201JHI48" if MCUX_HW_DEVICE_PART_LPC844M201JHI48
    default "LPC844M201JHI33" if MCUX_HW_DEVICE_PART_LPC844M201JHI33

# For chipmodel generated files
config MCUX_TOOLCHAIN_LINKER_DEVICE_PREFIX
    string
    default "LPC844" if MCUX_HW_DEVICE_ID_LPC844

config MCUX_TOOLCHAIN_MCUX_STARTUP
    string
    default "lpc844"

# Toolchain related

config MCUX_TOOLCHAIN_IAR_CPU_IDENTIFIER
    string
    default "LPC844M201" if MCUX_HW_DEVICE_ID_LPC844

config MCUX_TOOLCHAIN_MDK_CPU_IDENTIFIER
    string
    default "LPC844M201JBD64" if MCUX_HW_DEVICE_PART_LPC844M201JBD64
    default "LPC844M201JBD48" if MCUX_HW_DEVICE_PART_LPC844M201JBD48
    default "LPC844M201JHI48" if MCUX_HW_DEVICE_PART_LPC844M201JHI48
    default "LPC844M201JHI33" if MCUX_HW_DEVICE_PART_LPC844M201JHI33

config MCUX_TOOLCHAIN_JLINK_CPU_IDENTIFIER
    string
    default "LPC844" if MCUX_HW_DEVICE_ID_LPC844

# ip information
config MCUX_HW_IP_DriverType_ACOMP
    bool
    default y
    depends on MCUX_HW_DEVICE_ID_LPC844

config MCUX_HW_IP_DriverType_ADC12_5M
    bool
    default y
    depends on MCUX_HW_DEVICE_ID_LPC844

config MCUX_HW_IP_DriverType_CAPT
    bool
    default y
    depends on MCUX_HW_DEVICE_ID_LPC844

config MCUX_HW_IP_DriverType_CTIMER
    bool
    default y
    depends on MCUX_HW_DEVICE_ID_LPC844

config MCUX_HW_IP_DriverType_DAC10
    bool
    default y
    depends on MCUX_HW_DEVICE_ID_LPC844

config MCUX_HW_IP_DriverType_GPIO_PORT
    bool
    default y
    depends on MCUX_HW_DEVICE_ID_LPC844

config MCUX_HW_IP_DriverType_I2C_SERIALIF
    bool
    default y
    depends on MCUX_HW_DEVICE_ID_LPC844

config MCUX_HW_IP_DriverType_IAP
    bool
    default y
    depends on MCUX_HW_DEVICE_ID_LPC844

config MCUX_HW_IP_DriverType_INPUTMUX
    bool
    default y
    depends on MCUX_HW_DEVICE_ID_LPC844

config MCUX_HW_IP_DriverType_IOCON_LITE
    bool
    default y
    depends on MCUX_HW_DEVICE_ID_LPC844

config MCUX_HW_IP_DriverType_LPC_CLOCK
    bool
    default y
    depends on MCUX_HW_DEVICE_ID_LPC844

config MCUX_HW_IP_DriverType_LPC_FAIM
    bool
    default y
    depends on MCUX_HW_DEVICE_ID_LPC844

config MCUX_HW_IP_DriverType_LPC_FLASH_CTRL
    bool
    default y
    depends on MCUX_HW_DEVICE_ID_LPC844

config MCUX_HW_IP_DriverType_LPC_MTB
    bool
    default y
    depends on MCUX_HW_DEVICE_ID_LPC844

config MCUX_HW_IP_DriverType_LPC_NVIC
    bool
    default y
    depends on MCUX_HW_DEVICE_ID_LPC844

config MCUX_HW_IP_DriverType_LPC_PMU
    bool
    default y
    depends on MCUX_HW_DEVICE_ID_LPC844

config MCUX_HW_IP_DriverType_MCO_CRC
    bool
    default y
    depends on MCUX_HW_DEVICE_ID_LPC844

config MCUX_HW_IP_DriverType_MINI_SPI
    bool
    default y
    depends on MCUX_HW_DEVICE_ID_LPC844

config MCUX_HW_IP_DriverType_MINI_USART
    bool
    default y
    depends on MCUX_HW_DEVICE_ID_LPC844

config MCUX_HW_IP_DriverType_MRT
    bool
    default y
    depends on MCUX_HW_DEVICE_ID_LPC844

config MCUX_HW_IP_DriverType_PINT
    bool
    default y
    depends on MCUX_HW_DEVICE_ID_LPC844

config MCUX_HW_IP_DriverType_SCTIMER
    bool
    default y
    depends on MCUX_HW_DEVICE_ID_LPC844

config MCUX_HW_IP_DriverType_SDMA
    bool
    default y
    depends on MCUX_HW_DEVICE_ID_LPC844

config MCUX_HW_IP_DriverType_SWM
    bool
    default y
    depends on MCUX_HW_DEVICE_ID_LPC844

config MCUX_HW_IP_DriverType_SYSCON
    bool
    default y
    depends on MCUX_HW_DEVICE_ID_LPC844

config MCUX_HW_IP_DriverType_WKT
    bool
    default y
    depends on MCUX_HW_DEVICE_ID_LPC844

config MCUX_HW_IP_DriverType_WWDT
    bool
    default y
    depends on MCUX_HW_DEVICE_ID_LPC844
```

## mcux/mcux-sdk-ng/devices/LPC/LPC800/LPC845/Kconfig
```kconfig
# Copyright 2024 NXP
# All rights reserved.
#
# SPDX-License-Identifier: BSD-3-Clause

rsource "Kconfig.chip"
rsource "drivers/Kconfig"
rsource "../../../arm/Kconfig.common"
rsource "Kconfig.defconfig"

## Project segment and component dependency data
config MCUX_HW_DEVICE_LPC845
    # bool "Device LPC845 Configuration"
    bool
    default y

    # component dependency
    select MCUX_COMPONENT_component.miniusart_adapter if MCUX_COMPONENT_utility.assert_lite
    select MCUX_COMPONENT_driver.syscon if MCUX_COMPONENT_component.lpc_gpio_adapter
    select MCUX_COMPONENT_component.miniusart_adapter if MCUX_COMPONENT_utility.debug_console_lite
    select MCUX_COMPONENT_driver.lpc_dma if MCUX_COMPONENT_driver.lpc_i2c_dma
```

## mcux/mcux-sdk-ng/devices/LPC/LPC800/LPC845/Kconfig.chip
```kconfig
# Copyright 2024 NXP
#
# SPDX-License-Identifier: BSD-3-Clause

# core related
config MCUX_HW_CORE
    string
    default "cm0p"

config MCUX_HW_CORE_CM0P
    bool
    default y

config MCUX_HW_CORE_ID
    string
    default "core0"

config MCUX_HW_CORE_ID_CORE0
    bool
    default y

config MCUX_HW_DEVICE_CORE
    string
    default "LPC845"

config MCUX_HW_FPU
    string
    default "NO_FPU"

config MCUX_HW_FPU_TYPE
    string
    default "no_fpu"

config MCUX_HW_NO_FPU
    bool
    default y

config MCUX_HW_INT_PRIO_BITS
    int
    default 2

config MCUX_HW_SOC_SERIES_LPC
    bool
    default y

config MCUX_HW_SOC_SINGLECORE_DEVICE
    bool
    default y

# device related

config MCUX_HW_DEVICE_ID_LPC845
    bool

choice MCUX_HW_DEVICE_PART_LPC845
    prompt "Device LPC845 Part"
    config MCUX_HW_DEVICE_PART_LPC845M301JBD64
    bool "Device part LPC845M301JBD64"
    select MCUX_HW_DEVICE_ID_LPC845
    config MCUX_HW_DEVICE_PART_LPC845M301JBD48
    bool "Device part LPC845M301JBD48"
    select MCUX_HW_DEVICE_ID_LPC845
    config MCUX_HW_DEVICE_PART_LPC845M301JHI48
    bool "Device part LPC845M301JHI48"
    select MCUX_HW_DEVICE_ID_LPC845
    config MCUX_HW_DEVICE_PART_LPC845M301JHI33
    bool "Device part LPC845M301JHI33"
    select MCUX_HW_DEVICE_ID_LPC845
endchoice

config MCUX_HW_DEVICE_ID
    string
    default "LPC845" if MCUX_HW_DEVICE_ID_LPC845

config MCUX_HW_DEVICE_PART
    string
    default "LPC845M301JBD64" if MCUX_HW_DEVICE_PART_LPC845M301JBD64
    default "LPC845M301JBD48" if MCUX_HW_DEVICE_PART_LPC845M301JBD48
    default "LPC845M301JHI48" if MCUX_HW_DEVICE_PART_LPC845M301JHI48
    default "LPC845M301JHI33" if MCUX_HW_DEVICE_PART_LPC845M301JHI33

# For chipmodel generated files
config MCUX_TOOLCHAIN_LINKER_DEVICE_PREFIX
    string
    default "LPC845" if MCUX_HW_DEVICE_ID_LPC845

config MCUX_TOOLCHAIN_MCUX_STARTUP
    string
    default "lpc845"

# Toolchain related

config MCUX_TOOLCHAIN_IAR_CPU_IDENTIFIER
    string
    default "LPC845M301" if MCUX_HW_DEVICE_ID_LPC845

config MCUX_TOOLCHAIN_MDK_CPU_IDENTIFIER
    string
    default "LPC845M301JBD64" if MCUX_HW_DEVICE_PART_LPC845M301JBD64
    default "LPC845M301JBD48" if MCUX_HW_DEVICE_PART_LPC845M301JBD48
    default "LPC845M301JHI48" if MCUX_HW_DEVICE_PART_LPC845M301JHI48
    default "LPC845M301JHI33" if MCUX_HW_DEVICE_PART_LPC845M301JHI33

config MCUX_TOOLCHAIN_JLINK_CPU_IDENTIFIER
    string
    default "LPC845" if MCUX_HW_DEVICE_ID_LPC845

# ip information
config MCUX_HW_IP_DriverType_ACOMP
    bool
    default y
    depends on MCUX_HW_DEVICE_ID_LPC845

config MCUX_HW_IP_DriverType_ADC12_5M
    bool
    default y
    depends on MCUX_HW_DEVICE_ID_LPC845

config MCUX_HW_IP_DriverType_CAPT
    bool
    default y
    depends on MCUX_HW_DEVICE_ID_LPC845

config MCUX_HW_IP_DriverType_CTIMER
    bool
    default y
    depends on MCUX_HW_DEVICE_ID_LPC845

config MCUX_HW_IP_DriverType_DAC10
    bool
    default y
    depends on MCUX_HW_DEVICE_ID_LPC845

config MCUX_HW_IP_DriverType_GPIO_PORT
    bool
    default y
    depends on MCUX_HW_DEVICE_ID_LPC845

config MCUX_HW_IP_DriverType_I2C_SERIALIF
    bool
    default y
    depends on MCUX_HW_DEVICE_ID_LPC845

config MCUX_HW_IP_DriverType_IAP
    bool
    default y
    depends on MCUX_HW_DEVICE_ID_LPC845

config MCUX_HW_IP_DriverType_INPUTMUX
    bool
    default y
    depends on MCUX_HW_DEVICE_ID_LPC845

config MCUX_HW_IP_DriverType_IOCON_LITE
    bool
    default y
    depends on MCUX_HW_DEVICE_ID_LPC845

config MCUX_HW_IP_DriverType_LPC_CLOCK
    bool
    default y
    depends on MCUX_HW_DEVICE_ID_LPC845

config MCUX_HW_IP_DriverType_LPC_FAIM
    bool
    default y
    depends on MCUX_HW_DEVICE_ID_LPC845

config MCUX_HW_IP_DriverType_LPC_FLASH_CTRL
    bool
    default y
    depends on MCUX_HW_DEVICE_ID_LPC845

config MCUX_HW_IP_DriverType_LPC_MTB
    bool
    default y
    depends on MCUX_HW_DEVICE_ID_LPC845

config MCUX_HW_IP_DriverType_LPC_NVIC
    bool
    default y
    depends on MCUX_HW_DEVICE_ID_LPC845

config MCUX_HW_IP_DriverType_LPC_PMU
    bool
    default y
    depends on MCUX_HW_DEVICE_ID_LPC845

config MCUX_HW_IP_DriverType_MCO_CRC
    bool
    default y
    depends on MCUX_HW_DEVICE_ID_LPC845

config MCUX_HW_IP_DriverType_MINI_SPI
    bool
    default y
    depends on MCUX_HW_DEVICE_ID_LPC845

config MCUX_HW_IP_DriverType_MINI_USART
    bool
    default y
    depends on MCUX_HW_DEVICE_ID_LPC845

config MCUX_HW_IP_DriverType_MRT
    bool
    default y
    depends on MCUX_HW_DEVICE_ID_LPC845

config MCUX_HW_IP_DriverType_PINT
    bool
    default y
    depends on MCUX_HW_DEVICE_ID_LPC845

config MCUX_HW_IP_DriverType_SCTIMER
    bool
    default y
    depends on MCUX_HW_DEVICE_ID_LPC845

config MCUX_HW_IP_DriverType_SDMA
    bool
    default y
    depends on MCUX_HW_DEVICE_ID_LPC845

config MCUX_HW_IP_DriverType_SWM
    bool
    default y
    depends on MCUX_HW_DEVICE_ID_LPC845

config MCUX_HW_IP_DriverType_SYSCON
    bool
    default y
    depends on MCUX_HW_DEVICE_ID_LPC845

config MCUX_HW_IP_DriverType_WKT
    bool
    default y
    depends on MCUX_HW_DEVICE_ID_LPC845

config MCUX_HW_IP_DriverType_WWDT
    bool
    default y
    depends on MCUX_HW_DEVICE_ID_LPC845
```

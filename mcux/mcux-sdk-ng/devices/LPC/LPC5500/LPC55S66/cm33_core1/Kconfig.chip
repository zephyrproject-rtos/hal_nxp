## mcux/mcux-sdk-ng/devices/MCX/MCXA/MCXA144/Kconfig.chip
```kconfig
# Copyright 2024 NXP
#
# SPDX-License-Identifier: BSD-3-Clause

# core related
config MCUX_HW_CORE
    string
    default "cm33"

config MCUX_HW_CORE_CM33
    bool
    default y

config MCUX_HW_CORE_ID
    string
    default "cm33_core0"

config MCUX_HW_CORE_ID_CM33_CORE0
    bool
    default y

config MCUX_HW_DEVICE_CORE
    string
    default "MCXA144"

config MCUX_HW_FPU
    string
    default "SP_FPU"

config MCUX_HW_FPU_TYPE
    string
    default "fpv5_sp"

config MCUX_HW_FPV5_SP
    bool
    default y

config MCUX_HW_INT_PRIO_BITS
    int
    default 3

config MCUX_HW_DSP
    bool
    default y

config MCUX_HW_SAU
    bool
    default n

config MCUX_HW_SOC_SERIES_MCX
    bool
    default y

config MCUX_HW_SOC_SINGLECORE_DEVICE
    bool
    default y

# device related

config MCUX_HW_DEVICE_ID_MCXA144
    bool

choice
    prompt "Device MCXA144 Part"
    config MCUX_HW_DEVICE_PART_MCXA144VPJ
    bool "Device part MCXA144VPJ"
    select MCUX_HW_DEVICE_ID_MCXA144
    config MCUX_HW_DEVICE_PART_MCXA144VLL
    bool "Device part MCXA144VLL"
    select MCUX_HW_DEVICE_ID_MCXA144
    config MCUX_HW_DEVICE_PART_MCXA144VMP
    bool "Device part MCXA144VMP"
    select MCUX_HW_DEVICE_ID_MCXA144
    config MCUX_HW_DEVICE_PART_MCXA144VLH
    bool "Device part MCXA144VLH"
    select MCUX_HW_DEVICE_ID_MCXA144
    config MCUX_HW_DEVICE_PART_MCXA144VFT
    bool "Device part MCXA144VFT"
    select MCUX_HW_DEVICE_ID_MCXA144
endchoice

config MCUX_HW_DEVICE_ID
    string
    default "MCXA144" if MCUX_HW_DEVICE_ID_MCXA144

config MCUX_HW_DEVICE_PART
    string
    default "MCXA144VPJ" if MCUX_HW_DEVICE_PART_MCXA144VPJ
    default "MCXA144VLL" if MCUX_HW_DEVICE_PART_MCXA144VLL
    default "MCXA144VMP" if MCUX_HW_DEVICE_PART_MCXA144VMP
    default "MCXA144VLH" if MCUX_HW_DEVICE_PART_MCXA144VLH
    default "MCXA144VFT" if MCUX_HW_DEVICE_PART_MCXA144VFT

# For chipmodel generated files
config MCUX_TOOLCHAIN_LINKER_DEVICE_PREFIX
    string
    default "MCXA144" if MCUX_HW_DEVICE_ID_MCXA144

config MCUX_TOOLCHAIN_MCUX_STARTUP
    string
    default "mcxa144"

# Toolchain related

config MCUX_TOOLCHAIN_IAR_CPU_IDENTIFIER
    string
    default "MCXA144" if MCUX_HW_DEVICE_ID_MCXA144

config MCUX_TOOLCHAIN_MDK_CPU_IDENTIFIER
    string
    default "MCXA144VPJ" if MCUX_HW_DEVICE_PART_MCXA144VPJ
    default "MCXA144VLL" if MCUX_HW_DEVICE_PART_MCXA144VLL
    default "MCXA144VMP" if MCUX_HW_DEVICE_PART_MCXA144VMP
    default "MCXA144VLH" if MCUX_HW_DEVICE_PART_MCXA144VLH
    default "MCXA144VFT" if MCUX_HW_DEVICE_PART_MCXA144VFT

config MCUX_TOOLCHAIN_JLINK_CPU_IDENTIFIER
    string
    default "MCXA144" if MCUX_HW_DEVICE_ID_MCXA144

# ip information
config MCUX_HW_IP_DriverType_AOI
    bool
    default y
    depends on MCUX_HW_DEVICE_ID_MCXA144

config MCUX_HW_IP_DriverType_CDOG
    bool
    default y
    depends on MCUX_HW_DEVICE_ID_MCXA144

config MCUX_HW_IP_DriverType_CRC
    bool
    default y
    depends on MCUX_HW_DEVICE_ID_MCXA144

config MCUX_HW_IP_DriverType_CTIMER
    bool
    default y
    depends on MCUX_HW_DEVICE_ID_MCXA144

config MCUX_HW_IP_DriverType_DBGMB
    bool
    default y
    depends on MCUX_HW_DEVICE_ID_MCXA144

config MCUX_HW_IP_DriverType_EDMA3
    bool
    default y
    depends on MCUX_HW_DEVICE_ID_MCXA144

config MCUX_HW_IP_DriverType_EIM
    bool
    default y
    depends on MCUX_HW_DEVICE_ID_MCXA144

config MCUX_HW_IP_DriverType_EQDC
    bool
    default y
    depends on MCUX_HW_DEVICE_ID_MCXA144

config MCUX_HW_IP_DriverType_ERM
    bool
    default y
    depends on MCUX_HW_DEVICE_ID_MCXA144

config MCUX_HW_IP_DriverType_FLEXCAN
    bool
    default y
    depends on MCUX_HW_DEVICE_ID_MCXA144

config MCUX_HW_IP_DriverType_FLEXIO
    bool
    default y
    depends on MCUX_HW_DEVICE_ID_MCXA144

config MCUX_HW_IP_DriverType_FMC
    bool
    default y
    depends on MCUX_HW_DEVICE_ID_MCXA144

config MCUX_HW_IP_DriverType_FMU
    bool
    default y
    depends on MCUX_HW_DEVICE_ID_MCXA144

config MCUX_HW_IP_DriverType_FREQME
    bool
    default y
    depends on MCUX_HW_DEVICE_ID_MCXA144

config MCUX_HW_IP_DriverType_GLIKEY
    bool
    default y
    depends on MCUX_HW_DEVICE_ID_MCXA144

config MCUX_HW_IP_DriverType_GPIO
    bool
    default y
    depends on MCUX_HW_DEVICE_ID_MCXA144

config MCUX_HW_IP_DriverType_I3C
    bool
    default y
    depends on MCUX_HW_DEVICE_ID_MCXA144

config MCUX_HW_IP_DriverType_INPUTMUX
    bool
    default y
    depends on MCUX_HW_DEVICE_ID_MCXA144

config MCUX_HW_IP_DriverType_LPADC
    bool
    default y
    depends on MCUX_HW_DEVICE_ID_MCXA144

config MCUX_HW_IP_DriverType_LPCMP
    bool
    default y
    depends on MCUX_HW_DEVICE_ID_MCXA144

config MCUX_HW_IP_DriverType_LPC_SWD
    bool
    default y
    depends on MCUX_HW_DEVICE_ID_MCXA144

config MCUX_HW_IP_DriverType_LPC_SYSCON
    bool
    default y
    depends on MCUX_HW_DEVICE_ID_MCXA144

config MCUX_HW_IP_DriverType_LPDAC
    bool
    default y
    depends on MCUX_HW_DEVICE_ID_MCXA144

config MCUX_HW_IP_DriverType_LPI2C
    bool
    default y
    depends on MCUX_HW_DEVICE_ID_MCXA144

config MCUX_HW_IP_DriverType_LPSPI
    bool
    default y
    depends on MCUX_HW_DEVICE_ID_MCXA144

config MCUX_HW_IP_DriverType_LPTMR
    bool
    default y
    depends on MCUX_HW_DEVICE_ID_MCXA144

config MCUX_HW_IP_DriverType_LPUART
    bool
    default y
    depends on MCUX_HW_DEVICE_ID_MCXA144

config MCUX_HW_IP_DriverType_MCX_CMC
    bool
    default y
    depends on MCUX_HW_DEVICE_ID_MCXA144

config MCUX_HW_IP_DriverType_MCX_SPC
    bool
    default y
    depends on MCUX_HW_DEVICE_ID_MCXA144

config MCUX_HW_IP_DriverType_MCX_VBAT
    bool
    default y
    depends on MCUX_HW_DEVICE_ID_MCXA144

config MCUX_HW_IP_DriverType_MRCC
    bool
    default y
    depends on MCUX_HW_DEVICE_ID_MCXA144

config MCUX_HW_IP_DriverType_OPAMP
    bool
    default y
    depends on MCUX_HW_DEVICE_ID_MCXA144

config MCUX_HW_IP_DriverType_OSTIMER
    bool
    default y
    depends on MCUX_HW_DEVICE_ID_MCXA144

config MCUX_HW_IP_DriverType_PORT
    bool
    default y
    depends on MCUX_HW_DEVICE_ID_MCXA144

config MCUX_HW_IP_DriverType_PWM
    bool
    default y
    depends on MCUX_HW_DEVICE_ID_MCXA144

config MCUX_HW_IP_DriverType_SCG
    bool
    default y
    depends on MCUX_HW_DEVICE_ID_MCXA144

config MCUX_HW_IP_DriverType_TRDC_1
    bool
    default y
    depends on MCUX_HW_DEVICE_ID_MCXA144

config MCUX_HW_IP_DriverType_USB_DEVICE_KHCI
    bool
    default y
    depends on MCUX_HW_DEVICE_ID_MCXA144

config MCUX_HW_IP_DriverType_UTICK
    bool
    default y
    depends on MCUX_HW_DEVICE_ID_MCXA144

config MCUX_HW_IP_DriverType_WAKETIMER
    bool
    default y
    depends on MCUX_HW_DEVICE_ID_MCXA144

config MCUX_HW_IP_DriverType_WUU
    bool
    default y
    depends on MCUX_HW_DEVICE_ID_MCXA144

config MCUX_HW_IP_DriverType_WWDT
    bool
    default y
    depends on MCUX_HW_DEVICE_ID_MCXA144
```

## mcux/mcux-sdk-ng/devices/MCX/MCXA/MCXA145/Kconfig.chip
```kconfig
# Copyright 2024 NXP
#
# SPDX-License-Identifier: BSD-3-Clause

# core related
config MCUX_HW_CORE
    string
    default "cm33"

config MCUX_HW_CORE_CM33
    bool
    default y

config MCUX_HW_CORE_ID
    string
    default "cm33_core0"

config MCUX_HW_CORE_ID_CM33_CORE0
    bool
    default y

config MCUX_HW_DEVICE_CORE
    string
    default "MCXA145"

config MCUX_HW_FPU
    string
    default "SP_FPU"

config MCUX_HW_FPU_TYPE
    string
    default "fpv5_sp"

config MCUX_HW_FPV5_SP
    bool
    default y

config MCUX_HW_INT_PRIO_BITS
    int
    default 3

config MCUX_HW_DSP
    bool
    default y

config MCUX_HW_SAU
    bool
    default n

config MCUX_HW_SOC_SERIES_MCX
    bool
    default y

config MCUX_HW_SOC_SINGLECORE_DEVICE
    bool
    default y

# device related

config MCUX_HW_DEVICE_ID_MCXA145
    bool

choice MCUX_HW_DEVICE_PART_MCXA145
    prompt "Device MCXA145 Part"
    config MCUX_HW_DEVICE_PART_MCXA145VPJ
    bool "Device part MCXA145VPJ"
    select MCUX_HW_DEVICE_ID_MCXA145
    config MCUX_HW_DEVICE_PART_MCXA145VLL
    bool "Device part MCXA145VLL"
    select MCUX_HW_DEVICE_ID_MCXA145
    config MCUX_HW_DEVICE_PART_MCXA145VMP
    bool "Device part MCXA145VMP"
    select MCUX_HW_DEVICE_ID_MCXA145
    config MCUX_HW_DEVICE_PART_MCXA145VLH
    bool "Device part MCXA145VLH"
    select MCUX_HW_DEVICE_ID_MCXA145
    config MCUX_HW_DEVICE_PART_MCXA145VFT
    bool "Device part MCXA145VFT"
    select MCUX_HW_DEVICE_ID_MCXA145
endchoice

config MCUX_HW_DEVICE_ID
    string
    default "MCXA145" if MCUX_HW_DEVICE_ID_MCXA145

config MCUX_HW_DEVICE_PART
    string
    default "MCXA145VPJ" if MCUX_HW_DEVICE_PART_MCXA145VPJ
    default "MCXA145VLL" if MCUX_HW_DEVICE_PART_MCXA145VLL
    default "MCXA145VMP" if MCUX_HW_DEVICE_PART_MCXA145VMP
    default "MCXA145VLH" if MCUX_HW_DEVICE_PART_MCXA145VLH
    default "MCXA145VFT" if MCUX_HW_DEVICE_PART_MCXA145VFT

# For chipmodel generated files
config MCUX_TOOLCHAIN_LINKER_DEVICE_PREFIX
    string
    default "MCXA145" if MCUX_HW_DEVICE_ID_MCXA145

config MCUX_TOOLCHAIN_MCUX_STARTUP
    string
    default "mcxa145"

# Toolchain related

config MCUX_TOOLCHAIN_IAR_CPU_IDENTIFIER
    string
    default "MCXA145" if MCUX_HW_DEVICE_ID_MCXA145

config MCUX_TOOLCHAIN_MDK_CPU_IDENTIFIER
    string
    default "MCXA145VPJ" if MCUX_HW_DEVICE_PART_MCXA145VPJ
    default "MCXA145VLL" if MCUX_HW_DEVICE_PART_MCXA145VLL
    default "MCXA145VMP" if MCUX_HW_DEVICE_PART_MCXA145VMP
    default "MCXA145VLH" if MCUX_HW_DEVICE_PART_MCXA145VLH
    default "MCXA145VFT" if MCUX_HW_DEVICE_PART_MCXA145VFT

config MCUX_TOOLCHAIN_JLINK_CPU_IDENTIFIER
    string
    default "MCXA145" if MCUX_HW_DEVICE_ID_MCXA145

# ip information
config MCUX_HW_IP_DriverType_AOI
    bool
    default y
    depends on MCUX_HW_DEVICE_ID_MCXA145

config MCUX_HW_IP_DriverType_CDOG
    bool
    default y
    depends on MCUX_HW_DEVICE_ID_MCXA145

config MCUX_HW_IP_DriverType_CRC
    bool
    default y
    depends on MCUX_HW_DEVICE_ID_MCXA145

config MCUX_HW_IP_DriverType_CTIMER
    bool
    default y
    depends on MCUX_HW_DEVICE_ID_MCXA145

config MCUX_HW_IP_DriverType_DBGMB
    bool
    default y
    depends on MCUX_HW_DEVICE_ID_MCXA145

config MCUX_HW_IP_DriverType_EDMA3
    bool
    default y
    depends on MCUX_HW_DEVICE_ID_MCXA145

config MCUX_HW_IP_DriverType_EIM
    bool
    default y
    depends on MCUX_HW_DEVICE_ID_MCXA145

config MCUX_HW_IP_DriverType_EQDC
    bool
    default y
    depends on MCUX_HW_DEVICE_ID_MCXA145

config MCUX_HW_IP_DriverType_ERM
    bool
    default y
    depends on MCUX_HW_DEVICE_ID_MCXA145

config MCUX_HW_IP_DriverType_FLEXCAN
    bool
    default y
    depends on MCUX_HW_DEVICE_ID_MCXA145

config MCUX_HW_IP_DriverType_FLEXIO
    bool
    default y
    depends on MCUX_HW_DEVICE_ID_MCXA145

config MCUX_HW_IP_DriverType_FMC
    bool
    default y
    depends on MCUX_HW_DEVICE_ID_MCXA145

config MCUX_HW_IP_DriverType_FMU
    bool
    default y
    depends on MCUX_HW_DEVICE_ID_MCXA145

config MCUX_HW_IP_DriverType_FREQME
    bool
    default y
    depends on MCUX_HW_DEVICE_ID_MCXA145

config MCUX_HW_IP_DriverType_GLIKEY
    bool
    default y
    depends on MCUX_HW_DEVICE_ID_MCXA145

config MCUX_HW_IP_DriverType_GPIO
    bool
    default y
    depends on MCUX_HW_DEVICE_ID_MCXA145

config MCUX_HW_IP_DriverType_I3C
    bool
    default y
    depends on MCUX_HW_DEVICE_ID_MCXA145

config MCUX_HW_IP_DriverType_INPUTMUX
    bool
    default y
    depends on MCUX_HW_DEVICE_ID_MCXA145

config MCUX_HW_IP_DriverType_LPADC
    bool
    default y
    depends on MCUX_HW_DEVICE_ID_MCXA145

config MCUX_HW_IP_DriverType_LPCMP
    bool
    default y
    depends on MCUX_HW_DEVICE_ID_MCXA145

config MCUX_HW_IP_DriverType_LPC_SWD
    bool
    default y
    depends on MCUX_HW_DEVICE_ID_MCXA145

config MCUX_HW_IP_DriverType_LPC_SYSCON
    bool
    default y
    depends on MCUX_HW_DEVICE_ID_MCXA145

config MCUX_HW_IP_DriverType_LPDAC
    bool
    default y
    depends on MCUX_HW_DEVICE_ID_MCXA145

config MCUX_HW_IP_DriverType_LPI2C
    bool
    default y
    depends on MCUX_HW_DEVICE_ID_MCXA145

config MCUX_HW_IP_DriverType_LPSPI
    bool
    default y
    depends on MCUX_HW_DEVICE_ID_MCXA145

config MCUX_HW_IP_DriverType_LPTMR
    bool
    default y
    depends on MCUX_HW_DEVICE_ID_MCXA145

config MCUX_HW_IP_DriverType_LPUART
    bool
    default y
    depends on MCUX_HW_DEVICE_ID_MCXA145

config MCUX_HW_IP_DriverType_MCX_CMC
    bool
    default y
    depends on MCUX_HW_DEVICE_ID_MCXA145

config MCUX_HW_IP_DriverType_MCX_SPC
    bool
    default y
    depends on MCUX_HW_DEVICE_ID_MCXA145

config MCUX_HW_IP_DriverType_MCX_VBAT
    bool
    default y
    depends on MCUX_HW_DEVICE_ID_MCXA145

config MCUX_HW_IP_DriverType_MRCC
    bool
    default y
    depends on MCUX_HW_DEVICE_ID_MCXA145

config MCUX_HW_IP_DriverType_OPAMP
    bool
    default y
    depends on MCUX_HW_DEVICE_ID_MCXA145

config MCUX_HW_IP_DriverType_OSTIMER
    bool
    default y
    depends on MCUX_HW_DEVICE_ID_MCXA145

config MCUX_HW_IP_DriverType_PORT
    bool
    default y
    depends on MCUX_HW_DEVICE_ID_MCXA145

config MCUX_HW_IP_DriverType_PWM
    bool
    default y
    depends on MCUX_HW_DEVICE_ID_MCXA145

config MCUX_HW_IP_DriverType_SCG
    bool
    default y
    depends on MCUX_HW_DEVICE_ID_MCXA145

config MCUX_HW_IP_DriverType_TRDC_1
    bool
    default y
    depends on MCUX_HW_DEVICE_ID_MCXA145

config MCUX_HW_IP_DriverType_USB_DEVICE_KHCI
    bool
    default y
    depends on MCUX_HW_DEVICE_ID_MCXA145

config MCUX_HW_IP_DriverType_UTICK
    bool
    default y
    depends on MCUX_HW_DEVICE_ID_MCXA145

config MCUX_HW_IP_DriverType_WAKETIMER
    bool
    default y
    depends on MCUX_HW_DEVICE_ID_MCXA145

config MCUX_HW_IP_DriverType_WUU
    bool
    default y
    depends on MCUX_HW_DEVICE_ID_MCXA145

config MCUX_HW_IP_DriverType_WWDT
    bool
    default y
    depends on MCUX_HW_DEVICE_ID_MCXA145
```

## mcux/mcux-sdk-ng/devices/MCX/MCXA/MCXA153/drivers/romapi/Kconfig
```kconfig
# Copyright 2024 NXP
#
# SPDX-License-Identifier: BSD-3-Clause

config MCUX_HAS_COMPONENT_driver.romapi
    bool
    default y

config MCUX_COMPONENT_driver.romapi
    bool "Use driver romapi"
    select MCUX_COMPONENT_driver.common
    depends on MCUX_HAS_COMPONENT_driver.romapi
```

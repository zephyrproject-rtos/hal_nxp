## mcux/mcux-sdk-ng/devices/LPC/LPC800/LPC864/Kconfig.chip
```kconfig
# Copyright 2024 NXP
#
# SPDX-License-Identifier: BSD-3-Clause

# core related
config MCUX_HW_CORE
    string
    default "cm0p"

config MCUX_HW_CORE_CM0P
    bool
    default y

config MCUX_HW_CORE_ID
    string
    default "core0"

config MCUX_HW_CORE_ID_CORE0
    bool
    default y

config MCUX_HW_DEVICE_CORE
    string
    default "LPC864"

config MCUX_HW_FPU
    string
    default "NO_FPU"

config MCUX_HW_FPU_TYPE
    string
    default "no_fpu"

config MCUX_HW_NO_FPU
    bool
    default y

config MCUX_HW_INT_PRIO_BITS
    int
    default 2

config MCUX_HW_SOC_SERIES_LPC
    bool
    default y

config MCUX_HW_SOC_SINGLECORE_DEVICE
    bool
    default y

# device related

config MCUX_HW_DEVICE_ID_LPC864
    bool

choice
    prompt "Device LPC864 Part"
    config MCUX_HW_DEVICE_PART_LPC864M201JBD64
    bool "Device part LPC864M201JBD64"
    select MCUX_HW_DEVICE_ID_LPC864
    config MCUX_HW_DEVICE_PART_LPC864M201JHI48
    bool "Device part LPC864M201JHI48"
    select MCUX_HW_DEVICE_ID_LPC864
    config MCUX_HW_DEVICE_PART_LPC864M201JHI33
    bool "Device part LPC864M201JHI33"
    select MCUX_HW_DEVICE_ID_LPC864
endchoice

config MCUX_HW_DEVICE_ID
    string
    default "LPC864" if MCUX_HW_DEVICE_ID_LPC864

config MCUX_HW_DEVICE_PART
    string
    default "LPC864M201JBD64" if MCUX_HW_DEVICE_PART_LPC864M201JBD64
    default "LPC864M201JHI48" if MCUX_HW_DEVICE_PART_LPC864M201JHI48
    default "LPC864M201JHI33" if MCUX_HW_DEVICE_PART_LPC864M201JHI33

# For chipmodel generated files
config MCUX_TOOLCHAIN_LINKER_DEVICE_PREFIX
    string
    default "LPC864" if MCUX_HW_DEVICE_ID_LPC864

config MCUX_TOOLCHAIN_MCUX_STARTUP
    string
    default "lpc864"

# Toolchain related

config MCUX_TOOLCHAIN_IAR_CPU_IDENTIFIER
    string
    default "LPC864M201" if MCUX_HW_DEVICE_ID_LPC864

config MCUX_TOOLCHAIN_MDK_CPU_IDENTIFIER
    string
    default "LPC864M201JBD64" if MCUX_HW_DEVICE_PART_LPC864M201JBD64
    default "LPC864M201JHI48" if MCUX_HW_DEVICE_PART_LPC864M201JHI48
    default "LPC864M201JHI33" if MCUX_HW_DEVICE_PART_LPC864M201JHI33

config MCUX_TOOLCHAIN_JLINK_CPU_IDENTIFIER
    string
    default "LPC864" if MCUX_HW_DEVICE_ID_LPC864

# ip information
config MCUX_HW_IP_DriverType_ACOMP
    bool
    default y
    depends on MCUX_HW_DEVICE_ID_LPC864

config MCUX_HW_IP_DriverType_ADC12_5M
    bool
    default y
    depends on MCUX_HW_DEVICE_ID_LPC864

config MCUX_HW_IP_DriverType_CTIMER
    bool
    default y
    depends on MCUX_HW_DEVICE_ID_LPC864

config MCUX_HW_IP_DriverType_FTM
    bool
    default y
    depends on MCUX_HW_DEVICE_ID_LPC864

config MCUX_HW_IP_DriverType_GPIO_PORT
    bool
    default y
    depends on MCUX_HW_DEVICE_ID_LPC864

config MCUX_HW_IP_DriverType_I2C_SERIALIF
    bool
    default y
    depends on MCUX_HW_DEVICE_ID_LPC864

config MCUX_HW_IP_DriverType_I3C
    bool
    default y
    depends on MCUX_HW_DEVICE_ID_LPC864

config MCUX_HW_IP_DriverType_IAP
    bool
    default y
    depends on MCUX_HW_DEVICE_ID_LPC864

config MCUX_HW_IP_DriverType_INPUTMUX
    bool
    default y
    depends on MCUX_HW_DEVICE_ID_LPC864

config MCUX_HW_IP_DriverType_IOCON_LITE
    bool
    default y
    depends on MCUX_HW_DEVICE_ID_LPC864

config MCUX_HW_IP_DriverType_LPC_CLOCK
    bool
    default y
    depends on MCUX_HW_DEVICE_ID_LPC864

config MCUX_HW_IP_DriverType_LPC_FLASH_CTRL
    bool
    default y
    depends on MCUX_HW_DEVICE_ID_LPC864

config MCUX_HW_IP_DriverType_LPC_NVIC
    bool
    default y
    depends on MCUX_HW_DEVICE_ID_LPC864

config MCUX_HW_IP_DriverType_LPC_PMU
    bool
    default y
    depends on MCUX_HW_DEVICE_ID_LPC864

config MCUX_HW_IP_DriverType_MCO_CRC
    bool
    default y
    depends on MCUX_HW_DEVICE_ID_LPC864

config MCUX_HW_IP_DriverType_MINI_SPI
    bool
    default y
    depends on MCUX_HW_DEVICE_ID_LPC864

config MCUX_HW_IP_DriverType_MINI_USART
    bool
    default y
    depends on MCUX_HW_DEVICE_ID_LPC864

config MCUX_HW_IP_DriverType_MRT
    bool
    default y
    depends on MCUX_HW_DEVICE_ID_LPC864

config MCUX_HW_IP_DriverType_PINT
    bool
    default y
    depends on MCUX_HW_DEVICE_ID_LPC864

config MCUX_HW_IP_DriverType_SCTIMER
    bool
    default y
    depends on MCUX_HW_DEVICE_ID_LPC864

config MCUX_HW_IP_DriverType_SDMA
    bool
    default y
    depends on MCUX_HW_DEVICE_ID_LPC864

config MCUX_HW_IP_DriverType_SWM
    bool
    default y
    depends on MCUX_HW_DEVICE_ID_LPC864

config MCUX_HW_IP_DriverType_SYSCON
    bool
    default y
    depends on MCUX_HW_DEVICE_ID_LPC864

config MCUX_HW_IP_DriverType_WKT
    bool
    default y
    depends on MCUX_HW_DEVICE_ID_LPC864

config MCUX_HW_IP_DriverType_WWDT
    bool
    default y
    depends on MCUX_HW_DEVICE_ID_LPC864
```

## mcux/mcux-sdk-ng/devices/LPC/LPC800/LPC865/drivers/Kconfig
```kconfig
# Copyright 2024 NXP
# All rights reserved.
#
# SPDX-License-Identifier: BSD-3-Clause

menu "Device specific drivers configuration"

    config MCUX_COMPONENT_driver.clock
         bool "Use driver clock"
         default y

    config MCUX_COMPONENT_driver.inputmux_connections
         bool "Use driver inputmux_connections"
         default y

    config MCUX_COMPONENT_driver.power
         bool "Use driver power"
         default y

    config MCUX_COMPONENT_driver.reset
         bool "Use driver reset"
         default y

    config MCUX_COMPONENT_driver.swm_connections
         bool "Use driver swm_connections"
         default y

    config MCUX_COMPONENT_driver.syscon_connections
         bool "Use driver syscon_connections"
         default y

endmenu
```

## mcux/mcux-sdk-ng/devices/MCX/MCXA/MCXA142/Kconfig.chip
```kconfig
# Copyright 2024 NXP
#
# SPDX-License-Identifier: BSD-3-Clause

# core related
config MCUX_HW_CORE
    string
    default "cm33"

config MCUX_HW_CORE_CM33
    bool
    default y

config MCUX_HW_CORE_ID
    string
    default "cm33_core0"

config MCUX_HW_CORE_ID_CM33_CORE0
    bool
    default y

config MCUX_HW_DEVICE_CORE
    string
    default "MCXA142"

config MCUX_HW_FPU
    string
    default "NO_FPU"

config MCUX_HW_FPU_TYPE
    string
    default "no_fpu"

config MCUX_HW_NO_FPU
    bool
    default y

config MCUX_HW_INT_PRIO_BITS
    int
    default 3

config MCUX_HW_DSP
    bool
    default n

config MCUX_HW_SAU
    bool
    default n

config MCUX_HW_SOC_SERIES_MCX
    bool
    default y

config MCUX_HW_SOC_SINGLECORE_DEVICE
    bool
    default y

# device related

config MCUX_HW_DEVICE_ID_MCXA142
    bool

choice MCUX_HW_DEVICE_PART_MCXA142
    prompt "Device MCXA142 Part"
    config MCUX_HW_DEVICE_PART_MCXA142VLH
    bool "Device part MCXA142VLH"
    select MCUX_HW_DEVICE_ID_MCXA142
    config MCUX_HW_DEVICE_PART_MCXA142VFT
    bool "Device part MCXA142VFT"
    select MCUX_HW_DEVICE_ID_MCXA142
    config MCUX_HW_DEVICE_PART_MCXA142VFM
    bool "Device part MCXA142VFM"
    select MCUX_HW_DEVICE_ID_MCXA142
    config MCUX_HW_DEVICE_PART_MCXA142VLF
    bool "Device part MCXA142VLF"
    select MCUX_HW_DEVICE_ID_MCXA142
endchoice

config MCUX_HW_DEVICE_ID
    string
    default "MCXA142" if MCUX_HW_DEVICE_ID_MCXA142

config MCUX_HW_DEVICE_PART
    string
    default "MCXA142VLH" if MCUX_HW_DEVICE_PART_MCXA142VLH
    default "MCXA142VFT" if MCUX_HW_DEVICE_PART_MCXA142VFT
    default "MCXA142VFM" if MCUX_HW_DEVICE_PART_MCXA142VFM
    default "MCXA142VLF" if MCUX_HW_DEVICE_PART_MCXA142VLF

# For chipmodel generated files
config MCUX_TOOLCHAIN_LINKER_DEVICE_PREFIX
    string
    default "MCXA142" if MCUX_HW_DEVICE_ID_MCXA142

config MCUX_TOOLCHAIN_MCUX_STARTUP
    string
    default "mcxa142"

# Toolchain related

config MCUX_TOOLCHAIN_IAR_CPU_IDENTIFIER
    string
    default "MCXA142" if MCUX_HW_DEVICE_ID_MCXA142

config MCUX_TOOLCHAIN_MDK_CPU_IDENTIFIER
    string
    default "MCXA142VLH" if MCUX_HW_DEVICE_PART_MCXA142VLH
    default "MCXA142VFT" if MCUX_HW_DEVICE_PART_MCXA142VFT
    default "MCXA142VFM" if MCUX_HW_DEVICE_PART_MCXA142VFM
    default "MCXA142VLF" if MCUX_HW_DEVICE_PART_MCXA142VLF

config MCUX_TOOLCHAIN_JLINK_CPU_IDENTIFIER
    string
    default "MCXA142" if MCUX_HW_DEVICE_ID_MCXA142

# ip information
config MCUX_HW_IP_DriverType_AOI
    bool
    default y
    depends on MCUX_HW_DEVICE_ID_MCXA142

config MCUX_HW_IP_DriverType_CDOG
    bool
    default y
    depends on MCUX_HW_DEVICE_ID_MCXA142

config MCUX_HW_IP_DriverType_CRC
    bool
    default y
    depends on MCUX_HW_DEVICE_ID_MCXA142

config MCUX_HW_IP_DriverType_CTIMER
    bool
    default y
    depends on MCUX_HW_DEVICE_ID_MCXA142

config MCUX_HW_IP_DriverType_DBGMB
    bool
    default y
    depends on MCUX_HW_DEVICE_ID_MCXA142

config MCUX_HW_IP_DriverType_EDMA3
    bool
    default y
    depends on MCUX_HW_DEVICE_ID_MCXA142

config MCUX_HW_IP_DriverType_EIM
    bool
    default y
    depends on MCUX_HW_DEVICE_ID_MCXA142

config MCUX_HW_IP_DriverType_EQDC
    bool
    default y
    depends on MCUX_HW_DEVICE_ID_MCXA142

config MCUX_HW_IP_DriverType_ERM
    bool
    default y
    depends on MCUX_HW_DEVICE_ID_MCXA142

config MCUX_HW_IP_DriverType_FMC
    bool
    default y
    depends on MCUX_HW_DEVICE_ID_MCXA142

config MCUX_HW_IP_DriverType_FMU
    bool
    default y
    depends on MCUX_HW_DEVICE_ID_MCXA142

config MCUX_HW_IP_DriverType_FREQME
    bool
    default y
    depends on MCUX_HW_DEVICE_ID_MCXA142

config MCUX_HW_IP_DriverType_GLIKEY
    bool
    default y
    depends on MCUX_HW_DEVICE_ID_MCXA142

config MCUX_HW_IP_DriverType_GPIO
    bool
    default y
    depends on MCUX_HW_DEVICE_ID_MCXA142

config MCUX_HW_IP_DriverType_I3C
    bool
    default y
    depends on MCUX_HW_DEVICE_ID_MCXA142

config MCUX_HW_IP_DriverType_INPUTMUX
    bool
    default y
    depends on MCUX_HW_DEVICE_ID_MCXA142

config MCUX_HW_IP_DriverType_LPADC
    bool
    default y
    depends on MCUX_HW_DEVICE_ID_MCXA142

config MCUX_HW_IP_DriverType_LPCMP
    bool
    default y
    depends on MCUX_HW_DEVICE_ID_MCXA142

config MCUX_HW_IP_DriverType_LPC_SWD
    bool
    default y
    depends on MCUX_HW_DEVICE_ID_MCXA142

config MCUX_HW_IP_DriverType_LPC_SYSCON
    bool
    default y
    depends on MCUX_HW_DEVICE_ID_MCXA142

config MCUX_HW_IP_DriverType_LPI2C
    bool
    default y
    depends on MCUX_HW_DEVICE_ID_MCXA142

config MCUX_HW_IP_DriverType_LPSPI
    bool
    default y
    depends on MCUX_HW_DEVICE_ID_MCXA142

config MCUX_HW_IP_DriverType_LPTMR
    bool
    default y
    depends on MCUX_HW_DEVICE_ID_MCXA142

config MCUX_HW_IP_DriverType_LPUART
    bool
    default y
    depends on MCUX_HW_DEVICE_ID_MCXA142

config MCUX_HW_IP_DriverType_MCX_CMC
    bool
    default y
    depends on MCUX_HW_DEVICE_ID_MCXA142

config MCUX_HW_IP_DriverType_MCX_SPC
    bool
    default y
    depends on MCUX_HW_DEVICE_ID_MCXA142

config MCUX_HW_IP_DriverType_MCX_VBAT
    bool
    default y
    depends on MCUX_HW_DEVICE_ID_MCXA142

config MCUX_HW_IP_DriverType_MRCC
    bool
    default y
    depends on MCUX_HW_DEVICE_ID_MCXA142

config MCUX_HW_IP_DriverType_OSTIMER
    bool
    default y
    depends on MCUX_HW_DEVICE_ID_MCXA142

config MCUX_HW_IP_DriverType_PORT
    bool
    default y
    depends on MCUX_HW_DEVICE_ID_MCXA142

config MCUX_HW_IP_DriverType_PWM
    bool
    default y
    depends on MCUX_HW_DEVICE_ID_MCXA142

config MCUX_HW_IP_DriverType_SCG
    bool
    default y
    depends on MCUX_HW_DEVICE_ID_MCXA142

config MCUX_HW_IP_DriverType_TRDC_1
    bool
    default y
    depends on MCUX_HW_DEVICE_ID_MCXA142

config MCUX_HW_IP_DriverType_USB_DEVICE_KHCI
    bool
    default y
    depends on MCUX_HW_DEVICE_ID_MCXA142

config MCUX_HW_IP_DriverType_UTICK
    bool
    default y
    depends on MCUX_HW_DEVICE_ID_MCXA142

config MCUX_HW_IP_DriverType_WAKETIMER
    bool
    default y
    depends on MCUX_HW_DEVICE_ID_MCXA142

config MCUX_HW_IP_DriverType_WUU
    bool
    default y
    depends on MCUX_HW_DEVICE_ID_MCXA142

config MCUX_HW_IP_DriverType_WWDT
    bool
    default y
    depends on MCUX_HW_DEVICE_ID_MCXA142
```

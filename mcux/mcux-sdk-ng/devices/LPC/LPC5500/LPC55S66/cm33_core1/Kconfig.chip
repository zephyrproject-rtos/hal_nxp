## mcux/mcux-sdk-ng/devices/MCX/MCXA/MCXA154/Kconfig
```kconfig
# Copyright 2024 NXP
# All rights reserved.
#
# SPDX-License-Identifier: BSD-3-Clause

rsource "Kconfig.chip"
rsource "../MCXA156/drivers/Kconfig"
rsource "../../../arm/Kconfig.common"
rsource "Kconfig.defconfig"

## Project segment and component dependency data
config MCUX_HW_DEVICE_MCXA154
    # bool "Device MCXA154 Configuration"
    bool
    default y

    # component dependency
    select MCUX_COMPONENT_driver.edma4 if MCUX_COMPONENT_device.RTE
    select MCUX_COMPONENT_component.lpuart_adapter if MCUX_COMPONENT_component.serial_manager_uart
    select MCUX_COMPONENT_driver.mcx_spc if MCUX_COMPONENT_driver.clock
    select MCUX_COMPONENT_driver.edma_soc if MCUX_COMPONENT_driver.edma4
    select MCUX_COMPONENT_driver.edma4 if MCUX_COMPONENT_driver.lpi2c_edma
    select MCUX_COMPONENT_driver.edma4 if MCUX_COMPONENT_driver.lpspi_edma
    select MCUX_COMPONENT_driver.edma4 if MCUX_COMPONENT_driver.lpuart_edma
    select MCUX_COMPONENT_driver.lpspi_edma if MCUX_COMPONENT_driver.cmsis_lpspi
    select MCUX_COMPONENT_driver.lpi2c_edma if MCUX_COMPONENT_driver.cmsis_lpi2c
    select MCUX_COMPONENT_driver.lpuart_edma if MCUX_COMPONENT_driver.cmsis_lpuart
    select MCUX_COMPONENT_driver.edma4 if MCUX_COMPONENT_driver.flexcan_edma
    select MCUX_COMPONENT_driver.edma4 if MCUX_COMPONENT_driver.dbi_flexio_edma
    select MCUX_COMPONENT_driver.trdc_soc if MCUX_COMPONENT_driver.trdc_1
    select MCUX_COMPONENT_driver.edma4 if MCUX_COMPONENT_driver.flexio_uart_edma
    select MCUX_COMPONENT_driver.edma4 if MCUX_COMPONENT_driver.flexio_spi_edma
    select MCUX_COMPONENT_driver.edma4 if MCUX_COMPONENT_driver.flexio_mculcd_edma
```

## mcux/mcux-sdk-ng/devices/MCX/MCXA/MCXA154/Kconfig.chip
```kconfig
# Copyright 2024 NXP
#
# SPDX-License-Identifier: BSD-3-Clause

# core related
config MCUX_HW_CORE
    string
    default "cm33"

config MCUX_HW_CORE_CM33
    bool
    default y

config MCUX_HW_CORE_ID
    string
    default "cm33_core0"

config MCUX_HW_CORE_ID_CM33_CORE0
    bool
    default y

config MCUX_HW_DEVICE_CORE
    string
    default "MCXA154"

config MCUX_HW_FPU
    string
    default "SP_FPU"

config MCUX_HW_FPU_TYPE
    string
    default "fpv5_sp"

config MCUX_HW_FPV5_SP
    bool
    default y

config MCUX_HW_INT_PRIO_BITS
    int
    default 3

config MCUX_HW_DSP
    bool
    default y

config MCUX_HW_SAU
    bool
    default n

config MCUX_HW_SOC_SERIES_MCX
    bool
    default y

config MCUX_HW_SOC_SINGLECORE_DEVICE
    bool
    default y

# device related

config MCUX_HW_DEVICE_ID_MCXA154
    bool

choice MCUX_HW_DEVICE_PART_MCXA154
    prompt "Device MCXA154 Part"
    config MCUX_HW_DEVICE_PART_MCXA154VPJ
    bool "Device part MCXA154VPJ"
    select MCUX_HW_DEVICE_ID_MCXA154
    config MCUX_HW_DEVICE_PART_MCXA154VLL
    bool "Device part MCXA154VLL"
    select MCUX_HW_DEVICE_ID_MCXA154
    config MCUX_HW_DEVICE_PART_MCXA154VMP
    bool "Device part MCXA154VMP"
    select MCUX_HW_DEVICE_ID_MCXA154
    config MCUX_HW_DEVICE_PART_MCXA154VLH
    bool "Device part MCXA154VLH"
    select MCUX_HW_DEVICE_ID_MCXA154
    config MCUX_HW_DEVICE_PART_MCXA154VFT
    bool "Device part MCXA154VFT"
    select MCUX_HW_DEVICE_ID_MCXA154
endchoice

config MCUX_HW_DEVICE_ID
    string
    default "MCXA154" if MCUX_HW_DEVICE_ID_MCXA154

config MCUX_HW_DEVICE_PART
    string
    default "MCXA154VPJ" if MCUX_HW_DEVICE_PART_MCXA154VPJ
    default "MCXA154VLL" if MCUX_HW_DEVICE_PART_MCXA154VLL
    default "MCXA154VMP" if MCUX_HW_DEVICE_PART_MCXA154VMP
    default "MCXA154VLH" if MCUX_HW_DEVICE_PART_MCXA154VLH
    default "MCXA154VFT" if MCUX_HW_DEVICE_PART_MCXA154VFT

# For chipmodel generated files
config MCUX_TOOLCHAIN_LINKER_DEVICE_PREFIX
    string
    default "MCXA154" if MCUX_HW_DEVICE_ID_MCXA154

config MCUX_TOOLCHAIN_MCUX_STARTUP
    string
    default "mcxa154"

# Toolchain related

config MCUX_TOOLCHAIN_IAR_CPU_IDENTIFIER
    string
    default "MCXA154" if MCUX_HW_DEVICE_ID_MCXA154

config MCUX_TOOLCHAIN_MDK_CPU_IDENTIFIER
    string
    default "MCXA154VPJ" if MCUX_HW_DEVICE_PART_MCXA154VPJ
    default "MCXA154VLL" if MCUX_HW_DEVICE_PART_MCXA154VLL
    default "MCXA154VMP" if MCUX_HW_DEVICE_PART_MCXA154VMP
    default "MCXA154VLH" if MCUX_HW_DEVICE_PART_MCXA154VLH
    default "MCXA154VFT" if MCUX_HW_DEVICE_PART_MCXA154VFT

config MCUX_TOOLCHAIN_JLINK_CPU_IDENTIFIER
    string
    default "MCXA154" if MCUX_HW_DEVICE_ID_MCXA154

# ip information
config MCUX_HW_IP_DriverType_AOI
    bool
    default y
    depends on MCUX_HW_DEVICE_ID_MCXA154

config MCUX_HW_IP_DriverType_CDOG
    bool
    default y
    depends on MCUX_HW_DEVICE_ID_MCXA154

config MCUX_HW_IP_DriverType_CRC
    bool
    default y
    depends on MCUX_HW_DEVICE_ID_MCXA154

config MCUX_HW_IP_DriverType_CTIMER
    bool
    default y
    depends on MCUX_HW_DEVICE_ID_MCXA154

config MCUX_HW_IP_DriverType_DBGMB
    bool
    default y
    depends on MCUX_HW_DEVICE_ID_MCXA154

config MCUX_HW_IP_DriverType_EDMA3
    bool
    default y
    depends on MCUX_HW_DEVICE_ID_MCXA154

config MCUX_HW_IP_DriverType_EIM
    bool
    default y
    depends on MCUX_HW_DEVICE_ID_MCXA154

config MCUX_HW_IP_DriverType_EQDC
    bool
    default y
    depends on MCUX_HW_DEVICE_ID_MCXA154

config MCUX_HW_IP_DriverType_ERM
    bool
    default y
    depends on MCUX_HW_DEVICE_ID_MCXA154

config MCUX_HW_IP_DriverType_FLEXCAN
    bool
    default y
    depends on MCUX_HW_DEVICE_ID_MCXA154

config MCUX_HW_IP_DriverType_FLEXIO
    bool
    default y
    depends on MCUX_HW_DEVICE_ID_MCXA154

config MCUX_HW_IP_DriverType_FMC
    bool
    default y
    depends on MCUX_HW_DEVICE_ID_MCXA154

config MCUX_HW_IP_DriverType_FMU
    bool
    default y
    depends on MCUX_HW_DEVICE_ID_MCXA154

config MCUX_HW_IP_DriverType_FREQME
    bool
    default y
    depends on MCUX_HW_DEVICE_ID_MCXA154

config MCUX_HW_IP_DriverType_GLIKEY
    bool
    default y
    depends on MCUX_HW_DEVICE_ID_MCXA154

config MCUX_HW_IP_DriverType_GPIO
    bool
    default y
    depends on MCUX_HW_DEVICE_ID_MCXA154

config MCUX_HW_IP_DriverType_I3C
    bool
    default y
    depends on MCUX_HW_DEVICE_ID_MCXA154

config MCUX_HW_IP_DriverType_INPUTMUX
    bool
    default y
    depends on MCUX_HW_DEVICE_ID_MCXA154

config MCUX_HW_IP_DriverType_LPADC
    bool
    default y
    depends on MCUX_HW_DEVICE_ID_MCXA154

config MCUX_HW_IP_DriverType_LPCMP
    bool
    default y
    depends on MCUX_HW_DEVICE_ID_MCXA154

config MCUX_HW_IP_DriverType_LPC_SWD
    bool
    default y
    depends on MCUX_HW_DEVICE_ID_MCXA154

config MCUX_HW_IP_DriverType_LPC_SYSCON
    bool
    default y
    depends on MCUX_HW_DEVICE_ID_MCXA154

config MCUX_HW_IP_DriverType_LPDAC
    bool
    default y
    depends on MCUX_HW_DEVICE_ID_MCXA154

config MCUX_HW_IP_DriverType_LPI2C
    bool
    default y
    depends on MCUX_HW_DEVICE_ID_MCXA154

config MCUX_HW_IP_DriverType_LPSPI
    bool
    default y
    depends on MCUX_HW_DEVICE_ID_MCXA154

config MCUX_HW_IP_DriverType_LPTMR
    bool
    default y
    depends on MCUX_HW_DEVICE_ID_MCXA154

config MCUX_HW_IP_DriverType_LPUART
    bool
    default y
    depends on MCUX_HW_DEVICE_ID_MCXA154

config MCUX_HW_IP_DriverType_MCX_CMC
    bool
    default y
    depends on MCUX_HW_DEVICE_ID_MCXA154

config MCUX_HW_IP_DriverType_MCX_SPC
    bool
    default y
    depends on MCUX_HW_DEVICE_ID_MCXA154

config MCUX_HW_IP_DriverType_MCX_VBAT
    bool
    default y
    depends on MCUX_HW_DEVICE_ID_MCXA154

config MCUX_HW_IP_DriverType_MRCC
    bool
    default y
    depends on MCUX_HW_DEVICE_ID_MCXA154

config MCUX_HW_IP_DriverType_OPAMP
    bool
    default y
    depends on MCUX_HW_DEVICE_ID_MCXA154

config MCUX_HW_IP_DriverType_OSTIMER
    bool
    default y
    depends on MCUX_HW_DEVICE_ID_MCXA154

config MCUX_HW_IP_DriverType_PORT
    bool
    default y
    depends on MCUX_HW_DEVICE_ID_MCXA154

config MCUX_HW_IP_DriverType_PWM
    bool
    default y
    depends on MCUX_HW_DEVICE_ID_MCXA154

config MCUX_HW_IP_DriverType_SCG
    bool
    default y
    depends on MCUX_HW_DEVICE_ID_MCXA154

config MCUX_HW_IP_DriverType_TRDC_1
    bool
    default y
    depends on MCUX_HW_DEVICE_ID_MCXA154

config MCUX_HW_IP_DriverType_USB_DEVICE_KHCI
    bool
    default y
    depends on MCUX_HW_DEVICE_ID_MCXA154

config MCUX_HW_IP_DriverType_UTICK
    bool
    default y
    depends on MCUX_HW_DEVICE_ID_MCXA154

config MCUX_HW_IP_DriverType_WAKETIMER
    bool
    default y
    depends on MCUX_HW_DEVICE_ID_MCXA154

config MCUX_HW_IP_DriverType_WUU
    bool
    default y
    depends on MCUX_HW_DEVICE_ID_MCXA154

config MCUX_HW_IP_DriverType_WWDT
    bool
    default y
    depends on MCUX_HW_DEVICE_ID_MCXA154
```

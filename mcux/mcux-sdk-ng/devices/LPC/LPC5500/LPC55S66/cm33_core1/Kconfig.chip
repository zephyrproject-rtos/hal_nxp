## mcux/mcux-sdk-ng/devices/LPC/LPC800/LPC824/Kconfig.chip
```kconfig
# Copyright 2024 NXP
#
# SPDX-License-Identifier: BSD-3-Clause

# core related
config MCUX_HW_CORE
    string
    default "cm0p"

config MCUX_HW_CORE_CM0P
    bool
    default y

config MCUX_HW_CORE_ID
    string
    default "core0"

config MCUX_HW_CORE_ID_CORE0
    bool
    default y

config MCUX_HW_DEVICE_CORE
    string
    default "LPC824"

config MCUX_HW_FPU
    string
    default "NO_FPU"

config MCUX_HW_FPU_TYPE
    string
    default "no_fpu"

config MCUX_HW_NO_FPU
    bool
    default y

config MCUX_HW_INT_PRIO_BITS
    int
    default 2

config MCUX_HW_SOC_SERIES_LPC
    bool
    default y

config MCUX_HW_SOC_SINGLECORE_DEVICE
    bool
    default y

# device related

config MCUX_HW_DEVICE_ID_LPC824
    bool

choice MCUX_HW_DEVICE_PART_LPC824
    prompt "Device LPC824 Part"
    config MCUX_HW_DEVICE_PART_LPC824M201JHI33
    bool "Device part LPC824M201JHI33"
    select MCUX_HW_DEVICE_ID_LPC824
    config MCUX_HW_DEVICE_PART_LPC824M201JDH20
    bool "Device part LPC824M201JDH20"
    select MCUX_HW_DEVICE_ID_LPC824
endchoice

config MCUX_HW_DEVICE_ID
    string
    default "LPC824" if MCUX_HW_DEVICE_ID_LPC824

config MCUX_HW_DEVICE_PART
    string
    default "LPC824M201JHI33" if MCUX_HW_DEVICE_PART_LPC824M201JHI33
    default "LPC824M201JDH20" if MCUX_HW_DEVICE_PART_LPC824M201JDH20

# For chipmodel generated files
config MCUX_TOOLCHAIN_LINKER_DEVICE_PREFIX
    string
    default "LPC824" if MCUX_HW_DEVICE_ID_LPC824

config MCUX_TOOLCHAIN_MCUX_STARTUP
    string
    default "lpc824"

# Toolchain related

config MCUX_TOOLCHAIN_IAR_CPU_IDENTIFIER
    string
    default "LPC824M201" if MCUX_HW_DEVICE_ID_LPC824

config MCUX_TOOLCHAIN_MDK_CPU_IDENTIFIER
    string
    default "LPC824M201JHI33" if MCUX_HW_DEVICE_PART_LPC824M201JHI33
    default "LPC824M201JDH20" if MCUX_HW_DEVICE_PART_LPC824M201JDH20

config MCUX_TOOLCHAIN_JLINK_CPU_IDENTIFIER
    string
    default "LPC824" if MCUX_HW_DEVICE_ID_LPC824

# ip information
config MCUX_HW_IP_DriverType_ACOMP
    bool
    default y
    depends on MCUX_HW_DEVICE_ID_LPC824

config MCUX_HW_IP_DriverType_ADC12_5M
    bool
    default y
    depends on MCUX_HW_DEVICE_ID_LPC824

config MCUX_HW_IP_DriverType_FLEXCOMM_I2C
    bool
    default y
    depends on MCUX_HW_DEVICE_ID_LPC824

config MCUX_HW_IP_DriverType_FLEXCOMM_USART
    bool
    default y
    depends on MCUX_HW_DEVICE_ID_LPC824

config MCUX_HW_IP_DriverType_GPIO_PORT
    bool
    default y
    depends on MCUX_HW_DEVICE_ID_LPC824

config MCUX_HW_IP_DriverType_I2C_SERIALIF
    bool
    default y
    depends on MCUX_HW_DEVICE_ID_LPC824

config MCUX_HW_IP_DriverType_IAP
    bool
    default y
    depends on MCUX_HW_DEVICE_ID_LPC824

config MCUX_HW_IP_DriverType_INPUTMUX
    bool
    default y
    depends on MCUX_HW_DEVICE_ID_LPC824

config MCUX_HW_IP_DriverType_IOCON_LITE
    bool
    default y
    depends on MCUX_HW_DEVICE_ID_LPC824

config MCUX_HW_IP_DriverType_LPC_CLOCK
    bool
    default y
    depends on MCUX_HW_DEVICE_ID_LPC824

config MCUX_HW_IP_DriverType_LPC_FLASH_CTRL
    bool
    default y
    depends on MCUX_HW_DEVICE_ID_LPC824

config MCUX_HW_IP_DriverType_LPC_MTB
    bool
    default y
    depends on MCUX_HW_DEVICE_ID_LPC824

config MCUX_HW_IP_DriverType_LPC_NVIC
    bool
    default y
    depends on MCUX_HW_DEVICE_ID_LPC824

config MCUX_HW_IP_DriverType_LPC_PMU
    bool
    default y
    depends on MCUX_HW_DEVICE_ID_LPC824

config MCUX_HW_IP_DriverType_MCO_CRC
    bool
    default y
    depends on MCUX_HW_DEVICE_ID_LPC824

config MCUX_HW_IP_DriverType_MINI_SPI
    bool
    default y
    depends on MCUX_HW_DEVICE_ID_LPC824

config MCUX_HW_IP_DriverType_MINI_USART
    bool
    default y
    depends on MCUX_HW_DEVICE_ID_LPC824

config MCUX_HW_IP_DriverType_MRT
    bool
    default y
    depends on MCUX_HW_DEVICE_ID_LPC824

config MCUX_HW_IP_DriverType_PINT
    bool
    default y
    depends on MCUX_HW_DEVICE_ID_LPC824

config MCUX_HW_IP_DriverType_SCTIMER
    bool
    default y
    depends on MCUX_HW_DEVICE_ID_LPC824

config MCUX_HW_IP_DriverType_SDMA
    bool
    default y
    depends on MCUX_HW_DEVICE_ID_LPC824

config MCUX_HW_IP_DriverType_SWM
    bool
    default y
    depends on MCUX_HW_DEVICE_ID_LPC824

config MCUX_HW_IP_DriverType_SYSCON
    bool
    default y
    depends on MCUX_HW_DEVICE_ID_LPC824

config MCUX_HW_IP_DriverType_WKT
    bool
    default y
    depends on MCUX_HW_DEVICE_ID_LPC824

config MCUX_HW_IP_DriverType_WWDT
    bool
    default y
    depends on MCUX_HW_DEVICE_ID_LPC824
```

## mcux/mcux-sdk-ng/devices/LPC/LPC800/LPC832/Kconfig.chip
```kconfig
# Copyright 2024 NXP
#
# SPDX-License-Identifier: BSD-3-Clause

# core related
config MCUX_HW_CORE
    string
    default "cm0p"

config MCUX_HW_CORE_CM0P
    bool
    default y

config MCUX_HW_CORE_ID
    string
    default "core0"

config MCUX_HW_CORE_ID_CORE0
    bool
    default y

config MCUX_HW_DEVICE_CORE
    string
    default "LPC832"

config MCUX_HW_FPU
    string
    default "NO_FPU"

config MCUX_HW_FPU_TYPE
    string
    default "no_fpu"

config MCUX_HW_NO_FPU
    bool
    default y

config MCUX_HW_INT_PRIO_BITS
    int
    default 2

config MCUX_HW_SOC_SERIES_LPC
    bool
    default y

config MCUX_HW_SOC_SINGLECORE_DEVICE
    bool
    default y

# device related

config MCUX_HW_DEVICE_ID_LPC832
    bool

choice MCUX_HW_DEVICE_PART_LPC832
    prompt "Device LPC832 Part"
    config MCUX_HW_DEVICE_PART_LPC832M101FDH20
    bool "Device part LPC832M101FDH20"
    select MCUX_HW_DEVICE_ID_LPC832
endchoice

config MCUX_HW_DEVICE_ID
    string
    default "LPC832" if MCUX_HW_DEVICE_ID_LPC832

config MCUX_HW_DEVICE_PART
    string
    default "LPC832M101FDH20" if MCUX_HW_DEVICE_PART_LPC832M101FDH20

# For chipmodel generated files
config MCUX_TOOLCHAIN_LINKER_DEVICE_PREFIX
    string
    default "LPC832" if MCUX_HW_DEVICE_ID_LPC832

config MCUX_TOOLCHAIN_MCUX_STARTUP
    string
    default "lpc832"

# Toolchain related

config MCUX_TOOLCHAIN_IAR_CPU_IDENTIFIER
    string
    default "LPC832M101" if MCUX_HW_DEVICE_ID_LPC832

config MCUX_TOOLCHAIN_MDK_CPU_IDENTIFIER
    string
    default "LPC832M101FDH20" if MCUX_HW_DEVICE_PART_LPC832M101FDH20

config MCUX_TOOLCHAIN_JLINK_CPU_IDENTIFIER
    string
    default "LPC832" if MCUX_HW_DEVICE_ID_LPC832

# ip information
config MCUX_HW_IP_DriverType_ACOMP
    bool
    default y
    depends on MCUX_HW_DEVICE_ID_LPC832

config MCUX_HW_IP_DriverType_ADC12_5M
    bool
    default y
    depends on MCUX_HW_DEVICE_ID_LPC832

config MCUX_HW_IP_DriverType_FLEXCOMM_I2C
    bool
    default y
    depends on MCUX_HW_DEVICE_ID_LPC832

config MCUX_HW_IP_DriverType_FLEXCOMM_USART
    bool
    default y
    depends on MCUX_HW_DEVICE_ID_LPC832

config MCUX_HW_IP_DriverType_GPIO_PORT
    bool
    default y
    depends on MCUX_HW_DEVICE_ID_LPC832

config MCUX_HW_IP_DriverType_I2C_SERIALIF
    bool
    default y
    depends on MCUX_HW_DEVICE_ID_LPC832

config MCUX_HW_IP_DriverType_IAP
    bool
    default y
    depends on MCUX_HW_DEVICE_ID_LPC832

config MCUX_HW_IP_DriverType_INPUTMUX
    bool
    default y
    depends on MCUX_HW_DEVICE_ID_LPC832

config MCUX_HW_IP_DriverType_IOCON_LITE
    bool
    default y
    depends on MCUX_HW_DEVICE_ID_LPC832

config MCUX_HW_IP_DriverType_LPC_CLOCK
    bool
    default y
    depends on MCUX_HW_DEVICE_ID_LPC832

config MCUX_HW_IP_DriverType_LPC_FLASH_CTRL
    bool
    default y
    depends on MCUX_HW_DEVICE_ID_LPC832

config MCUX_HW_IP_DriverType_LPC_MTB
    bool
    default y
    depends on MCUX_HW_DEVICE_ID_LPC832

config MCUX_HW_IP_DriverType_LPC_NVIC
    bool
    default y
    depends on MCUX_HW_DEVICE_ID_LPC832

config MCUX_HW_IP_DriverType_LPC_PMU
    bool
    default y
    depends on MCUX_HW_DEVICE_ID_LPC832

config MCUX_HW_IP_DriverType_MCO_CRC
    bool
    default y
    depends on MCUX_HW_DEVICE_ID_LPC832

config MCUX_HW_IP_DriverType_MINI_SPI
    bool
    default y
    depends on MCUX_HW_DEVICE_ID_LPC832

config MCUX_HW_IP_DriverType_MINI_USART
    bool
    default y
    depends on MCUX_HW_DEVICE_ID_LPC832

config MCUX_HW_IP_DriverType_MRT
    bool
    default y
    depends on MCUX_HW_DEVICE_ID_LPC832

config MCUX_HW_IP_DriverType_PINT
    bool
    default y
    depends on MCUX_HW_DEVICE_ID_LPC832

config MCUX_HW_IP_DriverType_SCTIMER
    bool
    default y
    depends on MCUX_HW_DEVICE_ID_LPC832

config MCUX_HW_IP_DriverType_SDMA
    bool
    default y
    depends on MCUX_HW_DEVICE_ID_LPC832

config MCUX_HW_IP_DriverType_SWM
    bool
    default y
    depends on MCUX_HW_DEVICE_ID_LPC832

config MCUX_HW_IP_DriverType_SYSCON
    bool
    default y
    depends on MCUX_HW_DEVICE_ID_LPC832

config MCUX_HW_IP_DriverType_WKT
    bool
    default y
    depends on MCUX_HW_DEVICE_ID_LPC832

config MCUX_HW_IP_DriverType_WWDT
    bool
    default y
    depends on MCUX_HW_DEVICE_ID_LPC832
```

## mcux/mcux-sdk-ng/devices/LPC/LPC800/LPC834/Kconfig.chip
```kconfig
# Copyright 2024 NXP
#
# SPDX-License-Identifier: BSD-3-Clause

# core related
config MCUX_HW_CORE
    string
    default "cm0p"

config MCUX_HW_CORE_CM0P
    bool
    default y

config MCUX_HW_CORE_ID
    string
    default "core0"

config MCUX_HW_CORE_ID_CORE0
    bool
    default y

config MCUX_HW_DEVICE_CORE
    string
    default "LPC834"

config MCUX_HW_FPU
    string
    default "NO_FPU"

config MCUX_HW_FPU_TYPE
    string
    default "no_fpu"

config MCUX_HW_NO_FPU
    bool
    default y

config MCUX_HW_INT_PRIO_BITS
    int
    default 2

config MCUX_HW_SOC_SERIES_LPC
    bool
    default y

config MCUX_HW_SOC_SINGLECORE_DEVICE
    bool
    default y

# device related

config MCUX_HW_DEVICE_ID_LPC834
    bool

choice MCUX_HW_DEVICE_PART_LPC834
    prompt "Device LPC834 Part"
    config MCUX_HW_DEVICE_PART_LPC834M101FHI33
    bool "Device part LPC834M101FHI33"
    select MCUX_HW_DEVICE_ID_LPC834
endchoice

config MCUX_HW_DEVICE_ID
    string
    default "LPC834" if MCUX_HW_DEVICE_ID_LPC834

config MCUX_HW_DEVICE_PART
    string
    default "LPC834M101FHI33" if MCUX_HW_DEVICE_PART_LPC834M101FHI33

# For chipmodel generated files
config MCUX_TOOLCHAIN_LINKER_DEVICE_PREFIX
    string
    default "LPC834" if MCUX_HW_DEVICE_ID_LPC834

config MCUX_TOOLCHAIN_MCUX_STARTUP
    string
    default "lpc834"

# Toolchain related

config MCUX_TOOLCHAIN_IAR_CPU_IDENTIFIER
    string
    default "LPC834M101" if MCUX_HW_DEVICE_ID_LPC834

config MCUX_TOOLCHAIN_MDK_CPU_IDENTIFIER
    string
    default "LPC834M101FHI33" if MCUX_HW_DEVICE_PART_LPC834M101FHI33

config MCUX_TOOLCHAIN_JLINK_CPU_IDENTIFIER
    string
    default "LPC834" if MCUX_HW_DEVICE_ID_LPC834

# ip information
config MCUX_HW_IP_DriverType_ACOMP
    bool
    default y
    depends on MCUX_HW_DEVICE_ID_LPC834

config MCUX_HW_IP_DriverType_ADC12_5M
    bool
    default y
    depends on MCUX_HW_DEVICE_ID_LPC834

config MCUX_HW_IP_DriverType_FLEXCOMM_I2C
    bool
    default y
    depends on MCUX_HW_DEVICE_ID_LPC834

config MCUX_HW_IP_DriverType_FLEXCOMM_USART
    bool
    default y
    depends on MCUX_HW_DEVICE_ID_LPC834

config MCUX_HW_IP_DriverType_GPIO_PORT
    bool
    default y
    depends on MCUX_HW_DEVICE_ID_LPC834

config MCUX_HW_IP_DriverType_I2C_SERIALIF
    bool
    default y
    depends on MCUX_HW_DEVICE_ID_LPC834

config MCUX_HW_IP_DriverType_IAP
    bool
    default y
    depends on MCUX_HW_DEVICE_ID_LPC834

config MCUX_HW_IP_DriverType_INPUTMUX
    bool
    default y
    depends on MCUX_HW_DEVICE_ID_LPC834

config MCUX_HW_IP_DriverType_IOCON_LITE
    bool
    default y
    depends on MCUX_HW_DEVICE_ID_LPC834

config MCUX_HW_IP_DriverType_LPC_CLOCK
    bool
    default y
    depends on MCUX_HW_DEVICE_ID_LPC834

config MCUX_HW_IP_DriverType_LPC_FLASH_CTRL
    bool
    default y
    depends on MCUX_HW_DEVICE_ID_LPC834

config MCUX_HW_IP_DriverType_LPC_MTB
    bool
    default y
    depends on MCUX_HW_DEVICE_ID_LPC834

config MCUX_HW_IP_DriverType_LPC_NVIC
    bool
    default y
    depends on MCUX_HW_DEVICE_ID_LPC834

config MCUX_HW_IP_DriverType_LPC_PMU
    bool
    default y
    depends on MCUX_HW_DEVICE_ID_LPC834

config MCUX_HW_IP_DriverType_MCO_CRC
    bool
    default y
    depends on MCUX_HW_DEVICE_ID_LPC834

config MCUX_HW_IP_DriverType_MINI_SPI
    bool
    default y
    depends on MCUX_HW_DEVICE_ID_LPC834

config MCUX_HW_IP_DriverType_MINI_USART
    bool
    default y
    depends on MCUX_HW_DEVICE_ID_LPC834

config MCUX_HW_IP_DriverType_MRT
    bool
    default y
    depends on MCUX_HW_DEVICE_ID_LPC834

config MCUX_HW_IP_DriverType_PINT
    bool
    default y
    depends on MCUX_HW_DEVICE_ID_LPC834

config MCUX_HW_IP_DriverType_SCTIMER
    bool
    default y
    depends on MCUX_HW_DEVICE_ID_LPC834

config MCUX_HW_IP_DriverType_SDMA
    bool
    default y
    depends on MCUX_HW_DEVICE_ID_LPC834

config MCUX_HW_IP_DriverType_SWM
    bool
    default y
    depends on MCUX_HW_DEVICE_ID_LPC834

config MCUX_HW_IP_DriverType_SYSCON
    bool
    default y
    depends on MCUX_HW_DEVICE_ID_LPC834

config MCUX_HW_IP_DriverType_WKT
    bool
    default y
    depends on MCUX_HW_DEVICE_ID_LPC834

config MCUX_HW_IP_DriverType_WWDT
    bool
    default y
    depends on MCUX_HW_DEVICE_ID_LPC834
```

## mcux/mcux-sdk-ng/devices/Kinetis/KM/MKM34ZA5/Kconfig.chip
```kconfig
# Copyright 2024 NXP
#
# SPDX-License-Identifier: BSD-3-Clause

# core related
config MCUX_HW_CORE
    string
    default "cm0p"

config MCUX_HW_CORE_CM0P
    bool
    default y

config MCUX_HW_CORE_ID
    string
    default "core0"

config MCUX_HW_CORE_ID_CORE0
    bool
    default y

config MCUX_HW_DEVICE_CORE
    string
    default "MKM34ZA5"

config MCUX_HW_FPU
    string
    default "NO_FPU"

config MCUX_HW_FPU_TYPE
    string
    default "no_fpu"

config MCUX_HW_NO_FPU
    bool
    default y

config MCUX_HW_INT_PRIO_BITS
    int
    default 2

config MCUX_HW_SOC_SERIES_KINETIS
    bool
    default y

config MCUX_HW_SOC_SINGLECORE_DEVICE
    bool
    default y

# device related

config MCUX_HW_DEVICE_ID_MKM34Z128Axxx5
    bool

choice
    prompt "Device MKM34ZA5 Part"
    config MCUX_HW_DEVICE_PART_MKM34Z128ACLL5
    bool "Device part MKM34Z128ACLL5"
    select MCUX_HW_DEVICE_ID_MKM34Z128Axxx5
endchoice

config MCUX_HW_DEVICE_ID
    string
    default "MKM34Z128Axxx5" if MCUX_HW_DEVICE_ID_MKM34Z128Axxx5

config MCUX_HW_DEVICE_PART
    string
    default "MKM34Z128ACLL5" if MCUX_HW_DEVICE_PART_MKM34Z128ACLL5

# For chipmodel generated files
config MCUX_TOOLCHAIN_LINKER_DEVICE_PREFIX
    string
    default "MKM34Z128Axxx5" if MCUX_HW_DEVICE_ID_MKM34Z128Axxx5

config MCUX_TOOLCHAIN_MCUX_STARTUP
    string
    default "mkm34za5"

# Toolchain related

config MCUX_TOOLCHAIN_IAR_CPU_IDENTIFIER
    string
    default "MKM34Z128Axxx5" if MCUX_HW_DEVICE_ID_MKM34Z128Axxx5

config MCUX_TOOLCHAIN_MDK_CPU_IDENTIFIER
    string
    default "MKM34Z128ACLL5" if MCUX_HW_DEVICE_PART_MKM34Z128ACLL5

config MCUX_TOOLCHAIN_JLINK_CPU_IDENTIFIER
    string
    default "MKM34Z128Axxx5"

# ip information
config MCUX_HW_IP_DriverType_ADC16
    bool
    default y
    depends on MCUX_HW_DEVICE_ID_MKM34Z128Axxx5

config MCUX_HW_IP_DriverType_AFE
    bool
    default y
    depends on MCUX_HW_DEVICE_ID_MKM34Z128Axxx5

config MCUX_HW_IP_DriverType_AIPS
    bool
    default y
    depends on MCUX_HW_DEVICE_ID_MKM34Z128Axxx5

config MCUX_HW_IP_DriverType_CMP
    bool
    default y
    depends on MCUX_HW_DEVICE_ID_MKM34Z128Axxx5

config MCUX_HW_IP_DriverType_CRC
    bool
    default y
    depends on MCUX_HW_DEVICE_ID_MKM34Z128Axxx5

config MCUX_HW_IP_DriverType_DMA
    bool
    default y
    depends on MCUX_HW_DEVICE_ID_MKM34Z128Axxx5

config MCUX_HW_IP_DriverType_DMAMUX
    bool
    default y
    depends on MCUX_HW_DEVICE_ID_MKM34Z128Axxx5

config MCUX_HW_IP_DriverType_EWM
    bool
    default y
    depends on MCUX_HW_DEVICE_ID_MKM34Z128Axxx5

config MCUX_HW_IP_DriverType_FTFA
    bool
    default y
    depends on MCUX_HW_DEVICE_ID_MKM34Z128Axxx5

config MCUX_HW_IP_DriverType_GPIO
    bool
    default y
    depends on MCUX_HW_DEVICE_ID_MKM34Z128Axxx5

config MCUX_HW_IP_DriverType_I2C
    bool
    default y
    depends on MCUX_HW_DEVICE_ID_MKM34Z128Axxx5

config MCUX_HW_IP_DriverType_LLWU
    bool
    default y
    depends on MCUX_HW_DEVICE_ID_MKM34Z128Axxx5

config MCUX_HW_IP_DriverType_LPTMR
    bool
    default y
    depends on MCUX_HW_DEVICE_ID_MKM34Z128Axxx5

config MCUX_HW_IP_DriverType_MCG
    bool
    default y
    depends on MCUX_HW_DEVICE_ID_MKM34Z128Axxx5

config MCUX_HW_IP_DriverType_MCM
    bool
    default y
    depends on MCUX_HW_DEVICE_ID_MKM34Z128Axxx5

config MCUX_HW_IP_DriverType_MTB
    bool
    default y
    depends on MCUX_HW_DEVICE_ID_MKM34Z128Axxx5

config MCUX_HW_IP_DriverType_MTBDWT
    bool
    default y
    depends on MCUX_HW_DEVICE_ID_MKM34Z128Axxx5

config MCUX_HW_IP_DriverType_NV
    bool
    default y
    depends on MCUX_HW_DEVICE_ID_MKM34Z128Axxx5

config MCUX_HW_IP_DriverType_OSC
    bool
    default y
    depends on MCUX_HW_DEVICE_ID_MKM34Z128Axxx5

config MCUX_HW_IP_DriverType_PIT
    bool
    default y
    depends on MCUX_HW_DEVICE_ID_MKM34Z128Axxx5

config MCUX_HW_IP_DriverType_PMC
    bool
    default y
    depends on MCUX_HW_DEVICE_ID_MKM34Z128Axxx5

config MCUX_HW_IP_DriverType_PORT
    bool
    default y
    depends on MCUX_HW_DEVICE_ID_MKM34Z128Axxx5

config MCUX_HW_IP_DriverType_RCM
    bool
    default y
    depends on MCUX_HW_DEVICE_ID_MKM34Z128Axxx5

config MCUX_HW_IP_DriverType_RNGA
    bool
    default y
    depends on MCUX_HW_DEVICE_ID_MKM34Z128Axxx5

config MCUX_HW_IP_DriverType_ROM
    bool
    default y
    depends on MCUX_HW_DEVICE_ID_MKM34Z128Axxx5

config MCUX_HW_IP_DriverType_RTC_V2
    bool
    default y
    depends on MCUX_HW_DEVICE_ID_MKM34Z128Axxx5

config MCUX_HW_IP_DriverType_SIM
    bool
    default y
    depends on MCUX_HW_DEVICE_ID_MKM34Z128Axxx5

config MCUX_HW_IP_DriverType_SLCD
    bool
    default y
    depends on MCUX_HW_DEVICE_ID_MKM34Z128Axxx5

config MCUX_HW_IP_DriverType_SMC
    bool
    default y
    depends on MCUX_HW_DEVICE_ID_MKM34Z128Axxx5

config MCUX_HW_IP_DriverType_SPI
    bool
    default y
    depends on MCUX_HW_DEVICE_ID_MKM34Z128Axxx5

config MCUX_HW_IP_DriverType_SYSMPU
    bool
    default y
    depends on MCUX_HW_DEVICE_ID_MKM34Z128Axxx5

config MCUX_HW_IP_DriverType_TMR_2
    bool
    default y
    depends on MCUX_HW_DEVICE_ID_MKM34Z128Axxx5

config MCUX_HW_IP_DriverType_UART_ISO7816
    bool
    default y
    depends on MCUX_HW_DEVICE_ID_MKM34Z128Axxx5

config MCUX_HW_IP_DriverType_VREF
    bool
    default y
    depends on MCUX_HW_DEVICE_ID_MKM34Z128Axxx5

config MCUX_HW_IP_DriverType_WDOG
    bool
    default y
    depends on MCUX_HW_DEVICE_ID_MKM34Z128Axxx5

config MCUX_HW_IP_DriverType_XBAR
    bool
    default y
    depends on MCUX_HW_DEVICE_ID_MKM34Z128Axxx5
```

## mcux/mcux-sdk-ng/devices/Kinetis/KM/MKM35Z7/Kconfig.chip
```kconfig
# Copyright 2024 NXP
#
# SPDX-License-Identifier: BSD-3-Clause

# core related
config MCUX_HW_CORE
    string
    default "cm0p"

config MCUX_HW_CORE_CM0P
    bool
    default y

config MCUX_HW_CORE_ID
    string
    default "core0"

config MCUX_HW_CORE_ID_CORE0
    bool
    default y

config MCUX_HW_DEVICE_CORE
    string
    default "MKM35Z7"

config MCUX_HW_FPU
    string
    default "NO_FPU"

config MCUX_HW_FPU_TYPE
    string
    default "no_fpu"

config MCUX_HW_NO_FPU
    bool
    default y

config MCUX_HW_INT_PRIO_BITS
    int
    default 2

config MCUX_HW_SOC_SERIES_KINETIS
    bool
    default y

config MCUX_HW_SOC_SINGLECORE_DEVICE
    bool
    default y

# device related

config MCUX_HW_DEVICE_ID_MKM35Z512xxx7
    bool

config MCUX_HW_DEVICE_ID_MKM35Z256xxx7
    bool

choice MCUX_HW_DEVICE_PART_MKM35Z7
    prompt "Device MKM35Z7 Part"
    config MCUX_HW_DEVICE_PART_MKM35Z512VLQ7
    bool "Device part MKM35Z512VLQ7"
    select MCUX_HW_DEVICE_ID_MKM35Z512xxx7
    config MCUX_HW_DEVICE_PART_MKM35Z512VLL7
    bool "Device part MKM35Z512VLL7"
    select MCUX_HW_DEVICE_ID_MKM35Z512xxx7
    config MCUX_HW_DEVICE_PART_MKM35Z512VLQ7R
    bool "Device part MKM35Z512VLQ7R"
    select MCUX_HW_DEVICE_ID_MKM35Z512xxx7
    config MCUX_HW_DEVICE_PART_MKM35Z512VLL7R
    bool "Device part MKM35Z512VLL7R"
    select MCUX_HW_DEVICE_ID_MKM35Z512xxx7
    config MCUX_HW_DEVICE_PART_MKM35Z256VLQ7
    bool "Device part MKM35Z256VLQ7"
    select MCUX_HW_DEVICE_ID_MKM35Z256xxx7
    config MCUX_HW_DEVICE_PART_MKM35Z256VLL7
    bool "Device part MKM35Z256VLL7"
    select MCUX_HW_DEVICE_ID_MKM35Z256xxx7
    config MCUX_HW_DEVICE_PART_MKM35Z256VLQ7R
    bool "Device part MKM35Z256VLQ7R"
    select MCUX_HW_DEVICE_ID_MKM35Z256xxx7
    config MCUX_HW_DEVICE_PART_MKM35Z256VLL7R
    bool "Device part MKM35Z256VLL7R"
    select MCUX_HW_DEVICE_ID_MKM35Z256xxx7
endchoice

config MCUX_HW_DEVICE_ID
    string
    default "MKM35Z512xxx7" if MCUX_HW_DEVICE_ID_MKM35Z512xxx7
    default "MKM35Z256xxx7" if MCUX_HW_DEVICE_ID_MKM35Z256xxx7

config MCUX_HW_DEVICE_PART
    string
    default "MKM35Z512VLQ7" if MCUX_HW_DEVICE_PART_MKM35Z512VLQ7
    default "MKM35Z512VLL7" if MCUX_HW_DEVICE_PART_MKM35Z512VLL7
    default "MKM35Z512VLQ7R" if MCUX_HW_DEVICE_PART_MKM35Z512VLQ7R
    default "MKM35Z512VLL7R" if MCUX_HW_DEVICE_PART_MKM35Z512VLL7R
    default "MKM35Z256VLQ7" if MCUX_HW_DEVICE_PART_MKM35Z256VLQ7
    default "MKM35Z256VLL7" if MCUX_HW_DEVICE_PART_MKM35Z256VLL7
    default "MKM35Z256VLQ7R" if MCUX_HW_DEVICE_PART_MKM35Z256VLQ7R
    default "MKM35Z256VLL7R" if MCUX_HW_DEVICE_PART_MKM35Z256VLL7R

# For chipmodel generated files
config MCUX_TOOLCHAIN_LINKER_DEVICE_PREFIX
    string
    default "MKM35Z512xxx7" if MCUX_HW_DEVICE_ID_MKM35Z512xxx7
    default "MKM35Z256xxx7" if MCUX_HW_DEVICE_ID_MKM35Z256xxx7

config MCUX_TOOLCHAIN_MCUX_STARTUP
    string
    default "mkm35z7"

# Toolchain related

config MCUX_TOOLCHAIN_IAR_CPU_IDENTIFIER
    string
    default "MKM35Z512xxx7" if MCUX_HW_DEVICE_ID_MKM35Z512xxx7
    default "MKM35Z256xxx7" if MCUX_HW_DEVICE_ID_MKM35Z256xxx7

config MCUX_TOOLCHAIN_MDK_CPU_IDENTIFIER
    string
    default "MKM35Z512VLQ7" if MCUX_HW_DEVICE_PART_MKM35Z512VLQ7
    default "MKM35Z512VLL7" if MCUX_HW_DEVICE_PART_MKM35Z512VLL7
    default "MKM35Z512VLQ7R" if MCUX_HW_DEVICE_PART_MKM35Z512VLQ7R
    default "MKM35Z512VLL7R" if MCUX_HW_DEVICE_PART_MKM35Z512VLL7R
    default "MKM35Z256VLQ7" if MCUX_HW_DEVICE_PART_MKM35Z256VLQ7
    default "MKM35Z256VLL7" if MCUX_HW_DEVICE_PART_MKM35Z256VLL7
    default "MKM35Z256VLQ7R" if MCUX_HW_DEVICE_PART_MKM35Z256VLQ7R
    default "MKM35Z256VLL7R" if MCUX_HW_DEVICE_PART_MKM35Z256VLL7R

config MCUX_TOOLCHAIN_JLINK_CPU_IDENTIFIER
    string
    default "MKM35Z512xxx7" if MCUX_HW_DEVICE_ID_MKM35Z512xxx7
    default "MKM35Z256xxx7" if MCUX_HW_DEVICE_ID_MKM35Z256xxx7

# ip information
config MCUX_HW_IP_DriverType_ADC16
    bool
    default y
    depends on MCUX_HW_DEVICE_ID_MKM35Z512xxx7 || MCUX_HW_DEVICE_ID_MKM35Z256xxx7

config MCUX_HW_IP_DriverType_AFE
    bool
    default y
    depends on MCUX_HW_DEVICE_ID_MKM35Z512xxx7 || MCUX_HW_DEVICE_ID_MKM35Z256xxx7

config MCUX_HW_IP_DriverType_AIPS
    bool
    default y
    depends on MCUX_HW_DEVICE_ID_MKM35Z512xxx7 || MCUX_HW_DEVICE_ID_MKM35Z256xxx7

config MCUX_HW_IP_DriverType_AXBS
    bool
    default y
    depends on MCUX_HW_DEVICE_ID_MKM35Z512xxx7 || MCUX_HW_DEVICE_ID_MKM35Z256xxx7

config MCUX_HW_IP_DriverType_CMP
    bool
    default y
    depends on MCUX_HW_DEVICE_ID_MKM35Z512xxx7 || MCUX_HW_DEVICE_ID_MKM35Z256xxx7

config MCUX_HW_IP_DriverType_CRC
    bool
    default y
    depends on MCUX_HW_DEVICE_ID_MKM35Z512xxx7 || MCUX_HW_DEVICE_ID_MKM35Z256xxx7

config MCUX_HW_IP_DriverType_DMA
    bool
    default y
    depends on MCUX_HW_DEVICE_ID_MKM35Z512xxx7 || MCUX_HW_DEVICE_ID_MKM35Z256xxx7

config MCUX_HW_IP_DriverType_DMAMUX
    bool
    default y
    depends on MCUX_HW_DEVICE_ID_MKM35Z512xxx7 || MCUX_HW_DEVICE_ID_MKM35Z256xxx7

config MCUX_HW_IP_DriverType_EWM
    bool
    default y
    depends on MCUX_HW_DEVICE_ID_MKM35Z512xxx7 || MCUX_HW_DEVICE_ID_MKM35Z256xxx7

config MCUX_HW_IP_DriverType_FGPIO
    bool
    default y
    depends on MCUX_HW_DEVICE_ID_MKM35Z512xxx7 || MCUX_HW_DEVICE_ID_MKM35Z256xxx7

config MCUX_HW_IP_DriverType_FMC
    bool
    default y
    depends on MCUX_HW_DEVICE_ID_MKM35Z512xxx7 || MCUX_HW_DEVICE_ID_MKM35Z256xxx7

config MCUX_HW_IP_DriverType_FTFA
    bool
    default y
    depends on MCUX_HW_DEVICE_ID_MKM35Z512xxx7 || MCUX_HW_DEVICE_ID_MKM35Z256xxx7

config MCUX_HW_IP_DriverType_GPIO
    bool
    default y
    depends on MCUX_HW_DEVICE_ID_MKM35Z512xxx7 || MCUX_HW_DEVICE_ID_MKM35Z256xxx7

config MCUX_HW_IP_DriverType_I2C
    bool
    default y
    depends on MCUX_HW_DEVICE_ID_MKM35Z512xxx7 || MCUX_HW_DEVICE_ID_MKM35Z256xxx7

config MCUX_HW_IP_DriverType_LLWU
    bool
    default y
    depends on MCUX_HW_DEVICE_ID_MKM35Z512xxx7 || MCUX_HW_DEVICE_ID_MKM35Z256xxx7

config MCUX_HW_IP_DriverType_LPTMR
    bool
    default y
    depends on MCUX_HW_DEVICE_ID_MKM35Z512xxx7 || MCUX_HW_DEVICE_ID_MKM35Z256xxx7

config MCUX_HW_IP_DriverType_LPUART
    bool
    default y
    depends on MCUX_HW_DEVICE_ID_MKM35Z512xxx7 || MCUX_HW_DEVICE_ID_MKM35Z256xxx7

config MCUX_HW_IP_DriverType_MCG
    bool
    default y
    depends on MCUX_HW_DEVICE_ID_MKM35Z512xxx7 || MCUX_HW_DEVICE_ID_MKM35Z256xxx7

config MCUX_HW_IP_DriverType_MCM
    bool
    default y
    depends on MCUX_HW_DEVICE_ID_MKM35Z512xxx7 || MCUX_HW_DEVICE_ID_MKM35Z256xxx7

config MCUX_HW_IP_DriverType_MMAU
    bool
    default y
    depends on MCUX_HW_DEVICE_ID_MKM35Z512xxx7 || MCUX_HW_DEVICE_ID_MKM35Z256xxx7

config MCUX_HW_IP_DriverType_MMCAU
    bool
    default y
    depends on MCUX_HW_DEVICE_ID_MKM35Z512xxx7 || MCUX_HW_DEVICE_ID_MKM35Z256xxx7

config MCUX_HW_IP_DriverType_MTB
    bool
    default y
    depends on MCUX_HW_DEVICE_ID_MKM35Z512xxx7 || MCUX_HW_DEVICE_ID_MKM35Z256xxx7

config MCUX_HW_IP_DriverType_MTBDWT
    bool
    default y
    depends on MCUX_HW_DEVICE_ID_MKM35Z512xxx7 || MCUX_HW_DEVICE_ID_MKM35Z256xxx7

config MCUX_HW_IP_DriverType_NV
    bool
    default y
    depends on MCUX_HW_DEVICE_ID_MKM35Z512xxx7 || MCUX_HW_DEVICE_ID_MKM35Z256xxx7

config MCUX_HW_IP_DriverType_OSC
    bool
    default y
    depends on MCUX_HW_DEVICE_ID_MKM35Z512xxx7 || MCUX_HW_DEVICE_ID_MKM35Z256xxx7

config MCUX_HW_IP_DriverType_PDB
    bool
    default y
    depends on MCUX_HW_DEVICE_ID_MKM35Z512xxx7 || MCUX_HW_DEVICE_ID_MKM35Z256xxx7

config MCUX_HW_IP_DriverType_PIT
    bool
    default y
    depends on MCUX_HW_DEVICE_ID_MKM35Z512xxx7 || MCUX_HW_DEVICE_ID_MKM35Z256xxx7

config MCUX_HW_IP_DriverType_PMC
    bool
    default y
    depends on MCUX_HW_DEVICE_ID_MKM35Z512xxx7 || MCUX_HW_DEVICE_ID_MKM35Z256xxx7

config MCUX_HW_IP_DriverType_PORT
    bool
    default y
    depends on MCUX_HW_DEVICE_ID_MKM35Z512xxx7 || MCUX_HW_DEVICE_ID_MKM35Z256xxx7

config MCUX_HW_IP_DriverType_RCM
    bool
    default y
    depends on MCUX_HW_DEVICE_ID_MKM35Z512xxx7 || MCUX_HW_DEVICE_ID_MKM35Z256xxx7

config MCUX_HW_IP_DriverType_RNGA
    bool
    default y
    depends on MCUX_HW_DEVICE_ID_MKM35Z512xxx7 || MCUX_HW_DEVICE_ID_MKM35Z256xxx7

config MCUX_HW_IP_DriverType_ROM
    bool
    default y
    depends on MCUX_HW_DEVICE_ID_MKM35Z512xxx7 || MCUX_HW_DEVICE_ID_MKM35Z256xxx7

config MCUX_HW_IP_DriverType_RTC_V2
    bool
    default y
    depends on MCUX_HW_DEVICE_ID_MKM35Z512xxx7 || MCUX_HW_DEVICE_ID_MKM35Z256xxx7

config MCUX_HW_IP_DriverType_SIM
    bool
    default y
    depends on MCUX_HW_DEVICE_ID_MKM35Z512xxx7 || MCUX_HW_DEVICE_ID_MKM35Z256xxx7

config MCUX_HW_IP_DriverType_SLCD
    bool
    default y
    depends on MCUX_HW_DEVICE_ID_MKM35Z512xxx7 || MCUX_HW_DEVICE_ID_MKM35Z256xxx7

config MCUX_HW_IP_DriverType_SMC
    bool
    default y
    depends on MCUX_HW_DEVICE_ID_MKM35Z512xxx7 || MCUX_HW_DEVICE_ID_MKM35Z256xxx7

config MCUX_HW_IP_DriverType_SPI
    bool
    default y
    depends on MCUX_HW_DEVICE_ID_MKM35Z512xxx7 || MCUX_HW_DEVICE_ID_MKM35Z256xxx7

config MCUX_HW_IP_DriverType_SYSMPU
    bool
    default y
    depends on MCUX_HW_DEVICE_ID_MKM35Z512xxx7 || MCUX_HW_DEVICE_ID_MKM35Z256xxx7

config MCUX_HW_IP_DriverType_TMR_2
    bool
    default y
    depends on MCUX_HW_DEVICE_ID_MKM35Z512xxx7 || MCUX_HW_DEVICE_ID_MKM35Z256xxx7

config MCUX_HW_IP_DriverType_UART_ISO7816
    bool
    default y
    depends on MCUX_HW_DEVICE_ID_MKM35Z512xxx7 || MCUX_HW_DEVICE_ID_MKM35Z256xxx7

config MCUX_HW_IP_DriverType_VREF
    bool
    default y
    depends on MCUX_HW_DEVICE_ID_MKM35Z512xxx7 || MCUX_HW_DEVICE_ID_MKM35Z256xxx7

config MCUX_HW_IP_DriverType_WDOG
    bool
    default y
    depends on MCUX_HW_DEVICE_ID_MKM35Z512xxx7 || MCUX_HW_DEVICE_ID_MKM35Z256xxx7

config MCUX_HW_IP_DriverType_XBAR
    bool
    default y
    depends on MCUX_HW_DEVICE_ID_MKM35Z512xxx7 || MCUX_HW_DEVICE_ID_MKM35Z256xxx7
```

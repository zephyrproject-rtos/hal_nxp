## mcux/mcux-sdk-ng/devices/Kinetis/KE/MKE15Z4/Kconfig.chip
```kconfig
# Copyright 2024 NXP
#
# SPDX-License-Identifier: BSD-3-Clause

# core related
config MCUX_HW_CORE
    string
    default "cm0p"

config MCUX_HW_CORE_CM0P
    bool
    default y

config MCUX_HW_CORE_ID
    string
    default "core0"

config MCUX_HW_CORE_ID_CORE0
    bool
    default y

config MCUX_HW_DEVICE_CORE
    string
    default "MKE15Z4"

config MCUX_HW_FPU
    string
    default "NO_FPU"

config MCUX_HW_FPU_TYPE
    string
    default "no_fpu"

config MCUX_HW_NO_FPU
    bool
    default y

config MCUX_HW_INT_PRIO_BITS
    int
    default 2

config MCUX_HW_SOC_SERIES_KINETIS
    bool
    default y

config MCUX_HW_SOC_SINGLECORE_DEVICE
    bool
    default y

# device related

config MCUX_HW_DEVICE_ID_MKE15Z64xxx4
    bool

config MCUX_HW_DEVICE_ID_MKE15Z32xxx4
    bool

choice
    prompt "Device MKE15Z4 Part"
    config MCUX_HW_DEVICE_PART_MKE15Z64VLF4
    bool "Device part MKE15Z64VLF4"
    select MCUX_HW_DEVICE_ID_MKE15Z64xxx4
    config MCUX_HW_DEVICE_PART_MKE15Z64VLD4
    bool "Device part MKE15Z64VLD4"
    select MCUX_HW_DEVICE_ID_MKE15Z64xxx4
    config MCUX_HW_DEVICE_PART_MKE15Z64VFP4
    bool "Device part MKE15Z64VFP4"
    select MCUX_HW_DEVICE_ID_MKE15Z64xxx4
    config MCUX_HW_DEVICE_PART_MKE15Z32VLF4
    bool "Device part MKE15Z32VLF4"
    select MCUX_HW_DEVICE_ID_MKE15Z32xxx4
    config MCUX_HW_DEVICE_PART_MKE15Z32VLD4
    bool "Device part MKE15Z32VLD4"
    select MCUX_HW_DEVICE_ID_MKE15Z32xxx4
    config MCUX_HW_DEVICE_PART_MKE15Z32VFP4
    bool "Device part MKE15Z32VFP4"
    select MCUX_HW_DEVICE_ID_MKE15Z32xxx4
endchoice

config MCUX_HW_DEVICE_ID
    string
    default "MKE15Z64xxx4" if MCUX_HW_DEVICE_ID_MKE15Z64xxx4
    default "MKE15Z32xxx4" if MCUX_HW_DEVICE_ID_MKE15Z32xxx4

config MCUX_HW_DEVICE_PART
    string
    default "MKE15Z64VLF4" if MCUX_HW_DEVICE_PART_MKE15Z64VLF4
    default "MKE15Z64VLD4" if MCUX_HW_DEVICE_PART_MKE15Z64VLD4
    default "MKE15Z64VFP4" if MCUX_HW_DEVICE_PART_MKE15Z64VFP4
    default "MKE15Z32VLF4" if MCUX_HW_DEVICE_PART_MKE15Z32VLF4
    default "MKE15Z32VLD4" if MCUX_HW_DEVICE_PART_MKE15Z32VLD4
    default "MKE15Z32VFP4" if MCUX_HW_DEVICE_PART_MKE15Z32VFP4

# For chipmodel generated files
config MCUX_TOOLCHAIN_LINKER_DEVICE_PREFIX
    string
    default "MKE15Z64xxx4" if MCUX_HW_DEVICE_ID_MKE15Z64xxx4
    default "MKE15Z32xxx4" if MCUX_HW_DEVICE_ID_MKE15Z32xxx4

config MCUX_TOOLCHAIN_MCUX_STARTUP
    string
    default "mke15z4"

# Toolchain related

config MCUX_TOOLCHAIN_IAR_CPU_IDENTIFIER
    string
    default "MKE15Z64xxx4" if MCUX_HW_DEVICE_ID_MKE15Z64xxx4
    default "MKE15Z32xxx4" if MCUX_HW_DEVICE_ID_MKE15Z32xxx4

config MCUX_TOOLCHAIN_MDK_CPU_IDENTIFIER
    string
    default "MKE15Z64VLF4" if MCUX_HW_DEVICE_PART_MKE15Z64VLF4
    default "MKE15Z64VLD4" if MCUX_HW_DEVICE_PART_MKE15Z64VLD4
    default "MKE15Z64VFP4" if MCUX_HW_DEVICE_PART_MKE15Z64VFP4
    default "MKE15Z32VLF4" if MCUX_HW_DEVICE_PART_MKE15Z32VLF4
    default "MKE15Z32VLD4" if MCUX_HW_DEVICE_PART_MKE15Z32VLD4
    default "MKE15Z32VFP4" if MCUX_HW_DEVICE_PART_MKE15Z32VFP4

config MCUX_TOOLCHAIN_JLINK_CPU_IDENTIFIER
    string
    default "MKE15Z64xxx4" if MCUX_HW_DEVICE_ID_MKE15Z64xxx4
    default "MKE15Z32xxx4" if MCUX_HW_DEVICE_ID_MKE15Z32xxx4

# ip information
config MCUX_HW_IP_DriverType_ACMP
    bool
    default y
    depends on MCUX_HW_DEVICE_ID_MKE15Z64xxx4 || MCUX_HW_DEVICE_ID_MKE15Z32xxx4

config MCUX_HW_IP_DriverType_ADC12
    bool
    default y
    depends on MCUX_HW_DEVICE_ID_MKE15Z64xxx4 || MCUX_HW_DEVICE_ID_MKE15Z32xxx4

config MCUX_HW_IP_DriverType_CRC
    bool
    default y
    depends on MCUX_HW_DEVICE_ID_MKE15Z64xxx4 || MCUX_HW_DEVICE_ID_MKE15Z32xxx4

config MCUX_HW_IP_DriverType_EWM
    bool
    default y
    depends on MCUX_HW_DEVICE_ID_MKE15Z64xxx4 || MCUX_HW_DEVICE_ID_MKE15Z32xxx4

config MCUX_HW_IP_DriverType_FGPIO
    bool
    default y
    depends on MCUX_HW_DEVICE_ID_MKE15Z64xxx4 || MCUX_HW_DEVICE_ID_MKE15Z32xxx4

config MCUX_HW_IP_DriverType_FTFA
    bool
    default y
    depends on MCUX_HW_DEVICE_ID_MKE15Z64xxx4 || MCUX_HW_DEVICE_ID_MKE15Z32xxx4

config MCUX_HW_IP_DriverType_FTM
    bool
    default y
    depends on MCUX_HW_DEVICE_ID_MKE15Z64xxx4 || MCUX_HW_DEVICE_ID_MKE15Z32xxx4

config MCUX_HW_IP_DriverType_GPIO
    bool
    default y
    depends on MCUX_HW_DEVICE_ID_MKE15Z64xxx4 || MCUX_HW_DEVICE_ID_MKE15Z32xxx4

config MCUX_HW_IP_DriverType_LPI2C
    bool
    default y
    depends on MCUX_HW_DEVICE_ID_MKE15Z64xxx4 || MCUX_HW_DEVICE_ID_MKE15Z32xxx4

config MCUX_HW_IP_DriverType_LPIT
    bool
    default y
    depends on MCUX_HW_DEVICE_ID_MKE15Z64xxx4 || MCUX_HW_DEVICE_ID_MKE15Z32xxx4

config MCUX_HW_IP_DriverType_LPSPI
    bool
    default y
    depends on MCUX_HW_DEVICE_ID_MKE15Z64xxx4 || MCUX_HW_DEVICE_ID_MKE15Z32xxx4

config MCUX_HW_IP_DriverType_LPTMR
    bool
    default y
    depends on MCUX_HW_DEVICE_ID_MKE15Z64xxx4 || MCUX_HW_DEVICE_ID_MKE15Z32xxx4

config MCUX_HW_IP_DriverType_LPUART
    bool
    default y
    depends on MCUX_HW_DEVICE_ID_MKE15Z64xxx4 || MCUX_HW_DEVICE_ID_MKE15Z32xxx4

config MCUX_HW_IP_DriverType_MCM
    bool
    default y
    depends on MCUX_HW_DEVICE_ID_MKE15Z64xxx4 || MCUX_HW_DEVICE_ID_MKE15Z32xxx4

config MCUX_HW_IP_DriverType_MMDVSQ
    bool
    default y
    depends on MCUX_HW_DEVICE_ID_MKE15Z64xxx4 || MCUX_HW_DEVICE_ID_MKE15Z32xxx4

config MCUX_HW_IP_DriverType_MTB
    bool
    default y
    depends on MCUX_HW_DEVICE_ID_MKE15Z64xxx4 || MCUX_HW_DEVICE_ID_MKE15Z32xxx4

config MCUX_HW_IP_DriverType_MTBDWT
    bool
    default y
    depends on MCUX_HW_DEVICE_ID_MKE15Z64xxx4 || MCUX_HW_DEVICE_ID_MKE15Z32xxx4

config MCUX_HW_IP_DriverType_NV
    bool
    default y
    depends on MCUX_HW_DEVICE_ID_MKE15Z64xxx4 || MCUX_HW_DEVICE_ID_MKE15Z32xxx4

config MCUX_HW_IP_DriverType_PCC
    bool
    default y
    depends on MCUX_HW_DEVICE_ID_MKE15Z64xxx4 || MCUX_HW_DEVICE_ID_MKE15Z32xxx4

config MCUX_HW_IP_DriverType_PDB
    bool
    default y
    depends on MCUX_HW_DEVICE_ID_MKE15Z64xxx4 || MCUX_HW_DEVICE_ID_MKE15Z32xxx4

config MCUX_HW_IP_DriverType_PMC
    bool
    default y
    depends on MCUX_HW_DEVICE_ID_MKE15Z64xxx4 || MCUX_HW_DEVICE_ID_MKE15Z32xxx4

config MCUX_HW_IP_DriverType_PORT
    bool
    default y
    depends on MCUX_HW_DEVICE_ID_MKE15Z64xxx4 || MCUX_HW_DEVICE_ID_MKE15Z32xxx4

config MCUX_HW_IP_DriverType_PWT
    bool
    default y
    depends on MCUX_HW_DEVICE_ID_MKE15Z64xxx4 || MCUX_HW_DEVICE_ID_MKE15Z32xxx4

config MCUX_HW_IP_DriverType_RCM
    bool
    default y
    depends on MCUX_HW_DEVICE_ID_MKE15Z64xxx4 || MCUX_HW_DEVICE_ID_MKE15Z32xxx4

config MCUX_HW_IP_DriverType_ROM
    bool
    default y
    depends on MCUX_HW_DEVICE_ID_MKE15Z64xxx4 || MCUX_HW_DEVICE_ID_MKE15Z32xxx4

config MCUX_HW_IP_DriverType_SCG
    bool
    default y
    depends on MCUX_HW_DEVICE_ID_MKE15Z64xxx4 || MCUX_HW_DEVICE_ID_MKE15Z32xxx4

config MCUX_HW_IP_DriverType_SIM
    bool
    default y
    depends on MCUX_HW_DEVICE_ID_MKE15Z64xxx4 || MCUX_HW_DEVICE_ID_MKE15Z32xxx4

config MCUX_HW_IP_DriverType_SMC
    bool
    default y
    depends on MCUX_HW_DEVICE_ID_MKE15Z64xxx4 || MCUX_HW_DEVICE_ID_MKE15Z32xxx4

config MCUX_HW_IP_DriverType_SRTC
    bool
    default y
    depends on MCUX_HW_DEVICE_ID_MKE15Z64xxx4 || MCUX_HW_DEVICE_ID_MKE15Z32xxx4

config MCUX_HW_IP_DriverType_SYSRAM
    bool
    default y
    depends on MCUX_HW_DEVICE_ID_MKE15Z64xxx4 || MCUX_HW_DEVICE_ID_MKE15Z32xxx4

config MCUX_HW_IP_DriverType_TRGMUX
    bool
    default y
    depends on MCUX_HW_DEVICE_ID_MKE15Z64xxx4 || MCUX_HW_DEVICE_ID_MKE15Z32xxx4

config MCUX_HW_IP_DriverType_TSI_V5
    bool
    default y
    depends on MCUX_HW_DEVICE_ID_MKE15Z64xxx4 || MCUX_HW_DEVICE_ID_MKE15Z32xxx4

config MCUX_HW_IP_DriverType_WDOG32
    bool
    default y
    depends on MCUX_HW_DEVICE_ID_MKE15Z64xxx4 || MCUX_HW_DEVICE_ID_MKE15Z32xxx4
```

## mcux/mcux-sdk-ng/devices/Kinetis/KM/MKM14ZA5/Kconfig.chip
```kconfig
# Copyright 2024 NXP
#
# SPDX-License-Identifier: BSD-3-Clause

# core related
config MCUX_HW_CORE
    string
    default "cm0p"

config MCUX_HW_CORE_CM0P
    bool
    default y

config MCUX_HW_CORE_ID
    string
    default "core0"

config MCUX_HW_CORE_ID_CORE0
    bool
    default y

config MCUX_HW_DEVICE_CORE
    string
    default "MKM14ZA5"

config MCUX_HW_FPU
    string
    default "NO_FPU"

config MCUX_HW_FPU_TYPE
    string
    default "no_fpu"

config MCUX_HW_NO_FPU
    bool
    default y

config MCUX_HW_INT_PRIO_BITS
    int
    default 2

config MCUX_HW_SOC_SERIES_KINETIS
    bool
    default y

config MCUX_HW_SOC_SINGLECORE_DEVICE
    bool
    default y

# device related

config MCUX_HW_DEVICE_ID_MKM14Z64Axxx5
    bool

config MCUX_HW_DEVICE_ID_MKM14Z128Axxx5
    bool

choice MCUX_HW_DEVICE_PART_MKM14ZA5
    prompt "Device MKM14ZA5 Part"
    config MCUX_HW_DEVICE_PART_MKM14Z64ACHH5
    bool "Device part MKM14Z64ACHH5"
    select MCUX_HW_DEVICE_ID_MKM14Z64Axxx5
    config MCUX_HW_DEVICE_PART_MKM14Z128ACHH5
    bool "Device part MKM14Z128ACHH5"
    select MCUX_HW_DEVICE_ID_MKM14Z128Axxx5
endchoice

config MCUX_HW_DEVICE_ID
    string
    default "MKM14Z64Axxx5" if MCUX_HW_DEVICE_ID_MKM14Z64Axxx5
    default "MKM14Z128Axxx5" if MCUX_HW_DEVICE_ID_MKM14Z128Axxx5

config MCUX_HW_DEVICE_PART
    string
    default "MKM14Z64ACHH5" if MCUX_HW_DEVICE_PART_MKM14Z64ACHH5
    default "MKM14Z128ACHH5" if MCUX_HW_DEVICE_PART_MKM14Z128ACHH5

# For chipmodel generated files
config MCUX_TOOLCHAIN_LINKER_DEVICE_PREFIX
    string
    default "MKM14Z64Axxx5" if MCUX_HW_DEVICE_ID_MKM14Z64Axxx5
    default "MKM14Z128Axxx5" if MCUX_HW_DEVICE_ID_MKM14Z128Axxx5

config MCUX_TOOLCHAIN_MCUX_STARTUP
    string
    default "mkm14za5"

# Toolchain related

config MCUX_TOOLCHAIN_IAR_CPU_IDENTIFIER
    string
    default "MKM14Z64Axxx5" if MCUX_HW_DEVICE_ID_MKM14Z64Axxx5
    default "MKM14Z128Axxx5" if MCUX_HW_DEVICE_ID_MKM14Z128Axxx5

config MCUX_TOOLCHAIN_MDK_CPU_IDENTIFIER
    string
    default "MKM14Z64ACHH5" if MCUX_HW_DEVICE_PART_MKM14Z64ACHH5
    default "MKM14Z128ACHH5" if MCUX_HW_DEVICE_PART_MKM14Z128ACHH5

config MCUX_TOOLCHAIN_JLINK_CPU_IDENTIFIER
    string
    default "MKM14Z64Axxx5" if MCUX_HW_DEVICE_ID_MKM14Z64Axxx5
    default "MKM14Z128Axxx5" if MCUX_HW_DEVICE_ID_MKM14Z128Axxx5

# ip information
config MCUX_HW_IP_DriverType_ADC16
    bool
    default y
    depends on MCUX_HW_DEVICE_ID_MKM14Z64Axxx5 || MCUX_HW_DEVICE_ID_MKM14Z128Axxx5

config MCUX_HW_IP_DriverType_AFE
    bool
    default y
    depends on MCUX_HW_DEVICE_ID_MKM14Z64Axxx5 || MCUX_HW_DEVICE_ID_MKM14Z128Axxx5

config MCUX_HW_IP_DriverType_AIPS
    bool
    default y
    depends on MCUX_HW_DEVICE_ID_MKM14Z64Axxx5 || MCUX_HW_DEVICE_ID_MKM14Z128Axxx5

config MCUX_HW_IP_DriverType_CMP
    bool
    default y
    depends on MCUX_HW_DEVICE_ID_MKM14Z64Axxx5 || MCUX_HW_DEVICE_ID_MKM14Z128Axxx5

config MCUX_HW_IP_DriverType_CRC
    bool
    default y
    depends on MCUX_HW_DEVICE_ID_MKM14Z64Axxx5 || MCUX_HW_DEVICE_ID_MKM14Z128Axxx5

config MCUX_HW_IP_DriverType_DMA
    bool
    default y
    depends on MCUX_HW_DEVICE_ID_MKM14Z64Axxx5 || MCUX_HW_DEVICE_ID_MKM14Z128Axxx5

config MCUX_HW_IP_DriverType_DMAMUX
    bool
    default y
    depends on MCUX_HW_DEVICE_ID_MKM14Z64Axxx5 || MCUX_HW_DEVICE_ID_MKM14Z128Axxx5

config MCUX_HW_IP_DriverType_EWM
    bool
    default y
    depends on MCUX_HW_DEVICE_ID_MKM14Z64Axxx5 || MCUX_HW_DEVICE_ID_MKM14Z128Axxx5

config MCUX_HW_IP_DriverType_FTFA
    bool
    default y
    depends on MCUX_HW_DEVICE_ID_MKM14Z64Axxx5 || MCUX_HW_DEVICE_ID_MKM14Z128Axxx5

config MCUX_HW_IP_DriverType_GPIO
    bool
    default y
    depends on MCUX_HW_DEVICE_ID_MKM14Z64Axxx5 || MCUX_HW_DEVICE_ID_MKM14Z128Axxx5

config MCUX_HW_IP_DriverType_I2C
    bool
    default y
    depends on MCUX_HW_DEVICE_ID_MKM14Z64Axxx5 || MCUX_HW_DEVICE_ID_MKM14Z128Axxx5

config MCUX_HW_IP_DriverType_LLWU
    bool
    default y
    depends on MCUX_HW_DEVICE_ID_MKM14Z64Axxx5 || MCUX_HW_DEVICE_ID_MKM14Z128Axxx5

config MCUX_HW_IP_DriverType_LPTMR
    bool
    default y
    depends on MCUX_HW_DEVICE_ID_MKM14Z64Axxx5 || MCUX_HW_DEVICE_ID_MKM14Z128Axxx5

config MCUX_HW_IP_DriverType_MCG
    bool
    default y
    depends on MCUX_HW_DEVICE_ID_MKM14Z64Axxx5 || MCUX_HW_DEVICE_ID_MKM14Z128Axxx5

config MCUX_HW_IP_DriverType_MCM
    bool
    default y
    depends on MCUX_HW_DEVICE_ID_MKM14Z64Axxx5 || MCUX_HW_DEVICE_ID_MKM14Z128Axxx5

config MCUX_HW_IP_DriverType_MTB
    bool
    default y
    depends on MCUX_HW_DEVICE_ID_MKM14Z64Axxx5 || MCUX_HW_DEVICE_ID_MKM14Z128Axxx5

config MCUX_HW_IP_DriverType_MTBDWT
    bool
    default y
    depends on MCUX_HW_DEVICE_ID_MKM14Z64Axxx5 || MCUX_HW_DEVICE_ID_MKM14Z128Axxx5

config MCUX_HW_IP_DriverType_NV
    bool
    default y
    depends on MCUX_HW_DEVICE_ID_MKM14Z64Axxx5 || MCUX_HW_DEVICE_ID_MKM14Z128Axxx5

config MCUX_HW_IP_DriverType_OSC
    bool
    default y
    depends on MCUX_HW_DEVICE_ID_MKM14Z64Axxx5 || MCUX_HW_DEVICE_ID_MKM14Z128Axxx5

config MCUX_HW_IP_DriverType_PIT
    bool
    default y
    depends on MCUX_HW_DEVICE_ID_MKM14Z64Axxx5 || MCUX_HW_DEVICE_ID_MKM14Z128Axxx5

config MCUX_HW_IP_DriverType_PMC
    bool
    default y
    depends on MCUX_HW_DEVICE_ID_MKM14Z64Axxx5 || MCUX_HW_DEVICE_ID_MKM14Z128Axxx5

config MCUX_HW_IP_DriverType_PORT
    bool
    default y
    depends on MCUX_HW_DEVICE_ID_MKM14Z64Axxx5 || MCUX_HW_DEVICE_ID_MKM14Z128Axxx5

config MCUX_HW_IP_DriverType_RCM
    bool
    default y
    depends on MCUX_HW_DEVICE_ID_MKM14Z64Axxx5 || MCUX_HW_DEVICE_ID_MKM14Z128Axxx5

config MCUX_HW_IP_DriverType_RNGA
    bool
    default y
    depends on MCUX_HW_DEVICE_ID_MKM14Z64Axxx5 || MCUX_HW_DEVICE_ID_MKM14Z128Axxx5

config MCUX_HW_IP_DriverType_ROM
    bool
    default y
    depends on MCUX_HW_DEVICE_ID_MKM14Z64Axxx5 || MCUX_HW_DEVICE_ID_MKM14Z128Axxx5

config MCUX_HW_IP_DriverType_RTC_V2
    bool
    default y
    depends on MCUX_HW_DEVICE_ID_MKM14Z64Axxx5 || MCUX_HW_DEVICE_ID_MKM14Z128Axxx5

config MCUX_HW_IP_DriverType_SIM
    bool
    default y
    depends on MCUX_HW_DEVICE_ID_MKM14Z64Axxx5 || MCUX_HW_DEVICE_ID_MKM14Z128Axxx5

config MCUX_HW_IP_DriverType_SMC
    bool
    default y
    depends on MCUX_HW_DEVICE_ID_MKM14Z64Axxx5 || MCUX_HW_DEVICE_ID_MKM14Z128Axxx5

config MCUX_HW_IP_DriverType_SPI
    bool
    default y
    depends on MCUX_HW_DEVICE_ID_MKM14Z64Axxx5 || MCUX_HW_DEVICE_ID_MKM14Z128Axxx5

config MCUX_HW_IP_DriverType_SYSMPU
    bool
    default y
    depends on MCUX_HW_DEVICE_ID_MKM14Z64Axxx5 || MCUX_HW_DEVICE_ID_MKM14Z128Axxx5

config MCUX_HW_IP_DriverType_TMR_2
    bool
    default y
    depends on MCUX_HW_DEVICE_ID_MKM14Z64Axxx5 || MCUX_HW_DEVICE_ID_MKM14Z128Axxx5

config MCUX_HW_IP_DriverType_UART
    bool
    default y
    depends on MCUX_HW_DEVICE_ID_MKM14Z64Axxx5 || MCUX_HW_DEVICE_ID_MKM14Z128Axxx5

config MCUX_HW_IP_DriverType_VREF
    bool
    default y
    depends on MCUX_HW_DEVICE_ID_MKM14Z64Axxx5 || MCUX_HW_DEVICE_ID_MKM14Z128Axxx5

config MCUX_HW_IP_DriverType_WDOG
    bool
    default y
    depends on MCUX_HW_DEVICE_ID_MKM14Z64Axxx5 || MCUX_HW_DEVICE_ID_MKM14Z128Axxx5

config MCUX_HW_IP_DriverType_XBAR
    bool
    default y
    depends on MCUX_HW_DEVICE_ID_MKM14Z64Axxx5 || MCUX_HW_DEVICE_ID_MKM14Z128Axxx5
```

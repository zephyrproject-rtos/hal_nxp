## mcux/mcux-sdk-ng/devices/LPC/LPC54000/LPC54608/Kconfig.chip
```kconfig
# Copyright 2024 NXP
#
# SPDX-License-Identifier: BSD-3-Clause

# core related
config MCUX_HW_CORE
    string
    default "cm4f"

config MCUX_HW_CORE_CM4F
    bool
    default y

config MCUX_HW_CORE_ID
    string
    default "core0"

config MCUX_HW_CORE_ID_CORE0
    bool
    default y

config MCUX_HW_DEVICE_CORE
    string
    default "LPC54608"

config MCUX_HW_FPU
    string
    default "SP_FPU"

config MCUX_HW_FPU_TYPE
    string
    default "fpv4_sp"

config MCUX_HW_FPV4_SP
    bool
    default y

config MCUX_HW_INT_PRIO_BITS
    int
    default 3

config MCUX_HW_SOC_SERIES_LPC
    bool
    default y

config MCUX_HW_SOC_SINGLECORE_DEVICE
    bool
    default y

# device related

config MCUX_HW_DEVICE_ID_LPC54608J512
    bool

choice
    prompt "Device LPC54608 Part"
    config MCUX_HW_DEVICE_PART_LPC54608J512BD208
    bool "Device part LPC54608J512BD208"
    select MCUX_HW_DEVICE_ID_LPC54608J512
    config MCUX_HW_DEVICE_PART_LPC54608J512ET180
    bool "Device part LPC54608J512ET180"
    select MCUX_HW_DEVICE_ID_LPC54608J512
endchoice

config MCUX_HW_DEVICE_ID
    string
    default "LPC54608J512" if MCUX_HW_DEVICE_ID_LPC54608J512

config MCUX_HW_DEVICE_PART
    string
    default "LPC54608J512BD208" if MCUX_HW_DEVICE_PART_LPC54608J512BD208
    default "LPC54608J512ET180" if MCUX_HW_DEVICE_PART_LPC54608J512ET180

# For chipmodel generated files
config MCUX_TOOLCHAIN_LINKER_DEVICE_PREFIX
    string
    default "LPC54608J512" if MCUX_HW_DEVICE_ID_LPC54608J512

config MCUX_TOOLCHAIN_MCUX_STARTUP
    string
    default "lpc54608"

# Toolchain related

config MCUX_TOOLCHAIN_IAR_CPU_IDENTIFIER
    string
    default "LPC54608J512" if MCUX_HW_DEVICE_ID_LPC54608J512

config MCUX_TOOLCHAIN_MDK_CPU_IDENTIFIER
    string
    default "LPC54608J512BD208" if MCUX_HW_DEVICE_PART_LPC54608J512BD208
    default "LPC54608J512ET180" if MCUX_HW_DEVICE_PART_LPC54608J512ET180

config MCUX_TOOLCHAIN_JLINK_CPU_IDENTIFIER
    string
    default "LPC54608J512" if MCUX_HW_DEVICE_ID_LPC54608J512

# ip information
config MCUX_HW_IP_DriverType_ADC12_5M
    bool
    default y
    depends on MCUX_HW_DEVICE_ID_LPC54608J512

config MCUX_HW_IP_DriverType_ASYNC_SYSCON_FREQME
    bool
    default y
    depends on MCUX_HW_DEVICE_ID_LPC54608J512

config MCUX_HW_IP_DriverType_CTIMER
    bool
    default y
    depends on MCUX_HW_DEVICE_ID_LPC54608J512

config MCUX_HW_IP_DriverType_DMIC
    bool
    default y
    depends on MCUX_HW_DEVICE_ID_LPC54608J512

config MCUX_HW_IP_DriverType_EEPROM
    bool
    default y
    depends on MCUX_HW_DEVICE_ID_LPC54608J512

config MCUX_HW_IP_DriverType_EMC
    bool
    default y
    depends on MCUX_HW_DEVICE_ID_LPC54608J512

config MCUX_HW_IP_DriverType_FLASHIAP
    bool
    default y
    depends on MCUX_HW_DEVICE_ID_LPC54608J512

config MCUX_HW_IP_DriverType_FLEXCOMM
    bool
    default y
    depends on MCUX_HW_DEVICE_ID_LPC54608J512

config MCUX_HW_IP_DriverType_FLEXCOMM_I2C
    bool
    default y
    depends on MCUX_HW_DEVICE_ID_LPC54608J512

config MCUX_HW_IP_DriverType_FLEXCOMM_I2S
    bool
    default y
    depends on MCUX_HW_DEVICE_ID_LPC54608J512

config MCUX_HW_IP_DriverType_FLEXCOMM_SPI
    bool
    default y
    depends on MCUX_HW_DEVICE_ID_LPC54608J512

config MCUX_HW_IP_DriverType_FLEXCOMM_USART
    bool
    default y
    depends on MCUX_HW_DEVICE_ID_LPC54608J512

config MCUX_HW_IP_DriverType_FSG
    bool
    default y
    depends on MCUX_HW_DEVICE_ID_LPC54608J512

config MCUX_HW_IP_DriverType_GINT
    bool
    default y
    depends on MCUX_HW_DEVICE_ID_LPC54608J512

config MCUX_HW_IP_DriverType_GPIO_PORT
    bool
    default y
    depends on MCUX_HW_DEVICE_ID_LPC54608J512

config MCUX_HW_IP_DriverType_IAP
    bool
    default y
    depends on MCUX_HW_DEVICE_ID_LPC54608J512

config MCUX_HW_IP_DriverType_INPUTMUX
    bool
    default y
    depends on MCUX_HW_DEVICE_ID_LPC54608J512

config MCUX_HW_IP_DriverType_IOCON
    bool
    default y
    depends on MCUX_HW_DEVICE_ID_LPC54608J512

config MCUX_HW_IP_DriverType_LCD
    bool
    default y
    depends on MCUX_HW_DEVICE_ID_LPC54608J512

config MCUX_HW_IP_DriverType_LPC_ASYNC_SYSCON
    bool
    default y
    depends on MCUX_HW_DEVICE_ID_LPC54608J512

config MCUX_HW_IP_DriverType_LPC_ENET
    bool
    default y
    depends on MCUX_HW_DEVICE_ID_LPC54608J512

config MCUX_HW_IP_DriverType_LPC_SMARTCARD
    bool
    default y
    depends on MCUX_HW_DEVICE_ID_LPC54608J512

config MCUX_HW_IP_DriverType_LPC_SWD
    bool
    default y
    depends on MCUX_HW_DEVICE_ID_LPC54608J512

config MCUX_HW_IP_DriverType_MCAN
    bool
    default y
    depends on MCUX_HW_DEVICE_ID_LPC54608J512

config MCUX_HW_IP_DriverType_MCO_CRC
    bool
    default y
    depends on MCUX_HW_DEVICE_ID_LPC54608J512

config MCUX_HW_IP_DriverType_MRT
    bool
    default y
    depends on MCUX_HW_DEVICE_ID_LPC54608J512

config MCUX_HW_IP_DriverType_OTPC
    bool
    default y
    depends on MCUX_HW_DEVICE_ID_LPC54608J512

config MCUX_HW_IP_DriverType_PINT
    bool
    default y
    depends on MCUX_HW_DEVICE_ID_LPC54608J512

config MCUX_HW_IP_DriverType_RIT
    bool
    default y
    depends on MCUX_HW_DEVICE_ID_LPC54608J512

config MCUX_HW_IP_DriverType_RNG
    bool
    default y
    depends on MCUX_HW_DEVICE_ID_LPC54608J512

config MCUX_HW_IP_DriverType_RTC_LITE
    bool
    default y
    depends on MCUX_HW_DEVICE_ID_LPC54608J512

config MCUX_HW_IP_DriverType_SCTIMER
    bool
    default y
    depends on MCUX_HW_DEVICE_ID_LPC54608J512

config MCUX_HW_IP_DriverType_SDIF
    bool
    default y
    depends on MCUX_HW_DEVICE_ID_LPC54608J512

config MCUX_HW_IP_DriverType_SDMA
    bool
    default y
    depends on MCUX_HW_DEVICE_ID_LPC54608J512

config MCUX_HW_IP_DriverType_SHA
    bool
    default y
    depends on MCUX_HW_DEVICE_ID_LPC54608J512

config MCUX_HW_IP_DriverType_SPIFI
    bool
    default y
    depends on MCUX_HW_DEVICE_ID_LPC54608J512

config MCUX_HW_IP_DriverType_SYSCON_FREQME
    bool
    default y
    depends on MCUX_HW_DEVICE_ID_LPC54608J512

config MCUX_HW_IP_DriverType_USB_DEVICE_IP3511FS
    bool
    default y
    depends on MCUX_HW_DEVICE_ID_LPC54608J512

config MCUX_HW_IP_DriverType_USB_DEVICE_IP3511HS
    bool
    default y
    depends on MCUX_HW_DEVICE_ID_LPC54608J512

config MCUX_HW_IP_DriverType_USB_HOST_IP3516HS
    bool
    default y
    depends on MCUX_HW_DEVICE_ID_LPC54608J512

config MCUX_HW_IP_DriverType_USB_HOST_OHCI
    bool
    default y
    depends on MCUX_HW_DEVICE_ID_LPC54608J512

config MCUX_HW_IP_DriverType_UTICK
    bool
    default y
    depends on MCUX_HW_DEVICE_ID_LPC54608J512

config MCUX_HW_IP_DriverType_WWDT
    bool
    default y
    depends on MCUX_HW_DEVICE_ID_LPC54608J512
```

## mcux/mcux-sdk-ng/devices/LPC/LPC54000/LPC54S005/Kconfig.chip
```kconfig
# Copyright 2024 NXP
#
# SPDX-License-Identifier: BSD-3-Clause

# core related
config MCUX_HW_CORE
    string
    default "cm4f"

config MCUX_HW_CORE_CM4F
    bool
    default y

config MCUX_HW_CORE_ID
    string
    default "core0"

config MCUX_HW_CORE_ID_CORE0
    bool
    default y

config MCUX_HW_DEVICE_CORE
    string
    default "LPC54S005"

config MCUX_HW_FPU
    string
    default "SP_FPU"

config MCUX_HW_FPU_TYPE
    string
    default "fpv4_sp"

config MCUX_HW_FPV4_SP
    bool
    default y

config MCUX_HW_INT_PRIO_BITS
    int
    default 3

config MCUX_HW_SOC_SERIES_LPC
    bool
    default y

config MCUX_HW_SOC_SINGLECORE_DEVICE
    bool
    default y

# device related

config MCUX_HW_DEVICE_ID_LPC54S005
    bool

choice MCUX_HW_DEVICE_PART_LPC54S005
    prompt "Device LPC54S005 Part"
    config MCUX_HW_DEVICE_PART_LPC54S005JET100
    bool "Device part LPC54S005JET100"
    select MCUX_HW_DEVICE_ID_LPC54S005
    config MCUX_HW_DEVICE_PART_LPC54S005JBD100
    bool "Device part LPC54S005JBD100"
    select MCUX_HW_DEVICE_ID_LPC54S005
endchoice

config MCUX_HW_DEVICE_ID
    string
    default "LPC54S005" if MCUX_HW_DEVICE_ID_LPC54S005

config MCUX_HW_DEVICE_PART
    string
    default "LPC54S005JET100" if MCUX_HW_DEVICE_PART_LPC54S005JET100
    default "LPC54S005JBD100" if MCUX_HW_DEVICE_PART_LPC54S005JBD100

# For chipmodel generated files
config MCUX_TOOLCHAIN_LINKER_DEVICE_PREFIX
    string
    default "LPC54S005" if MCUX_HW_DEVICE_ID_LPC54S005

config MCUX_TOOLCHAIN_MCUX_STARTUP
    string
    default "lpc54s005"

# Toolchain related

config MCUX_TOOLCHAIN_IAR_CPU_IDENTIFIER
    string
    default "LPC54S005" if MCUX_HW_DEVICE_ID_LPC54S005

config MCUX_TOOLCHAIN_MDK_CPU_IDENTIFIER
    string
    default "LPC54S005JET100" if MCUX_HW_DEVICE_PART_LPC54S005JET100
    default "LPC54S005JBD100" if MCUX_HW_DEVICE_PART_LPC54S005JBD100

config MCUX_TOOLCHAIN_JLINK_CPU_IDENTIFIER
    string
    default "LPC54S005" if MCUX_HW_DEVICE_ID_LPC54S005

# ip information
config MCUX_HW_IP_DriverType_ADC12_5M
    bool
    default y
    depends on MCUX_HW_DEVICE_ID_LPC54S005

config MCUX_HW_IP_DriverType_AES
    bool
    default y
    depends on MCUX_HW_DEVICE_ID_LPC54S005

config MCUX_HW_IP_DriverType_ASYNC_SYSCON_FREQME
    bool
    default y
    depends on MCUX_HW_DEVICE_ID_LPC54S005

config MCUX_HW_IP_DriverType_CTIMER
    bool
    default y
    depends on MCUX_HW_DEVICE_ID_LPC54S005

config MCUX_HW_IP_DriverType_DMIC
    bool
    default y
    depends on MCUX_HW_DEVICE_ID_LPC54S005

config MCUX_HW_IP_DriverType_EMC
    bool
    default y
    depends on MCUX_HW_DEVICE_ID_LPC54S005

config MCUX_HW_IP_DriverType_FLEXCOMM
    bool
    default y
    depends on MCUX_HW_DEVICE_ID_LPC54S005

config MCUX_HW_IP_DriverType_FLEXCOMM_I2C
    bool
    default y
    depends on MCUX_HW_DEVICE_ID_LPC54S005

config MCUX_HW_IP_DriverType_FLEXCOMM_I2S
    bool
    default y
    depends on MCUX_HW_DEVICE_ID_LPC54S005

config MCUX_HW_IP_DriverType_FLEXCOMM_SPI
    bool
    default y
    depends on MCUX_HW_DEVICE_ID_LPC54S005

config MCUX_HW_IP_DriverType_FLEXCOMM_USART
    bool
    default y
    depends on MCUX_HW_DEVICE_ID_LPC54S005

config MCUX_HW_IP_DriverType_GINT
    bool
    default y
    depends on MCUX_HW_DEVICE_ID_LPC54S005

config MCUX_HW_IP_DriverType_GPIO_PORT
    bool
    default y
    depends on MCUX_HW_DEVICE_ID_LPC54S005

config MCUX_HW_IP_DriverType_IAP
    bool
    default y
    depends on MCUX_HW_DEVICE_ID_LPC54S005

config MCUX_HW_IP_DriverType_INPUTMUX
    bool
    default y
    depends on MCUX_HW_DEVICE_ID_LPC54S005

config MCUX_HW_IP_DriverType_IOCON
    bool
    default y
    depends on MCUX_HW_DEVICE_ID_LPC54S005

config MCUX_HW_IP_DriverType_LCD
    bool
    default y
    depends on MCUX_HW_DEVICE_ID_LPC54S005

config MCUX_HW_IP_DriverType_LPC_ASYNC_SYSCON
    bool
    default y
    depends on MCUX_HW_DEVICE_ID_LPC54S005

config MCUX_HW_IP_DriverType_LPC_ENET
    bool
    default y
    depends on MCUX_HW_DEVICE_ID_LPC54S005

config MCUX_HW_IP_DriverType_LPC_PUF
    bool
    default y
    depends on MCUX_HW_DEVICE_ID_LPC54S005

config MCUX_HW_IP_DriverType_LPC_SMARTCARD
    bool
    default y
    depends on MCUX_HW_DEVICE_ID_LPC54S005

config MCUX_HW_IP_DriverType_LPC_SWD
    bool
    default y
    depends on MCUX_HW_DEVICE_ID_LPC54S005

config MCUX_HW_IP_DriverType_MCAN
    bool
    default y
    depends on MCUX_HW_DEVICE_ID_LPC54S005

config MCUX_HW_IP_DriverType_MCO_CRC
    bool
    default y
    depends on MCUX_HW_DEVICE_ID_LPC54S005

config MCUX_HW_IP_DriverType_MRT
    bool
    default y
    depends on MCUX_HW_DEVICE_ID_LPC54S005

config MCUX_HW_IP_DriverType_OTPC
    bool
    default y
    depends on MCUX_HW_DEVICE_ID_LPC54S005

config MCUX_HW_IP_DriverType_PINT
    bool
    default y
    depends on MCUX_HW_DEVICE_ID_LPC54S005

config MCUX_HW_IP_DriverType_PUF
    bool
    default y
    depends on MCUX_HW_DEVICE_ID_LPC54S005

config MCUX_HW_IP_DriverType_RIT
    bool
    default y
    depends on MCUX_HW_DEVICE_ID_LPC54S005

config MCUX_HW_IP_DriverType_RNG
    bool
    default y
    depends on MCUX_HW_DEVICE_ID_LPC54S005

config MCUX_HW_IP_DriverType_RTC_LITE
    bool
    default y
    depends on MCUX_HW_DEVICE_ID_LPC54S005

config MCUX_HW_IP_DriverType_SCTIMER
    bool
    default y
    depends on MCUX_HW_DEVICE_ID_LPC54S005

config MCUX_HW_IP_DriverType_SDIF
    bool
    default y
    depends on MCUX_HW_DEVICE_ID_LPC54S005

config MCUX_HW_IP_DriverType_SDMA
    bool
    default y
    depends on MCUX_HW_DEVICE_ID_LPC54S005

config MCUX_HW_IP_DriverType_SHA
    bool
    default y
    depends on MCUX_HW_DEVICE_ID_LPC54S005

config MCUX_HW_IP_DriverType_SPIFI
    bool
    default y
    depends on MCUX_HW_DEVICE_ID_LPC54S005

config MCUX_HW_IP_DriverType_SYSCON_FREQME
    bool
    default y
    depends on MCUX_HW_DEVICE_ID_LPC54S005

config MCUX_HW_IP_DriverType_USB_DEVICE_IP3511FS
    bool
    default y
    depends on MCUX_HW_DEVICE_ID_LPC54S005

config MCUX_HW_IP_DriverType_USB_DEVICE_IP3511HS
    bool
    default y
    depends on MCUX_HW_DEVICE_ID_LPC54S005

config MCUX_HW_IP_DriverType_USB_HOST_IP3516HS
    bool
    default y
    depends on MCUX_HW_DEVICE_ID_LPC54S005

config MCUX_HW_IP_DriverType_USB_HOST_OHCI
    bool
    default y
    depends on MCUX_HW_DEVICE_ID_LPC54S005

config MCUX_HW_IP_DriverType_UTICK
    bool
    default y
    depends on MCUX_HW_DEVICE_ID_LPC54S005

config MCUX_HW_IP_DriverType_WWDT
    bool
    default y
    depends on MCUX_HW_DEVICE_ID_LPC54S005
```

## mcux/mcux-sdk-ng/devices/LPC/LPC54000/LPC54S018M/Kconfig
```kconfig
# Copyright 2024 NXP
# All rights reserved.
#
# SPDX-License-Identifier: BSD-3-Clause

rsource "Kconfig.chip"
rsource "drivers/Kconfig"
rsource "../../../arm/Kconfig.common"
rsource "Kconfig.defconfig"

## Project segment and component dependency data
config MCUX_HW_DEVICE_LPC54S018M
    # bool "Device LPC54S018M Configuration"
    bool
    default y

    # component dependency
    select MCUX_COMPONENT_driver.lpc_dma if MCUX_COMPONENT_device.RTE
    select MCUX_COMPONENT_driver.power if MCUX_COMPONENT_driver.clock
    select MCUX_COMPONENT_component.usart_adapter if MCUX_COMPONENT_component.serial_manager_uart
    select MCUX_COMPONENT_component.usart_adapter if MCUX_COMPONENT_utility.debug_console_lite
    select MCUX_COMPONENT_driver.lpc_dma if MCUX_COMPONENT_driver.dmic_dma
    select MCUX_COMPONENT_driver.lpc_dma if MCUX_COMPONENT_driver.flexcomm_i2c_dma
    select MCUX_COMPONENT_driver.lpc_dma if MCUX_COMPONENT_driver.flexcomm_i2s_dma
    select MCUX_COMPONENT_driver.lpc_dma if MCUX_COMPONENT_driver.spifi_dma
    select MCUX_COMPONENT_driver.lpc_dma if MCUX_COMPONENT_driver.flexcomm_spi_dma
    select MCUX_COMPONENT_driver.lpc_dma if MCUX_COMPONENT_driver.flexcomm_usart_dma
```

## mcux/mcux-sdk-ng/devices/LPC/LPC5500/LPC5504/Kconfig
```kconfig
# Copyright 2024 NXP
# All rights reserved.
#
# SPDX-License-Identifier: BSD-3-Clause

rsource "Kconfig.chip"
rsource "../LPC55S06/drivers/Kconfig"
rsource "../../../arm/Kconfig.common"
rsource "Kconfig.defconfig"

## Project segment and component dependency data
config MCUX_HW_DEVICE_LPC5504
    # bool "Device LPC5504 Configuration"
    bool
    default y

    # component dependency
    select MCUX_COMPONENT_driver.power if MCUX_COMPONENT_driver.clock
    select MCUX_COMPONENT_driver.lpc_dma if MCUX_COMPONENT_device.RTE
    select MCUX_COMPONENT_component.usart_adapter if MCUX_COMPONENT_component.serial_manager_uart
    select MCUX_COMPONENT_component.usart_adapter if MCUX_COMPONENT_utility.debug_console_lite
    select MCUX_COMPONENT_driver.lpc_dma if MCUX_COMPONENT_driver.flexcomm_i2c_dma
    select MCUX_COMPONENT_driver.lpc_dma if MCUX_COMPONENT_driver.flexcomm_i2s_dma
    select MCUX_COMPONENT_driver.lpc_dma if MCUX_COMPONENT_driver.flexcomm_spi_dma
    select MCUX_COMPONENT_driver.lpc_dma if MCUX_COMPONENT_driver.flexcomm_usart_dma
```

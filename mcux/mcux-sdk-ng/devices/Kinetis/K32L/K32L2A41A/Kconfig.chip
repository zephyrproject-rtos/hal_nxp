## mcux/mcux-sdk-ng/devices/LPC/LPC5500/LPC5526/Kconfig.chip
```kconfig
# Copyright 2024 NXP
#
# SPDX-License-Identifier: BSD-3-Clause

# core related
config MCUX_HW_CORE
    string
    default "cm33"

config MCUX_HW_CORE_CM33
    bool
    default y

config MCUX_HW_CORE_ID
    string
    default "cm33_core0"

config MCUX_HW_CORE_ID_CM33_CORE0
    bool
    default y

config MCUX_HW_DEVICE_CORE
    string
    default "LPC5526"

config MCUX_HW_FPU
    string
    default "SP_FPU"

config MCUX_HW_FPU_TYPE
    string
    default "fpv5_sp"

config MCUX_HW_FPV5_SP
    bool
    default y

config MCUX_HW_INT_PRIO_BITS
    int
    default 3

config MCUX_HW_DSP
    bool
    default y

config MCUX_HW_SAU
    bool
    default y

config MCUX_HW_SOC_SERIES_LPC
    bool
    default y

config MCUX_HW_SOC_SINGLECORE_DEVICE
    bool
    default y

# device related

config MCUX_HW_DEVICE_ID_LPC5526
    bool

choice
    prompt "Device LPC5526 Part"
    config MCUX_HW_DEVICE_PART_LPC5526JBD100
    bool "Device part LPC5526JBD100"
    select MCUX_HW_DEVICE_ID_LPC5526
    config MCUX_HW_DEVICE_PART_LPC5526JEV98
    bool "Device part LPC5526JEV98"
    select MCUX_HW_DEVICE_ID_LPC5526
    config MCUX_HW_DEVICE_PART_LPC5526JBD64
    bool "Device part LPC5526JBD64"
    select MCUX_HW_DEVICE_ID_LPC5526
endchoice

config MCUX_HW_DEVICE_ID
    string
    default "LPC5526" if MCUX_HW_DEVICE_ID_LPC5526

config MCUX_HW_DEVICE_PART
    string
    default "LPC5526JBD100" if MCUX_HW_DEVICE_PART_LPC5526JBD100
    default "LPC5526JEV98" if MCUX_HW_DEVICE_PART_LPC5526JEV98
    default "LPC5526JBD64" if MCUX_HW_DEVICE_PART_LPC5526JBD64

# For chipmodel generated files
config MCUX_TOOLCHAIN_LINKER_DEVICE_PREFIX
    string
    default "LPC5526" if MCUX_HW_DEVICE_ID_LPC5526

config MCUX_TOOLCHAIN_MCUX_STARTUP
    string
    default "lpc5526"

# Toolchain related

config MCUX_TOOLCHAIN_IAR_CPU_IDENTIFIER
    string
    default "LPC5526" if MCUX_HW_DEVICE_ID_LPC5526

config MCUX_TOOLCHAIN_MDK_CPU_IDENTIFIER
    string
    default "LPC5526JBD100" if MCUX_HW_DEVICE_PART_LPC5526JBD100
    default "LPC5526JEV98" if MCUX_HW_DEVICE_PART_LPC5526JEV98
    default "LPC5526JBD64" if MCUX_HW_DEVICE_PART_LPC5526JBD64

config MCUX_TOOLCHAIN_JLINK_CPU_IDENTIFIER
    string
    default "LPC5526" if MCUX_HW_DEVICE_ID_LPC5526

# ip information
config MCUX_HW_IP_DriverType_ANALOGCTRL
    bool
    default y
    depends on MCUX_HW_DEVICE_ID_LPC5526

config MCUX_HW_IP_DriverType_CTIMER
    bool
    default y
    depends on MCUX_HW_DEVICE_ID_LPC5526

config MCUX_HW_IP_DriverType_FLEXCOMM
    bool
    default y
    depends on MCUX_HW_DEVICE_ID_LPC5526

config MCUX_HW_IP_DriverType_FLEXCOMM_I2C
    bool
    default y
    depends on MCUX_HW_DEVICE_ID_LPC5526

config MCUX_HW_IP_DriverType_FLEXCOMM_I2S
    bool
    default y
    depends on MCUX_HW_DEVICE_ID_LPC5526

config MCUX_HW_IP_DriverType_FLEXCOMM_SPI
    bool
    default y
    depends on MCUX_HW_DEVICE_ID_LPC5526

config MCUX_HW_IP_DriverType_FLEXCOMM_USART
    bool
    default y
    depends on MCUX_HW_DEVICE_ID_LPC5526

config MCUX_HW_IP_DriverType_GINT
    bool
    default y
    depends on MCUX_HW_DEVICE_ID_LPC5526

config MCUX_HW_IP_DriverType_GPIO_PORT
    bool
    default y
    depends on MCUX_HW_DEVICE_ID_LPC5526

config MCUX_HW_IP_DriverType_IAP_1
    bool
    default y
    depends on MCUX_HW_DEVICE_ID_LPC5526

config MCUX_HW_IP_DriverType_INPUTMUX
    bool
    default y
    depends on MCUX_HW_DEVICE_ID_LPC5526

config MCUX_HW_IP_DriverType_IOCON
    bool
    default y
    depends on MCUX_HW_DEVICE_ID_LPC5526

config MCUX_HW_IP_DriverType_LPADC
    bool
    default y
    depends on MCUX_HW_DEVICE_ID_LPC5526

config MCUX_HW_IP_DriverType_LPC_AHB_SECURE_CTRL
    bool
    default y
    depends on MCUX_HW_DEVICE_ID_LPC5526

config MCUX_HW_IP_DriverType_LPC_DBGMAILBOX
    bool
    default y
    depends on MCUX_HW_DEVICE_ID_LPC5526

config MCUX_HW_IP_DriverType_LPC_FLASH
    bool
    default y
    depends on MCUX_HW_DEVICE_ID_LPC5526

config MCUX_HW_IP_DriverType_LPC_FLASH_CFPA
    bool
    default y
    depends on MCUX_HW_DEVICE_ID_LPC5526

config MCUX_HW_IP_DriverType_LPC_FLASH_CMPA
    bool
    default y
    depends on MCUX_HW_DEVICE_ID_LPC5526

config MCUX_HW_IP_DriverType_LPC_FLASH_KEY_STORE
    bool
    default y
    depends on MCUX_HW_DEVICE_ID_LPC5526

config MCUX_HW_IP_DriverType_LPC_PMC
    bool
    default y
    depends on MCUX_HW_DEVICE_ID_LPC5526

config MCUX_HW_IP_DriverType_LPC_POWERLIB
    bool
    default y
    depends on MCUX_HW_DEVICE_ID_LPC5526

config MCUX_HW_IP_DriverType_LPC_SECGPIO
    bool
    default y
    depends on MCUX_HW_DEVICE_ID_LPC5526

config MCUX_HW_IP_DriverType_LPC_SWD
    bool
    default y
    depends on MCUX_HW_DEVICE_ID_LPC5526

config MCUX_HW_IP_DriverType_MCO_CRC
    bool
    default y
    depends on MCUX_HW_DEVICE_ID_LPC5526

config MCUX_HW_IP_DriverType_MRT
    bool
    default y
    depends on MCUX_HW_DEVICE_ID_LPC5526

config MCUX_HW_IP_DriverType_OSTIMER
    bool
    default y
    depends on MCUX_HW_DEVICE_ID_LPC5526

config MCUX_HW_IP_DriverType_PINT
    bool
    default y
    depends on MCUX_HW_DEVICE_ID_LPC5526

config MCUX_HW_IP_DriverType_PLU
    bool
    default y
    depends on MCUX_HW_DEVICE_ID_LPC5526

config MCUX_HW_IP_DriverType_PRINCE
    bool
    default y
    depends on MCUX_HW_DEVICE_ID_LPC5526

config MCUX_HW_IP_DriverType_RNG_1
    bool
    default y
    depends on MCUX_HW_DEVICE_ID_LPC5526

config MCUX_HW_IP_DriverType_RTC_LITE
    bool
    default y
    depends on MCUX_HW_DEVICE_ID_LPC5526

config MCUX_HW_IP_DriverType_SCTIMER
    bool
    default y
    depends on MCUX_HW_DEVICE_ID_LPC5526

config MCUX_HW_IP_DriverType_SDIF
    bool
    default y
    depends on MCUX_HW_DEVICE_ID_LPC5526

config MCUX_HW_IP_DriverType_SDMA
    bool
    default y
    depends on MCUX_HW_DEVICE_ID_LPC5526

config MCUX_HW_IP_DriverType_SYSCON_CMP
    bool
    default y
    depends on MCUX_HW_DEVICE_ID_LPC5526

config MCUX_HW_IP_DriverType_SYSCTL
    bool
    default y
    depends on MCUX_HW_DEVICE_ID_LPC5526

config MCUX_HW_IP_DriverType_USB_DEVICE_IP3511FS
    bool
    default y
    depends on MCUX_HW_DEVICE_ID_LPC5526

config MCUX_HW_IP_DriverType_USB_DEVICE_IP3511HS
    bool
    default y
    depends on MCUX_HW_DEVICE_ID_LPC5526

config MCUX_HW_IP_DriverType_USB_HOST_IP3516HS
    bool
    default y
    depends on MCUX_HW_DEVICE_ID_LPC5526

config MCUX_HW_IP_DriverType_USB_HOST_OHCI
    bool
    default y
    depends on MCUX_HW_DEVICE_ID_LPC5526

config MCUX_HW_IP_DriverType_USB_PHY
    bool
    default y
    depends on MCUX_HW_DEVICE_ID_LPC5526

config MCUX_HW_IP_DriverType_UTICK
    bool
    default y
    depends on MCUX_HW_DEVICE_ID_LPC5526

config MCUX_HW_IP_DriverType_WWDT
    bool
    default y
    depends on MCUX_HW_DEVICE_ID_LPC5526
```

## mcux/mcux-sdk-ng/devices/LPC/LPC5500/LPC55S06/drivers/Kconfig
```kconfig
# Copyright 2024 NXP
# All rights reserved.
#
# SPDX-License-Identifier: BSD-3-Clause

menu "Device specific drivers configuration"

    config MCUX_COMPONENT_driver.clock
         bool "Use driver clock"
         default y

    config MCUX_COMPONENT_driver.inputmux_connections
         bool "Use driver inputmux_connections"
         default y

    config MCUX_COMPONENT_driver.power
         bool "Use driver power"
         default y

    config MCUX_COMPONENT_driver.reset
         bool "Use driver reset"
         default y

endmenu
```

## mcux/mcux-sdk-ng/devices/LPC/LPC5500/LPC55S36/Kconfig.chip
```kconfig
# Copyright 2024 NXP
#
# SPDX-License-Identifier: BSD-3-Clause

# core related
config MCUX_HW_CORE
    string
    default "cm33"

config MCUX_HW_CORE_CM33
    bool
    default y

config MCUX_HW_CORE_ID
    string
    default "cm33_core0"

config MCUX_HW_CORE_ID_CM33_CORE0
    bool
    default y

config MCUX_HW_DEVICE_CORE
    string
    default "LPC55S36"

config MCUX_HW_FPU
    string
    default "SP_FPU"

config MCUX_HW_FPU_TYPE
    string
    default "fpv5_sp"

config MCUX_HW_FPV5_SP
    bool
    default y

config MCUX_HW_INT_PRIO_BITS
    int
    default 3

config MCUX_HW_DSP
    bool
    default y

config MCUX_HW_SAU
    bool
    default y

config MCUX_HW_SOC_SERIES_LPC
    bool
    default y

config MCUX_HW_SOC_SINGLECORE_DEVICE
    bool
    default y

# device related

config MCUX_HW_DEVICE_ID_LPC55S36
    bool

choice MCUX_HW_DEVICE_PART_LPC55S36
    prompt "Device LPC55S36 Part"
    config MCUX_HW_DEVICE_PART_LPC55S36JBD100
    bool "Device part LPC55S36JBD100"
    select MCUX_HW_DEVICE_ID_LPC55S36
    config MCUX_HW_DEVICE_PART_LPC55S36JHI48
    bool "Device part LPC55S36JHI48"
    select MCUX_HW_DEVICE_ID_LPC55S36
endchoice

config MCUX_HW_DEVICE_ID
    string
    default "LPC55S36" if MCUX_HW_DEVICE_ID_LPC55S36

config MCUX_HW_DEVICE_PART
    string
    default "LPC55S36JBD100" if MCUX_HW_DEVICE_PART_LPC55S36JBD100
    default "LPC55S36JHI48" if MCUX_HW_DEVICE_PART_LPC55S36JHI48

# For chipmodel generated files
config MCUX_TOOLCHAIN_LINKER_DEVICE_PREFIX
    string
    default "LPC55S36" if MCUX_HW_DEVICE_ID_LPC55S36

config MCUX_TOOLCHAIN_MCUX_STARTUP
    string
    default "lpc55s36"

# Toolchain related

config MCUX_TOOLCHAIN_IAR_CPU_IDENTIFIER
    string
    default "LPC55S36" if MCUX_HW_DEVICE_ID_LPC55S36

config MCUX_TOOLCHAIN_MDK_CPU_IDENTIFIER
    string
    default "LPC55S36JBD100" if MCUX_HW_DEVICE_PART_LPC55S36JBD100
    default "LPC55S36JHI48" if MCUX_HW_DEVICE_PART_LPC55S36JHI48

config MCUX_TOOLCHAIN_JLINK_CPU_IDENTIFIER
    string
    default "LPC55S36" if MCUX_HW_DEVICE_ID_LPC55S36

# ip information
config MCUX_HW_IP_DriverType_ANALOGCTRL
    bool
    default y
    depends on MCUX_HW_DEVICE_ID_LPC55S36

config MCUX_HW_IP_DriverType_AOI
    bool
    default y
    depends on MCUX_HW_DEVICE_ID_LPC55S36

config MCUX_HW_IP_DriverType_CACHE64_CTRL
    bool
    default y
    depends on MCUX_HW_DEVICE_ID_LPC55S36

config MCUX_HW_IP_DriverType_CACHE64_POLSEL
    bool
    default y
    depends on MCUX_HW_DEVICE_ID_LPC55S36

config MCUX_HW_IP_DriverType_CASPER
    bool
    default y
    depends on MCUX_HW_DEVICE_ID_LPC55S36

config MCUX_HW_IP_DriverType_CDOG
    bool
    default y
    depends on MCUX_HW_DEVICE_ID_LPC55S36

config MCUX_HW_IP_DriverType_CRC
    bool
    default y
    depends on MCUX_HW_DEVICE_ID_LPC55S36

config MCUX_HW_IP_DriverType_CTIMER
    bool
    default y
    depends on MCUX_HW_DEVICE_ID_LPC55S36

config MCUX_HW_IP_DriverType_DMIC
    bool
    default y
    depends on MCUX_HW_DEVICE_ID_LPC55S36

config MCUX_HW_IP_DriverType_ENC
    bool
    default y
    depends on MCUX_HW_DEVICE_ID_LPC55S36

config MCUX_HW_IP_DriverType_FLEXCOMM
    bool
    default y
    depends on MCUX_HW_DEVICE_ID_LPC55S36

config MCUX_HW_IP_DriverType_FLEXCOMM_I2C
    bool
    default y
    depends on MCUX_HW_DEVICE_ID_LPC55S36

config MCUX_HW_IP_DriverType_FLEXCOMM_I2S
    bool
    default y
    depends on MCUX_HW_DEVICE_ID_LPC55S36

config MCUX_HW_IP_DriverType_FLEXCOMM_SPI
    bool
    default y
    depends on MCUX_HW_DEVICE_ID_LPC55S36

config MCUX_HW_IP_DriverType_FLEXCOMM_USART
    bool
    default y
    depends on MCUX_HW_DEVICE_ID_LPC55S36

config MCUX_HW_IP_DriverType_FLEXSPI
    bool
    default y
    depends on MCUX_HW_DEVICE_ID_LPC55S36

config MCUX_HW_IP_DriverType_FLEXSPI_IPED
    bool
    default y
    depends on MCUX_HW_DEVICE_ID_LPC55S36

config MCUX_HW_IP_DriverType_FREQME
    bool
    default y
    depends on MCUX_HW_DEVICE_ID_LPC55S36

config MCUX_HW_IP_DriverType_GINT
    bool
    default y
    depends on MCUX_HW_DEVICE_ID_LPC55S36

config MCUX_HW_IP_DriverType_GPIO_PORT
    bool
    default y
    depends on MCUX_HW_DEVICE_ID_LPC55S36

config MCUX_HW_IP_DriverType_HASHCRYPT
    bool
    default y
    depends on MCUX_HW_DEVICE_ID_LPC55S36

config MCUX_HW_IP_DriverType_HSCMP
    bool
    default y
    depends on MCUX_HW_DEVICE_ID_LPC55S36

config MCUX_HW_IP_DriverType_I3C
    bool
    default y
    depends on MCUX_HW_DEVICE_ID_LPC55S36

config MCUX_HW_IP_DriverType_INPUTMUX
    bool
    default y
    depends on MCUX_HW_DEVICE_ID_LPC55S36

config MCUX_HW_IP_DriverType_IOCON
    bool
    default y
    depends on MCUX_HW_DEVICE_ID_LPC55S36

config MCUX_HW_IP_DriverType_ITRC
    bool
    default y
    depends on MCUX_HW_DEVICE_ID_LPC55S36

config MCUX_HW_IP_DriverType_LPADC
    bool
    default y
    depends on MCUX_HW_DEVICE_ID_LPC55S36

config MCUX_HW_IP_DriverType_LPC_Debug
    bool
    default y
    depends on MCUX_HW_DEVICE_ID_LPC55S36

config MCUX_HW_IP_DriverType_LPC_ELS
    bool
    default y
    depends on MCUX_HW_DEVICE_ID_LPC55S36

config MCUX_HW_IP_DriverType_LPC_FLASH
    bool
    default y
    depends on MCUX_HW_DEVICE_ID_LPC55S36

config MCUX_HW_IP_DriverType_LPC_GPIO
    bool
    default y
    depends on MCUX_HW_DEVICE_ID_LPC55S36

config MCUX_HW_IP_DriverType_LPC_MAILBOX
    bool
    default y
    depends on MCUX_HW_DEVICE_ID_LPC55S36

config MCUX_HW_IP_DriverType_LPC_PKC
    bool
    default y
    depends on MCUX_HW_DEVICE_ID_LPC55S36

config MCUX_HW_IP_DriverType_LPC_PMC
    bool
    default y
    depends on MCUX_HW_DEVICE_ID_LPC55S36

config MCUX_HW_IP_DriverType_LPC_RTC
    bool
    default y
    depends on MCUX_HW_DEVICE_ID_LPC55S36

config MCUX_HW_IP_DriverType_LPC_SECTRL
    bool
    default y
    depends on MCUX_HW_DEVICE_ID_LPC55S36

config MCUX_HW_IP_DriverType_LPC_SPI_FILTER
    bool
    default y
    depends on MCUX_HW_DEVICE_ID_LPC55S36

config MCUX_HW_IP_DriverType_LPDAC
    bool
    default y
    depends on MCUX_HW_DEVICE_ID_LPC55S36

config MCUX_HW_IP_DriverType_MCAN
    bool
    default y
    depends on MCUX_HW_DEVICE_ID_LPC55S36

config MCUX_HW_IP_DriverType_MRT
    bool
    default y
    depends on MCUX_HW_DEVICE_ID_LPC55S36

config MCUX_HW_IP_DriverType_OPAMP
    bool
    default y
    depends on MCUX_HW_DEVICE_ID_LPC55S36

config MCUX_HW_IP_DriverType_OSTIMER
    bool
    default y
    depends on MCUX_HW_DEVICE_ID_LPC55S36

config MCUX_HW_IP_DriverType_PINT
    bool
    default y
    depends on MCUX_HW_DEVICE_ID_LPC55S36

config MCUX_HW_IP_DriverType_PLU
    bool
    default y
    depends on MCUX_HW_DEVICE_ID_LPC55S36

config MCUX_HW_IP_DriverType_POWERQUAD
    bool
    default y
    depends on MCUX_HW_DEVICE_ID_LPC55S36

config MCUX_HW_IP_DriverType_PRINCE
    bool
    default y
    depends on MCUX_HW_DEVICE_ID_LPC55S36

config MCUX_HW_IP_DriverType_PUFV3
    bool
    default y
    depends on MCUX_HW_DEVICE_ID_LPC55S36

config MCUX_HW_IP_DriverType_PWM
    bool
    default y
    depends on MCUX_HW_DEVICE_ID_LPC55S36

config MCUX_HW_IP_DriverType_RNG_1
    bool
    default y
    depends on MCUX_HW_DEVICE_ID_LPC55S36

config MCUX_HW_IP_DriverType_RTC_V2
    bool
    default y
    depends on MCUX_HW_DEVICE_ID_LPC55S36

config MCUX_HW_IP_DriverType_SCTIMER
    bool
    default y
    depends on MCUX_HW_DEVICE_ID_LPC55S36

config MCUX_HW_IP_DriverType_SDMA
    bool
    default y
    depends on MCUX_HW_DEVICE_ID_LPC55S36

config MCUX_HW_IP_DriverType_SYSCON_CMP
    bool
    default y
    depends on MCUX_HW_DEVICE_ID_LPC55S36

config MCUX_HW_IP_DriverType_SYSCON_CMP_LPCAC
    bool
    default y
    depends on MCUX_HW_DEVICE_ID_LPC55S36

config MCUX_HW_IP_DriverType_SYSCON_LPCAC
    bool
    default y
    depends on MCUX_HW_DEVICE_ID_LPC55S36

config MCUX_HW_IP_DriverType_SYSCTL
    bool
    default y
    depends on MCUX_HW_DEVICE_ID_LPC55S36

config MCUX_HW_IP_DriverType_USB_DEVICE_IP3511FS
    bool
    default y
    depends on MCUX_HW_DEVICE_ID_LPC55S36

config MCUX_HW_IP_DriverType_USB_HOST_OHCI
    bool
    default y
    depends on MCUX_HW_DEVICE_ID_LPC55S36

config MCUX_HW_IP_DriverType_UTICK
    bool
    default y
    depends on MCUX_HW_DEVICE_ID_LPC55S36

config MCUX_HW_IP_DriverType_VREF_1
    bool
    default y
    depends on MCUX_HW_DEVICE_ID_LPC55S36

config MCUX_HW_IP_DriverType_WWDT
    bool
    default y
    depends on MCUX_HW_DEVICE_ID_LPC55S36
```

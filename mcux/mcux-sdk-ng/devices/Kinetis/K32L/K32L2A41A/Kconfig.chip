## mcux/mcux-sdk-ng/devices/Kinetis/KE/MKE12Z9/Kconfig.chip
```kconfig
# Copyright 2024 NXP
#
# SPDX-License-Identifier: BSD-3-Clause

# core related
config MCUX_HW_CORE
    string
    default "cm0p"

config MCUX_HW_CORE_CM0P
    bool
    default y

config MCUX_HW_CORE_ID
    string
    default "cm0plus"

config MCUX_HW_CORE_ID_CM0PLUS
    bool
    default y

config MCUX_HW_DEVICE_CORE
    string
    default "MKE12Z9"

config MCUX_HW_FPU
    string
    default "NO_FPU"

config MCUX_HW_FPU_TYPE
    string
    default "no_fpu"

config MCUX_HW_NO_FPU
    bool
    default y

config MCUX_HW_INT_PRIO_BITS
    int
    default 2

config MCUX_HW_SOC_SERIES_KINETIS
    bool
    default y

config MCUX_HW_SOC_SINGLECORE_DEVICE
    bool
    default y

# device related

config MCUX_HW_DEVICE_ID_MKE12Z512xxx9
    bool

choice
    prompt "Device MKE12Z9 Part"
    config MCUX_HW_DEVICE_PART_MKE12Z512VLL9
    bool "Device part MKE12Z512VLL9"
    select MCUX_HW_DEVICE_ID_MKE12Z512xxx9
    config MCUX_HW_DEVICE_PART_MKE12Z512VLH9
    bool "Device part MKE12Z512VLH9"
    select MCUX_HW_DEVICE_ID_MKE12Z512xxx9
endchoice

config MCUX_HW_DEVICE_ID
    string
    default "MKE12Z512xxx9" if MCUX_HW_DEVICE_ID_MKE12Z512xxx9

config MCUX_HW_DEVICE_PART
    string
    default "MKE12Z512VLL9" if MCUX_HW_DEVICE_PART_MKE12Z512VLL9
    default "MKE12Z512VLH9" if MCUX_HW_DEVICE_PART_MKE12Z512VLH9

# For chipmodel generated files
config MCUX_TOOLCHAIN_LINKER_DEVICE_PREFIX
    string
    default "MKE12Z512xxx9" if MCUX_HW_DEVICE_ID_MKE12Z512xxx9

config MCUX_TOOLCHAIN_MCUX_STARTUP
    string
    default "mke12z9"

# Toolchain related

config MCUX_TOOLCHAIN_IAR_CPU_IDENTIFIER
    string
    default "MKE12Z512xxx9" if MCUX_HW_DEVICE_ID_MKE12Z512xxx9

config MCUX_TOOLCHAIN_MDK_CPU_IDENTIFIER
    string
    default "MKE12Z512VLL9" if MCUX_HW_DEVICE_PART_MKE12Z512VLL9
    default "MKE12Z512VLH9" if MCUX_HW_DEVICE_PART_MKE12Z512VLH9

config MCUX_TOOLCHAIN_JLINK_CPU_IDENTIFIER
    string
    default "MKE12Z512xxx9"

# ip information
config MCUX_HW_IP_DriverType_ACMP
    bool
    default y
    depends on MCUX_HW_DEVICE_ID_MKE12Z512xxx9

config MCUX_HW_IP_DriverType_ADC12
    bool
    default y
    depends on MCUX_HW_DEVICE_ID_MKE12Z512xxx9

config MCUX_HW_IP_DriverType_AIPS
    bool
    default y
    depends on MCUX_HW_DEVICE_ID_MKE12Z512xxx9

config MCUX_HW_IP_DriverType_AXBS
    bool
    default y
    depends on MCUX_HW_DEVICE_ID_MKE12Z512xxx9

config MCUX_HW_IP_DriverType_CRC
    bool
    default y
    depends on MCUX_HW_DEVICE_ID_MKE12Z512xxx9

config MCUX_HW_IP_DriverType_DMAMUX
    bool
    default y
    depends on MCUX_HW_DEVICE_ID_MKE12Z512xxx9

config MCUX_HW_IP_DriverType_EDMA
    bool
    default y
    depends on MCUX_HW_DEVICE_ID_MKE12Z512xxx9

config MCUX_HW_IP_DriverType_EWM
    bool
    default y
    depends on MCUX_HW_DEVICE_ID_MKE12Z512xxx9

config MCUX_HW_IP_DriverType_FGPIO
    bool
    default y
    depends on MCUX_HW_DEVICE_ID_MKE12Z512xxx9

config MCUX_HW_IP_DriverType_FLEXIO
    bool
    default y
    depends on MCUX_HW_DEVICE_ID_MKE12Z512xxx9

config MCUX_HW_IP_DriverType_FTFE
    bool
    default y
    depends on MCUX_HW_DEVICE_ID_MKE12Z512xxx9

config MCUX_HW_IP_DriverType_FTM
    bool
    default y
    depends on MCUX_HW_DEVICE_ID_MKE12Z512xxx9

config MCUX_HW_IP_DriverType_GPIO
    bool
    default y
    depends on MCUX_HW_DEVICE_ID_MKE12Z512xxx9

config MCUX_HW_IP_DriverType_LPI2C
    bool
    default y
    depends on MCUX_HW_DEVICE_ID_MKE12Z512xxx9

config MCUX_HW_IP_DriverType_LPIT
    bool
    default y
    depends on MCUX_HW_DEVICE_ID_MKE12Z512xxx9

config MCUX_HW_IP_DriverType_LPSPI
    bool
    default y
    depends on MCUX_HW_DEVICE_ID_MKE12Z512xxx9

config MCUX_HW_IP_DriverType_LPTMR
    bool
    default y
    depends on MCUX_HW_DEVICE_ID_MKE12Z512xxx9

config MCUX_HW_IP_DriverType_LPUART
    bool
    default y
    depends on MCUX_HW_DEVICE_ID_MKE12Z512xxx9

config MCUX_HW_IP_DriverType_MCM
    bool
    default y
    depends on MCUX_HW_DEVICE_ID_MKE12Z512xxx9

config MCUX_HW_IP_DriverType_MTB
    bool
    default y
    depends on MCUX_HW_DEVICE_ID_MKE12Z512xxx9

config MCUX_HW_IP_DriverType_NV
    bool
    default y
    depends on MCUX_HW_DEVICE_ID_MKE12Z512xxx9

config MCUX_HW_IP_DriverType_PCC
    bool
    default y
    depends on MCUX_HW_DEVICE_ID_MKE12Z512xxx9

config MCUX_HW_IP_DriverType_PMC
    bool
    default y
    depends on MCUX_HW_DEVICE_ID_MKE12Z512xxx9

config MCUX_HW_IP_DriverType_PORT
    bool
    default y
    depends on MCUX_HW_DEVICE_ID_MKE12Z512xxx9

config MCUX_HW_IP_DriverType_PWT
    bool
    default y
    depends on MCUX_HW_DEVICE_ID_MKE12Z512xxx9

config MCUX_HW_IP_DriverType_RCM
    bool
    default y
    depends on MCUX_HW_DEVICE_ID_MKE12Z512xxx9

config MCUX_HW_IP_DriverType_SCG
    bool
    default y
    depends on MCUX_HW_DEVICE_ID_MKE12Z512xxx9

config MCUX_HW_IP_DriverType_SIM
    bool
    default y
    depends on MCUX_HW_DEVICE_ID_MKE12Z512xxx9

config MCUX_HW_IP_DriverType_SMC
    bool
    default y
    depends on MCUX_HW_DEVICE_ID_MKE12Z512xxx9

config MCUX_HW_IP_DriverType_SRTC
    bool
    default y
    depends on MCUX_HW_DEVICE_ID_MKE12Z512xxx9

config MCUX_HW_IP_DriverType_SYSRAM
    bool
    default y
    depends on MCUX_HW_DEVICE_ID_MKE12Z512xxx9

config MCUX_HW_IP_DriverType_TRGMUX
    bool
    default y
    depends on MCUX_HW_DEVICE_ID_MKE12Z512xxx9

config MCUX_HW_IP_DriverType_UART
    bool
    default y
    depends on MCUX_HW_DEVICE_ID_MKE12Z512xxx9

config MCUX_HW_IP_DriverType_WDOG32
    bool
    default y
    depends on MCUX_HW_DEVICE_ID_MKE12Z512xxx9
```

## mcux/mcux-sdk-ng/devices/Kinetis/KE/MKE13Z7/Kconfig.chip
```kconfig
# Copyright 2024 NXP
#
# SPDX-License-Identifier: BSD-3-Clause

# core related
config MCUX_HW_CORE
    string
    default "cm0p"

config MCUX_HW_CORE_CM0P
    bool
    default y

config MCUX_HW_CORE_ID
    string
    default "core0"

config MCUX_HW_CORE_ID_CORE0
    bool
    default y

config MCUX_HW_DEVICE_CORE
    string
    default "MKE13Z7"

config MCUX_HW_FPU
    string
    default "NO_FPU"

config MCUX_HW_FPU_TYPE
    string
    default "no_fpu"

config MCUX_HW_NO_FPU
    bool
    default y

config MCUX_HW_INT_PRIO_BITS
    int
    default 2

config MCUX_HW_SOC_SERIES_KINETIS
    bool
    default y

config MCUX_HW_SOC_SINGLECORE_DEVICE
    bool
    default y

# device related

config MCUX_HW_DEVICE_ID_MKE13Z256xxx7
    bool

config MCUX_HW_DEVICE_ID_MKE13Z128xxx7
    bool

choice
    prompt "Device MKE13Z7 Part"
    config MCUX_HW_DEVICE_PART_MKE13Z256VLL7
    bool "Device part MKE13Z256VLL7"
    select MCUX_HW_DEVICE_ID_MKE13Z256xxx7
    config MCUX_HW_DEVICE_PART_MKE13Z256VLH7
    bool "Device part MKE13Z256VLH7"
    select MCUX_HW_DEVICE_ID_MKE13Z256xxx7
    config MCUX_HW_DEVICE_PART_MKE13Z256VLF7
    bool "Device part MKE13Z256VLF7"
    select MCUX_HW_DEVICE_ID_MKE13Z256xxx7
    config MCUX_HW_DEVICE_PART_MKE13Z128VLL7
    bool "Device part MKE13Z128VLL7"
    select MCUX_HW_DEVICE_ID_MKE13Z128xxx7
    config MCUX_HW_DEVICE_PART_MKE13Z128VLH7
    bool "Device part MKE13Z128VLH7"
    select MCUX_HW_DEVICE_ID_MKE13Z128xxx7
    config MCUX_HW_DEVICE_PART_MKE13Z128VLF7
    bool "Device part MKE13Z128VLF7"
    select MCUX_HW_DEVICE_ID_MKE13Z128xxx7
endchoice

config MCUX_HW_DEVICE_ID
    string
    default "MKE13Z256xxx7" if MCUX_HW_DEVICE_ID_MKE13Z256xxx7
    default "MKE13Z128xxx7" if MCUX_HW_DEVICE_ID_MKE13Z128xxx7

config MCUX_HW_DEVICE_PART
    string
    default "MKE13Z256VLL7" if MCUX_HW_DEVICE_PART_MKE13Z256VLL7
    default "MKE13Z256VLH7" if MCUX_HW_DEVICE_PART_MKE13Z256VLH7
    default "MKE13Z256VLF7" if MCUX_HW_DEVICE_PART_MKE13Z256VLF7
    default "MKE13Z128VLL7" if MCUX_HW_DEVICE_PART_MKE13Z128VLL7
    default "MKE13Z128VLH7" if MCUX_HW_DEVICE_PART_MKE13Z128VLH7
    default "MKE13Z128VLF7" if MCUX_HW_DEVICE_PART_MKE13Z128VLF7

# For chipmodel generated files
config MCUX_TOOLCHAIN_LINKER_DEVICE_PREFIX
    string
    default "MKE13Z256xxx7" if MCUX_HW_DEVICE_ID_MKE13Z256xxx7
    default "MKE13Z128xxx7" if MCUX_HW_DEVICE_ID_MKE13Z128xxx7

config MCUX_TOOLCHAIN_MCUX_STARTUP
    string
    default "mke13z7"

# Toolchain related

config MCUX_TOOLCHAIN_IAR_CPU_IDENTIFIER
    string
    default "MKE13Z256xxx7" if MCUX_HW_DEVICE_ID_MKE13Z256xxx7
    default "MKE13Z128xxx7" if MCUX_HW_DEVICE_ID_MKE13Z128xxx7

config MCUX_TOOLCHAIN_MDK_CPU_IDENTIFIER
    string
    default "MKE13Z256VLL7" if MCUX_HW_DEVICE_PART_MKE13Z256VLL7
    default "MKE13Z256VLH7" if MCUX_HW_DEVICE_PART_MKE13Z256VLH7
    default "MKE13Z256VLF7" if MCUX_HW_DEVICE_PART_MKE13Z256VLF7
    default "MKE13Z128VLL7" if MCUX_HW_DEVICE_PART_MKE13Z128VLL7
    default "MKE13Z128VLH7" if MCUX_HW_DEVICE_PART_MKE13Z128VLH7
    default "MKE13Z128VLF7" if MCUX_HW_DEVICE_PART_MKE13Z128VLF7

config MCUX_TOOLCHAIN_JLINK_CPU_IDENTIFIER
    string
    default "MKE13Z256xxx7" if MCUX_HW_DEVICE_ID_MKE13Z256xxx7
    default "MKE13Z128xxx7" if MCUX_HW_DEVICE_ID_MKE13Z128xxx7

# ip information
config MCUX_HW_IP_DriverType_ACMP
    bool
    default y
    depends on MCUX_HW_DEVICE_ID_MKE13Z256xxx7 || MCUX_HW_DEVICE_ID_MKE13Z128xxx7

config MCUX_HW_IP_DriverType_ADC12
    bool
    default y
    depends on MCUX_HW_DEVICE_ID_MKE13Z256xxx7 || MCUX_HW_DEVICE_ID_MKE13Z128xxx7

config MCUX_HW_IP_DriverType_CRC
    bool
    default y
    depends on MCUX_HW_DEVICE_ID_MKE13Z256xxx7 || MCUX_HW_DEVICE_ID_MKE13Z128xxx7

config MCUX_HW_IP_DriverType_DMAMUX
    bool
    default y
    depends on MCUX_HW_DEVICE_ID_MKE13Z256xxx7 || MCUX_HW_DEVICE_ID_MKE13Z128xxx7

config MCUX_HW_IP_DriverType_EDMA
    bool
    default y
    depends on MCUX_HW_DEVICE_ID_MKE13Z256xxx7 || MCUX_HW_DEVICE_ID_MKE13Z128xxx7

config MCUX_HW_IP_DriverType_EWM
    bool
    default y
    depends on MCUX_HW_DEVICE_ID_MKE13Z256xxx7 || MCUX_HW_DEVICE_ID_MKE13Z128xxx7

config MCUX_HW_IP_DriverType_FGPIO
    bool
    default y
    depends on MCUX_HW_DEVICE_ID_MKE13Z256xxx7 || MCUX_HW_DEVICE_ID_MKE13Z128xxx7

config MCUX_HW_IP_DriverType_FLEXIO
    bool
    default y
    depends on MCUX_HW_DEVICE_ID_MKE13Z256xxx7 || MCUX_HW_DEVICE_ID_MKE13Z128xxx7

config MCUX_HW_IP_DriverType_FTFA
    bool
    default y
    depends on MCUX_HW_DEVICE_ID_MKE13Z256xxx7 || MCUX_HW_DEVICE_ID_MKE13Z128xxx7

config MCUX_HW_IP_DriverType_FTM
    bool
    default y
    depends on MCUX_HW_DEVICE_ID_MKE13Z256xxx7 || MCUX_HW_DEVICE_ID_MKE13Z128xxx7

config MCUX_HW_IP_DriverType_GPIO
    bool
    default y
    depends on MCUX_HW_DEVICE_ID_MKE13Z256xxx7 || MCUX_HW_DEVICE_ID_MKE13Z128xxx7

config MCUX_HW_IP_DriverType_LPI2C
    bool
    default y
    depends on MCUX_HW_DEVICE_ID_MKE13Z256xxx7 || MCUX_HW_DEVICE_ID_MKE13Z128xxx7

config MCUX_HW_IP_DriverType_LPIT
    bool
    default y
    depends on MCUX_HW_DEVICE_ID_MKE13Z256xxx7 || MCUX_HW_DEVICE_ID_MKE13Z128xxx7

config MCUX_HW_IP_DriverType_LPSPI
    bool
    default y
    depends on MCUX_HW_DEVICE_ID_MKE13Z256xxx7 || MCUX_HW_DEVICE_ID_MKE13Z128xxx7

config MCUX_HW_IP_DriverType_LPTMR
    bool
    default y
    depends on MCUX_HW_DEVICE_ID_MKE13Z256xxx7 || MCUX_HW_DEVICE_ID_MKE13Z128xxx7

config MCUX_HW_IP_DriverType_LPUART
    bool
    default y
    depends on MCUX_HW_DEVICE_ID_MKE13Z256xxx7 || MCUX_HW_DEVICE_ID_MKE13Z128xxx7

config MCUX_HW_IP_DriverType_MCM
    bool
    default y
    depends on MCUX_HW_DEVICE_ID_MKE13Z256xxx7 || MCUX_HW_DEVICE_ID_MKE13Z128xxx7

config MCUX_HW_IP_DriverType_MTB
    bool
    default y
    depends on MCUX_HW_DEVICE_ID_MKE13Z256xxx7 || MCUX_HW_DEVICE_ID_MKE13Z128xxx7

config MCUX_HW_IP_DriverType_MTBDWT
    bool
    default y
    depends on MCUX_HW_DEVICE_ID_MKE13Z256xxx7 || MCUX_HW_DEVICE_ID_MKE13Z128xxx7

config MCUX_HW_IP_DriverType_NV
    bool
    default y
    depends on MCUX_HW_DEVICE_ID_MKE13Z256xxx7 || MCUX_HW_DEVICE_ID_MKE13Z128xxx7

config MCUX_HW_IP_DriverType_PCC
    bool
    default y
    depends on MCUX_HW_DEVICE_ID_MKE13Z256xxx7 || MCUX_HW_DEVICE_ID_MKE13Z128xxx7

config MCUX_HW_IP_DriverType_PMC
    bool
    default y
    depends on MCUX_HW_DEVICE_ID_MKE13Z256xxx7 || MCUX_HW_DEVICE_ID_MKE13Z128xxx7

config MCUX_HW_IP_DriverType_PORT
    bool
    default y
    depends on MCUX_HW_DEVICE_ID_MKE13Z256xxx7 || MCUX_HW_DEVICE_ID_MKE13Z128xxx7

config MCUX_HW_IP_DriverType_PWT
    bool
    default y
    depends on MCUX_HW_DEVICE_ID_MKE13Z256xxx7 || MCUX_HW_DEVICE_ID_MKE13Z128xxx7

config MCUX_HW_IP_DriverType_RCM
    bool
    default y
    depends on MCUX_HW_DEVICE_ID_MKE13Z256xxx7 || MCUX_HW_DEVICE_ID_MKE13Z128xxx7

config MCUX_HW_IP_DriverType_ROM
    bool
    default y
    depends on MCUX_HW_DEVICE_ID_MKE13Z256xxx7 || MCUX_HW_DEVICE_ID_MKE13Z128xxx7

config MCUX_HW_IP_DriverType_SCG
    bool
    default y
    depends on MCUX_HW_DEVICE_ID_MKE13Z256xxx7 || MCUX_HW_DEVICE_ID_MKE13Z128xxx7

config MCUX_HW_IP_DriverType_SIM
    bool
    default y
    depends on MCUX_HW_DEVICE_ID_MKE13Z256xxx7 || MCUX_HW_DEVICE_ID_MKE13Z128xxx7

config MCUX_HW_IP_DriverType_SMC
    bool
    default y
    depends on MCUX_HW_DEVICE_ID_MKE13Z256xxx7 || MCUX_HW_DEVICE_ID_MKE13Z128xxx7

config MCUX_HW_IP_DriverType_SYSRAM
    bool
    default y
    depends on MCUX_HW_DEVICE_ID_MKE13Z256xxx7 || MCUX_HW_DEVICE_ID_MKE13Z128xxx7

config MCUX_HW_IP_DriverType_TRGMUX
    bool
    default y
    depends on MCUX_HW_DEVICE_ID_MKE13Z256xxx7 || MCUX_HW_DEVICE_ID_MKE13Z128xxx7

config MCUX_HW_IP_DriverType_TSI_V5
    bool
    default y
    depends on MCUX_HW_DEVICE_ID_MKE13Z256xxx7 || MCUX_HW_DEVICE_ID_MKE13Z128xxx7

config MCUX_HW_IP_DriverType_WDOG32
    bool
    default y
    depends on MCUX_HW_DEVICE_ID_MKE13Z256xxx7 || MCUX_HW_DEVICE_ID_MKE13Z128xxx7
```

## mcux/mcux-sdk-ng/devices/Kinetis/KE/MKE14Z4/Kconfig
```kconfig
# Copyright 2024 NXP
# All rights reserved.
#
# SPDX-License-Identifier: BSD-3-Clause

rsource "Kconfig.chip"
rsource "drivers/Kconfig"
rsource "../../../arm/Kconfig.common"
rsource "Kconfig.defconfig"

## pinmux dependency
config MCUX_DEPENDENCY_PINMUX
    bool
    default n

    imply MCUX_COMPONENT_driver.gpio
    imply MCUX_COMPONENT_driver.port

## Project segment and component dependency data
config MCUX_HW_DEVICE_MKE14Z4
    # bool "Device MKE14Z4 Configuration"
    bool
    default y
    ## Project segment dependency data

    select MCUX_COMPONENT_driver.port if MCUX_PRJSEG_module.board.pinmux
    select MCUX_COMPONENT_driver.gpio if MCUX_PRJSEG_module.board.pinmux
    select MCUX_COMPONENT_driver.clock if MCUX_PRJSEG_module.board.clock    
    select MCUX_COMPONENT_driver.smc if MCUX_PRJSEG_module.board.clock
    select MCUX_COMPONENT_component.lpuart_adapter if MCUX_PRJSEG_module.board.console_lite
    select MCUX_COMPONENT_driver.lpuart if MCUX_PRJSEG_module.board.console_lite

    # component dependency
    select MCUX_COMPONENT_component.lpuart_adapter if MCUX_COMPONENT_component.serial_manager_uart
    select MCUX_COMPONENT_component.lpuart_adapter if MCUX_COMPONENT_utility.debug_console_lite
```

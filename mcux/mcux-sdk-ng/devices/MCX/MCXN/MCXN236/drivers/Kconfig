## mcux/mcux-sdk-ng/devices/MCX/MCXN/MCXN236/drivers/Kconfig
```kconfig
# Copyright 2024 NXP
# All rights reserved.
#
# SPDX-License-Identifier: BSD-3-Clause

menu "Device specific drivers configuration"

    rsource "${SdkRootDirPath}/devices/MCX/MCXN/MCXN947/drivers/romapi/Kconfig"

    config MCUX_COMPONENT_driver.clock
         bool "Use driver clock"
         default y

    config MCUX_COMPONENT_driver.edma_soc
         bool "Use driver edma_soc"
         default n

    config MCUX_COMPONENT_driver.inputmux_connections
         bool "Use driver inputmux_connections"
         default y

    config MCUX_COMPONENT_driver.reset
         bool "Use driver reset"
         default y

endmenu
```

## mcux/mcux-sdk-ng/devices/MCX/MCXN/MCXN546/cm33_core0/Kconfig.chip
```kconfig
# Copyright 2024 NXP
# All rights reserved.
#
# SPDX-License-Identifier: BSD-3-Clause
# core related
config MCUX_HW_CORE
    string
    default "cm33"

config MCUX_HW_CORE_CM33
    bool
    default y

config MCUX_HW_CORE_ID
    string
    default "cm33_core0"

config MCUX_HW_CORE_ID_CM33_CORE0
    bool
    default y

config MCUX_HW_DEVICE_CORE
    string
    default "MCXN546_cm33_core0"

config MCUX_HW_FPU
    string
    default "SP_FPU"

config MCUX_HW_FPU_TYPE
    string
    default "fpv5_sp"

config MCUX_HW_FPV5_SP
    bool
    default y

config MCUX_HW_INT_PRIO_BITS
    int
    default 3

config MCUX_HW_DSP
    bool
    default y

config MCUX_HW_SAU
    bool
    default y

config MCUX_HW_SOC_SERIES_MCX
    bool
    default y

# For chipmodel generated files
config MCUX_TOOLCHAIN_LINKER_DEVICE_PREFIX
    string
    default "MCXN546_cm33_core0" if MCUX_HW_DEVICE_ID_MCXN546

config MCUX_TOOLCHAIN_MCUX_STARTUP
    string
    default "mcxn546_cm33_core0"

# Toolchain related

config MCUX_TOOLCHAIN_IAR_CPU_IDENTIFIER
    string
    default "MCXN546_core0" if MCUX_HW_DEVICE_ID_MCXN546

config MCUX_TOOLCHAIN_MDK_CPU_IDENTIFIER
    string
    default "MCXN546VDF:cm33_core0" if MCUX_HW_DEVICE_PART_MCXN546VDF
    default "MCXN546VPB:cm33_core0" if MCUX_HW_DEVICE_PART_MCXN546VPB
    default "MCXN546VNL:cm33_core0" if MCUX_HW_DEVICE_PART_MCXN546VNL

config MCUX_TOOLCHAIN_JLINK_CPU_IDENTIFIER
    string
    default "MCXN546_M33_0" if MCUX_HW_DEVICE_ID_MCXN546
```

## mcux/mcux-sdk-ng/devices/MCX/MCXN/MCXN547/Kconfig.chip
```kconfig
# Copyright 2024 NXP
#
# SPDX-License-Identifier: BSD-3-Clause

# device related

config MCUX_HW_DEVICE_ID_MCXN547
    bool

choice MCUX_HW_DEVICE_PART_MCXN547
    prompt "Device MCXN547 Part"
    config MCUX_HW_DEVICE_PART_MCXN547VDF
    bool "Device part MCXN547VDF"
    select MCUX_HW_DEVICE_ID_MCXN547
    config MCUX_HW_DEVICE_PART_MCXN547VPB
    bool "Device part MCXN547VPB"
    select MCUX_HW_DEVICE_ID_MCXN547
    config MCUX_HW_DEVICE_PART_MCXN547VNL
    bool "Device part MCXN547VNL"
    select MCUX_HW_DEVICE_ID_MCXN547
endchoice

config MCUX_HW_DEVICE_ID
    string
    default "MCXN547" if MCUX_HW_DEVICE_ID_MCXN547

config MCUX_HW_DEVICE_PART
    string
    default "MCXN547VDF" if MCUX_HW_DEVICE_PART_MCXN547VDF
    default "MCXN547VPB" if MCUX_HW_DEVICE_PART_MCXN547VPB
    default "MCXN547VNL" if MCUX_HW_DEVICE_PART_MCXN547VNL

# ip information
config MCUX_HW_IP_DriverType_AHBSC
    bool
    default y
    depends on MCUX_HW_DEVICE_ID_MCXN547

config MCUX_HW_IP_DriverType_CACHE64_CTRL
    bool
    default y
    depends on MCUX_HW_DEVICE_ID_MCXN547

config MCUX_HW_IP_DriverType_CACHE64_POLSEL
    bool
    default y
    depends on MCUX_HW_DEVICE_ID_MCXN547

config MCUX_HW_IP_DriverType_CDOG
    bool
    default y
    depends on MCUX_HW_DEVICE_ID_MCXN547

config MCUX_HW_IP_DriverType_CRC
    bool
    default y
    depends on MCUX_HW_DEVICE_ID_MCXN547

config MCUX_HW_IP_DriverType_CTIMER
    bool
    default y
    depends on MCUX_HW_DEVICE_ID_MCXN547

config MCUX_HW_IP_DriverType_CoolFlux_BSP32
    bool
    default y
    depends on MCUX_HW_DEVICE_ID_MCXN547

config MCUX_HW_IP_DriverType_DBGMB
    bool
    default y
    depends on MCUX_HW_DEVICE_ID_MCXN547

config MCUX_HW_IP_DriverType_DIGTMP
    bool
    default y
    depends on MCUX_HW_DEVICE_ID_MCXN547

config MCUX_HW_IP_DriverType_EDMA3
    bool
    default y
    depends on MCUX_HW_DEVICE_ID_MCXN547

config MCUX_HW_IP_DriverType_EIM
    bool
    default y
    depends on MCUX_HW_DEVICE_ID_MCXN547

config MCUX_HW_IP_DriverType_EMVSIM
    bool
    default y
    depends on MCUX_HW_DEVICE_ID_MCXN547

config MCUX_HW_IP_DriverType_ERM
    bool
    default y
    depends on MCUX_HW_DEVICE_ID_MCXN547

config MCUX_HW_IP_DriverType_EVTG
    bool
    default y
    depends on MCUX_HW_DEVICE_ID_MCXN547

config MCUX_HW_IP_DriverType_EWM
    bool
    default y
    depends on MCUX_HW_DEVICE_ID_MCXN547

config MCUX_HW_IP_DriverType_FLEXCAN
    bool
    default y
    depends on MCUX_HW_DEVICE_ID_MCXN547

config MCUX_HW_IP_DriverType_FLEXIO
    bool
    default y
    depends on MCUX_HW_DEVICE_ID_MCXN547

config MCUX_HW_IP_DriverType_FLEXSPI
    bool
    default y
    depends on MCUX_HW_DEVICE_ID_MCXN547

config MCUX_HW_IP_DriverType_FLEXSPI_IPED
    bool
    default y
    depends on MCUX_HW_DEVICE_ID_MCXN547

config MCUX_HW_IP_DriverType_FMC
    bool
    default y
    depends on MCUX_HW_DEVICE_ID_MCXN547

config MCUX_HW_IP_DriverType_FMU
    bool
    default y
    depends on MCUX_HW_DEVICE_ID_MCXN547

config MCUX_HW_IP_DriverType_FREQME
    bool
    default y
    depends on MCUX_HW_DEVICE_ID_MCXN547

config MCUX_HW_IP_DriverType_GDET
    bool
    default y
    depends on MCUX_HW_DEVICE_ID_MCXN547

config MCUX_HW_IP_DriverType_GPIO
    bool
    default y
    depends on MCUX_HW_DEVICE_ID_MCXN547

config MCUX_HW_IP_DriverType_I3C
    bool
    default y
    depends on MCUX_HW_DEVICE_ID_MCXN547

config MCUX_HW_IP_DriverType_INPUTMUX
    bool
    default y
    depends on MCUX_HW_DEVICE_ID_MCXN547

config MCUX_HW_IP_DriverType_INTM
    bool
    default y
    depends on MCUX_HW_DEVICE_ID_MCXN547

config MCUX_HW_IP_DriverType_IPCSS
    bool
    default y
    depends on MCUX_HW_DEVICE_ID_MCXN547

config MCUX_HW_IP_DriverType_ITRC
    bool
    default y
    depends on MCUX_HW_DEVICE_ID_MCXN547

config MCUX_HW_IP_DriverType_LPADC
    bool
    default y
    depends on MCUX_HW_DEVICE_ID_MCXN547

config MCUX_HW_IP_DriverType_LPCMP
    bool
    default y
    depends on MCUX_HW_DEVICE_ID_MCXN547

config MCUX_HW_IP_DriverType_LPDAC
    bool
    default y
    depends on MCUX_HW_DEVICE_ID_MCXN547

config MCUX_HW_IP_DriverType_LPFLEXCOMM
    bool
    default y
    depends on MCUX_HW_DEVICE_ID_MCXN547

config MCUX_HW_IP_DriverType_LPFLEXCOMM_LPI2C
    bool
    default y
    depends on MCUX_HW_DEVICE_ID_MCXN547

config MCUX_HW_IP_DriverType_LPFLEXCOMM_LPSPI
    bool
    default y
    depends on MCUX_HW_DEVICE_ID_MCXN547

config MCUX_HW_IP_DriverType_LPFLEXCOMM_LPUART
    bool
    default y
    depends on MCUX_HW_DEVICE_ID_MCXN547

config MCUX_HW_IP_DriverType_LPTMR
    bool
    default y
    depends on MCUX_HW_DEVICE_ID_MCXN547

config MCUX_HW_IP_DriverType_MAILBOX
    bool
    default y
    depends on MCUX_HW_DEVICE_ID_MCXN547

config MCUX_HW_IP_DriverType_MCX_CMC
    bool
    default y
    depends on MCUX_HW_DEVICE_ID_MCXN547

config MCUX_HW_IP_DriverType_MCX_ENET
    bool
    default y
    depends on MCUX_HW_DEVICE_ID_MCXN547

config MCUX_HW_IP_DriverType_MCX_SPC
    bool
    default y
    depends on MCUX_HW_DEVICE_ID_MCXN547

config MCUX_HW_IP_DriverType_MCX_VBAT
    bool
    default y
    depends on MCUX_HW_DEVICE_ID_MCXN547

config MCUX_HW_IP_DriverType_MRT
    bool
    default y
    depends on MCUX_HW_DEVICE_ID_MCXN547

config MCUX_HW_IP_DriverType_OSTIMER
    bool
    default y
    depends on MCUX_HW_DEVICE_ID_MCXN547

config MCUX_HW_IP_DriverType_OTPC
    bool
    default y
    depends on MCUX_HW_DEVICE_ID_MCXN547

config MCUX_HW_IP_DriverType_PDM
    bool
    default y
    depends on MCUX_HW_DEVICE_ID_MCXN547

config MCUX_HW_IP_DriverType_PINT
    bool
    default y
    depends on MCUX_HW_DEVICE_ID_MCXN547

config MCUX_HW_IP_DriverType_PKC
    bool
    default y
    depends on MCUX_HW_DEVICE_ID_MCXN547

config MCUX_HW_IP_DriverType_PLU
    bool
    default y
    depends on MCUX_HW_DEVICE_ID_MCXN547

config MCUX_HW_IP_DriverType_PORT
    bool
    default y
    depends on MCUX_HW_DEVICE_ID_MCXN547

config MCUX_HW_IP_DriverType_POWERQUAD
    bool
    default y
    depends on MCUX_HW_DEVICE_ID_MCXN547

config MCUX_HW_IP_DriverType_PRINCE
    bool
    default y
    depends on MCUX_HW_DEVICE_ID_MCXN547

config MCUX_HW_IP_DriverType_PUF
    bool
    default y
    depends on MCUX_HW_DEVICE_ID_MCXN547

config MCUX_HW_IP_DriverType_PUFCTRL
    bool
    default y
    depends on MCUX_HW_DEVICE_ID_MCXN547

config MCUX_HW_IP_DriverType_PUFV3
    bool
    default y
    depends on MCUX_HW_DEVICE_ID_MCXN547

config MCUX_HW_IP_DriverType_PWM
    bool
    default y
    depends on MCUX_HW_DEVICE_ID_MCXN547

config MCUX_HW_IP_DriverType_QDC
    bool
    default y
    depends on MCUX_HW_DEVICE_ID_MCXN547

config MCUX_HW_IP_DriverType_RNG_1
    bool
    default y
    depends on MCUX_HW_DEVICE_ID_MCXN547

config MCUX_HW_IP_DriverType_RTC
    bool
    default y
    depends on MCUX_HW_DEVICE_ID_MCXN547

config MCUX_HW_IP_DriverType_RTC_V2
    bool
    default y
    depends on MCUX_HW_DEVICE_ID_MCXN547

config MCUX_HW_IP_DriverType_SAI
    bool
    default y
    depends on MCUX_HW_DEVICE_ID_MCXN547

config MCUX_HW_IP_DriverType_SCG
    bool
    default y
    depends on MCUX_HW_DEVICE_ID_MCXN547

config MCUX_HW_IP_DriverType_SCTIMER
    bool
    default y
    depends on MCUX_HW_DEVICE_ID_MCXN547

config MCUX_HW_IP_DriverType_SEMA42
    bool
    default y
    depends on MCUX_HW_DEVICE_ID_MCXN547

config MCUX_HW_IP_DriverType_SMARTDMA
    bool
    default y
    depends on MCUX_HW_DEVICE_ID_MCXN547

config MCUX_HW_IP_DriverType_SWD
    bool
    default y
    depends on MCUX_HW_DEVICE_ID_MCXN547

config MCUX_HW_IP_DriverType_SYSCON_LPCAC
    bool
    default y
    depends on MCUX_HW_DEVICE_ID_MCXN547

config MCUX_HW_IP_DriverType_SYSPM
    bool
    default y
    depends on MCUX_HW_DEVICE_ID_MCXN547

config MCUX_HW_IP_DriverType_TRDC_1
    bool
    default y
    depends on MCUX_HW_DEVICE_ID_MCXN547

config MCUX_HW_IP_DriverType_TSI_V6
    bool
    default y
    depends on MCUX_HW_DEVICE_ID_MCXN547

config MCUX_HW_IP_DriverType_USBHSDCD
    bool
    default y
    depends on MCUX_HW_DEVICE_ID_MCXN547

config MCUX_HW_IP_DriverType_USBNC
    bool
    default y
    depends on MCUX_HW_DEVICE_ID_MCXN547

config MCUX_HW_IP_DriverType_USB_HOST_DEVICE_EHCI
    bool
    default y
    depends on MCUX_HW_DEVICE_ID_MCXN547

config MCUX_HW_IP_DriverType_USB_HOST_DEVICE_KHCI
    bool
    default y
    depends on MCUX_HW_DEVICE_ID_MCXN547

config MCUX_HW_IP_DriverType_USB_HSDCD
    bool
    default y
    depends on MCUX_HW_DEVICE_ID_MCXN547

config MCUX_HW_IP_DriverType_USB_PHY
    bool
    default y
    depends on MCUX_HW_DEVICE_ID_MCXN547

config MCUX_HW_IP_DriverType_USDHC
    bool
    default y
    depends on MCUX_HW_DEVICE_ID_MCXN547

config MCUX_HW_IP_DriverType_USIM
    bool
    default y
    depends on MCUX_HW_DEVICE_ID_MCXN547

config MCUX_HW_IP_DriverType_UTICK
    bool
    default y
    depends on MCUX_HW_DEVICE_ID_MCXN547

config MCUX_HW_IP_DriverType_VREF_1
    bool
    default y
    depends on MCUX_HW_DEVICE_ID_MCXN547

config MCUX_HW_IP_DriverType_WUU
    bool
    default y
    depends on MCUX_HW_DEVICE_ID_MCXN547

config MCUX_HW_IP_DriverType_WWDT
    bool
    default y
    depends on MCUX_HW_DEVICE_ID_MCXN547
```

## mcux/mcux-sdk-ng/devices/MCX/MCXN/MCXN547/cm33_core1/Kconfig.chip
```kconfig
# Copyright 2024 NXP
# All rights reserved.
#
# SPDX-License-Identifier: BSD-3-Clause
# core related
config MCUX_HW_CORE
    string
    default "cm33"

config MCUX_HW_CORE_CM33
    bool
    default y

config MCUX_HW_CORE_ID
    string
    default "cm33_core1"

config MCUX_HW_CORE_ID_CM33_CORE1
    bool
    default y

config MCUX_HW_DEVICE_CORE
    string
    default "MCXN547_cm33_core1"

config MCUX_HW_FPU
    string
    default "NO_FPU"

config MCUX_HW_FPU_TYPE
    string
    default "no_fpu"

config MCUX_HW_NO_FPU
    bool
    default y

config MCUX_HW_INT_PRIO_BITS
    int
    default 3

config MCUX_HW_DSP
    bool
    default n

config MCUX_HW_SAU
    bool
    default n

config MCUX_HW_SOC_SERIES_MCX
    bool
    default y

# For chipmodel generated files
config MCUX_TOOLCHAIN_LINKER_DEVICE_PREFIX
    string
    default "MCXN547_cm33_core1" if MCUX_HW_DEVICE_ID_MCXN547

config MCUX_TOOLCHAIN_MCUX_STARTUP
    string
    default "mcxn547_cm33_core1"

# Toolchain related

config MCUX_TOOLCHAIN_IAR_CPU_IDENTIFIER
    string
    default "MCXN547_core1" if MCUX_HW_DEVICE_ID_MCXN547

config MCUX_TOOLCHAIN_MDK_CPU_IDENTIFIER
    string
    default "MCXN547VDF:cm33_core1" if MCUX_HW_DEVICE_PART_MCXN547VDF
    default "MCXN547VPB:cm33_core1" if MCUX_HW_DEVICE_PART_MCXN547VPB
    default "MCXN547VNL:cm33_core1" if MCUX_HW_DEVICE_PART_MCXN547VNL

config MCUX_TOOLCHAIN_JLINK_CPU_IDENTIFIER
    string
    default "MCXN547_M33_1" if MCUX_HW_DEVICE_ID_MCXN547
```

## mcux/mcux-sdk-ng/devices/MCX/MCXN/MCXN946/Kconfig
```kconfig
# Copyright 2024 NXP
# All rights reserved.
#
# SPDX-License-Identifier: BSD-3-Clause
rsource "${core_id}/Kconfig"

rsource "Kconfig.chip"
rsource "../MCXN947/drivers/Kconfig"
rsource "../../../arm/Kconfig.common"
rsource "Kconfig.defconfig"

## Project segment and component dependency data
config MCUX_HW_DEVICE_MCXN946
    # bool "Device MCXN946 Configuration"
    bool
    default y

    # component dependency
    select MCUX_COMPONENT_driver.edma4 if MCUX_COMPONENT_device.RTE
    select MCUX_COMPONENT_component.lpuart_adapter if MCUX_COMPONENT_component.serial_manager_uart
    select MCUX_COMPONENT_component.lpuart_adapter if MCUX_COMPONENT_utility.debug_console_lite
    select MCUX_COMPONENT_driver.mcx_spc if MCUX_COMPONENT_driver.clock
    select MCUX_COMPONENT_driver.edma_soc if MCUX_COMPONENT_driver.edma4
    select MCUX_COMPONENT_driver.edma4 if MCUX_COMPONENT_driver.flexio_mculcd_edma
    select MCUX_COMPONENT_driver.smartdma if MCUX_COMPONENT_driver.flexio_mculcd_smartdma
    select MCUX_COMPONENT_driver.trdc_soc if MCUX_COMPONENT_driver.trdc_1
    select MCUX_COMPONENT_driver.edma4 if MCUX_COMPONENT_driver.sai_edma
    select MCUX_COMPONENT_driver.edma4 if MCUX_COMPONENT_driver.lpuart_edma
    select MCUX_COMPONENT_driver.edma4 if MCUX_COMPONENT_driver.lpspi_edma
    select MCUX_COMPONENT_driver.lpflexcomm_lpspi if MCUX_COMPONENT_driver.lpspi_edma
    select MCUX_COMPONENT_driver.edma4 if MCUX_COMPONENT_driver.lpi2c_edma
    select MCUX_COMPONENT_driver.lpflexcomm_lpi2c if MCUX_COMPONENT_driver.lpi2c_edma
    select MCUX_COMPONENT_driver.lpflexcomm_lpuart_edma if MCUX_COMPONENT_driver.cmsis_lpuart
    select MCUX_COMPONENT_driver.lpflexcomm_lpspi_edma if MCUX_COMPONENT_driver.cmsis_lpspi
    select MCUX_COMPONENT_driver.lpflexcomm_lpi2c_edma if MCUX_COMPONENT_driver.cmsis_lpi2c
    select MCUX_COMPONENT_driver.edma4 if MCUX_COMPONENT_driver.flexcan_edma
    select MCUX_COMPONENT_driver.edma4 if MCUX_COMPONENT_driver.flexio_spi_edma
    select MCUX_COMPONENT_driver.edma4 if MCUX_COMPONENT_driver.flexio_uart_edma
    select MCUX_COMPONENT_driver.edma4 if MCUX_COMPONENT_driver.pdm_edma
```

## mcux/mcux-sdk-ng/devices/MCX/MCXN/MCXN946/cm33_core0/Kconfig
```kconfig
# Copyright 2024 NXP
# All rights reserved.
#
# SPDX-License-Identifier: BSD-3-Clause

config MCUX_HW_DEVICE_MCXN946_CORE_ID_cm33_core0
    bool
    default y

rsource "Kconfig.chip"
```

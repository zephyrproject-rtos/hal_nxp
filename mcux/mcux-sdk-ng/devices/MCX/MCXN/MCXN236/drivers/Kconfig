## mcux/mcux-sdk-ng/devices/MCX/MCXN/MCXN946/cm33_core0/Kconfig.chip
```kconfig
# Copyright 2024 NXP
# All rights reserved.
#
# SPDX-License-Identifier: BSD-3-Clause
# core related
config MCUX_HW_CORE
    string
    default "cm33"

config MCUX_HW_CORE_CM33
    bool
    default y

config MCUX_HW_CORE_ID
    string
    default "cm33_core0"

config MCUX_HW_CORE_ID_CM33_CORE0
    bool
    default y

config MCUX_HW_DEVICE_CORE
    string
    default "MCXN946_cm33_core0"

config MCUX_HW_FPU
    string
    default "SP_FPU"

config MCUX_HW_FPU_TYPE
    string
    default "fpv5_sp"

config MCUX_HW_FPV5_SP
    bool
    default y

config MCUX_HW_INT_PRIO_BITS
    int
    default 3

config MCUX_HW_DSP
    bool
    default y

config MCUX_HW_SAU
    bool
    default y

config MCUX_HW_SOC_SERIES_MCX
    bool
    default y

# For chipmodel generated files
config MCUX_TOOLCHAIN_LINKER_DEVICE_PREFIX
    string
    default "MCXN946_cm33_core0" if MCUX_HW_DEVICE_ID_MCXN946

config MCUX_TOOLCHAIN_MCUX_STARTUP
    string
    default "mcxn946_cm33_core0"

# Toolchain related

config MCUX_TOOLCHAIN_IAR_CPU_IDENTIFIER
    string
    default "MCXN946_core0" if MCUX_HW_DEVICE_ID_MCXN946

config MCUX_TOOLCHAIN_MDK_CPU_IDENTIFIER
    string
    default "MCXN946VDF:cm33_core0" if MCUX_HW_DEVICE_PART_MCXN946VDF
    default "MCXN946VPB:cm33_core0" if MCUX_HW_DEVICE_PART_MCXN946VPB
    default "MCXN946VNL:cm33_core0" if MCUX_HW_DEVICE_PART_MCXN946VNL

config MCUX_TOOLCHAIN_JLINK_CPU_IDENTIFIER
    string
    default "MCXN946_M33_0" if MCUX_HW_DEVICE_ID_MCXN946
```

## mcux/mcux-sdk-ng/devices/MCX/MCXN/MCXN947/cm33_core0/Kconfig.chip
```kconfig
# Copyright 2024 NXP
# All rights reserved.
#
# SPDX-License-Identifier: BSD-3-Clause
# core related
config MCUX_HW_CORE
    string
    default "cm33"

config MCUX_HW_CORE_CM33
    bool
    default y

config MCUX_HW_CORE_ID
    string
    default "cm33_core0"

config MCUX_HW_CORE_ID_CM33_CORE0
    bool
    default y

config MCUX_HW_DEVICE_CORE
    string
    default "MCXN947_cm33_core0"

config MCUX_HW_FPU
    string
    default "SP_FPU"

config MCUX_HW_FPU_TYPE
    string
    default "fpv5_sp"

config MCUX_HW_FPV5_SP
    bool
    default y

config MCUX_HW_INT_PRIO_BITS
    int
    default 3

config MCUX_HW_DSP
    bool
    default y

config MCUX_HW_SAU
    bool
    default y

config MCUX_HW_SOC_SERIES_MCX
    bool
    default y

# For chipmodel generated files
config MCUX_TOOLCHAIN_LINKER_DEVICE_PREFIX
    string
    default "MCXN947_cm33_core0" if MCUX_HW_DEVICE_ID_MCXN947

config MCUX_TOOLCHAIN_MCUX_STARTUP
    string
    default "mcxn947_cm33_core0"

# Toolchain related

config MCUX_TOOLCHAIN_IAR_CPU_IDENTIFIER
    string
    default "MCXN947_core0" if MCUX_HW_DEVICE_ID_MCXN947

config MCUX_TOOLCHAIN_MDK_CPU_IDENTIFIER
    string
    default "MCXN947VDF:cm33_core0" if MCUX_HW_DEVICE_PART_MCXN947VDF
    default "MCXN947VPB:cm33_core0" if MCUX_HW_DEVICE_PART_MCXN947VPB
    default "MCXN947VNL:cm33_core0" if MCUX_HW_DEVICE_PART_MCXN947VNL

config MCUX_TOOLCHAIN_JLINK_CPU_IDENTIFIER
    string
    default "MCXN947_M33_0" if MCUX_HW_DEVICE_ID_MCXN947
```

## mcux/mcux-sdk-ng/devices/MCX/MCXN/MCXN947/drivers/romapi/Kconfig
```kconfig
# Copyright 2024 NXP
#
# SPDX-License-Identifier: BSD-3-Clause

config MCUX_HAS_COMPONENT_driver.romapi
    bool
    default y

config MCUX_COMPONENT_driver.romapi
    bool "Use driver romapi"
    select MCUX_COMPONENT_driver.common
    depends on MCUX_HAS_COMPONENT_driver.romapi

config MCUX_COMPONENT_driver.mem_interface
    bool "Use driver mem_interface"
    select MCUX_COMPONENT_driver.common
    depends on MCUX_HAS_COMPONENT_driver.romapi

config MCUX_COMPONENT_driver.romapi_nboot
    bool "Use driver romapi_nboot"
    select MCUX_COMPONENT_driver.common
    depends on MCUX_HAS_COMPONENT_driver.romapi

config MCUX_COMPONENT_driver.runbootloader
    bool "Use driver runbootloader"
    select MCUX_COMPONENT_driver.common
    depends on MCUX_HAS_COMPONENT_driver.romapi

config MCUX_COMPONENT_driver.romapi_flashiap
    bool "Use driver romapi_flashiap"
    select MCUX_COMPONENT_driver.common
    depends on MCUX_HAS_COMPONENT_driver.romapi
```

## mcux/mcux-sdk-ng/devices/MCX/MCXW/MCXW70AC/drivers/Kconfig
```kconfig
# Copyright 2026 NXP
#
# SPDX-License-Identifier: BSD-3-Clause

menu "Device specific drivers configuration"
     rsource "./Kconfig_clock"
     rsource "./Kconfig_romapi"
endmenu
```

## mcux/mcux-sdk-ng/devices/MCX/MCXW/MCXW716A/drivers/Kconfig
```kconfig
# Copyright 2024 NXP
#
# SPDX-License-Identifier: BSD-3-Clause

menu "Device specific drivers configuration"

    rsource "../../MCXW716C/drivers/Kconfig_clock"
    rsource "../../MCXW716C/drivers/Kconfig_romapi"

endmenu
```

## mcux/mcux-sdk-ng/devices/MCX/MCXW/MCXW727A/cm33_core1/Kconfig.chip
```kconfig
# Copyright 2024 NXP
#
# SPDX-License-Identifier: BSD-3-Clause

# core related
config MCUX_HW_CORE
    string
    default "cm33"

config MCUX_HW_CORE_CM33
    bool
    default y

config MCUX_HW_CORE_ID
    string
    default "cm33_core1"

config MCUX_HW_CORE_ID_CM33_CORE1
    bool
    default y

config MCUX_HW_DEVICE_CORE
    string
    default "MCXW727A_cm33_core1"

config MCUX_HW_FPU
    string
    default "NO_FPU"

config MCUX_HW_FPU_TYPE
    string
    default "no_fpu"

config MCUX_HW_NO_FPU
    bool
    default y

config MCUX_HW_INT_PRIO_BITS
    int
    default 3

config MCUX_HW_DSP
    bool
    default n

config MCUX_HW_SAU
    bool
    default y

config MCUX_HW_SOC_SERIES_WIRELESS
    bool
    default y

config MCUX_HW_SOC_SINGLECORE_DEVICE
    bool
    default y

# For chipmodel generated files
config MCUX_TOOLCHAIN_LINKER_DEVICE_PREFIX
    string
    default "mcxw727_cm33_core1" if MCUX_HW_DEVICE_ID_MCXW727AxxxA

config MCUX_TOOLCHAIN_MCUX_STARTUP
    string
    default "mcxw727a_cm33_core1"

# Toolchain related

config MCUX_TOOLCHAIN_IAR_CPU_IDENTIFIER
    string
    default "MCXW727A_core1" if MCUX_HW_DEVICE_ID_MCXW727AxxxA

config MCUX_TOOLCHAIN_MDK_CPU_IDENTIFIER
    string
    default "MCXW727AMFTA" if MCUX_HW_DEVICE_PART_MCXW727AMFTA

config MCUX_TOOLCHAIN_JLINK_CPU_IDENTIFIER
    string
    default "MCXW727A" if MCUX_HW_DEVICE_ID_MCXW727AxxxA
```

## mcux/mcux-sdk-ng/devices/MCX/MCXW/MCXW727A/drivers/Kconfig
```kconfig
# Copyright 2024 NXP
#
# SPDX-License-Identifier: BSD-3-Clause

menu "Device specific drivers configuration"

    rsource "../../MCXW727C/drivers/Kconfig_clock"
    rsource "../../MCXW727C/drivers/Kconfig_romapi"

endmenu
```

## mcux/mcux-sdk-ng/devices/MCX/MCXW/MCXW727C/cm33_core1/Kconfig
```kconfig
# Copyright 2024 NXP
#
# SPDX-License-Identifier: BSD-3-Clause

config MCUX_HW_DEVICE_MCXW727C_CORE_ID_cm33_core1
    bool
    default y

rsource "Kconfig.chip"
```

## mcux/mcux-sdk-ng/devices/RT/RT1010/MIMXRT1011/Kconfig.chip
```kconfig
# Copyright 2024 NXP
# All rights reserved.
#
# SPDX-License-Identifier: BSD-3-Clause
#

config MCUX_HW_SOC_SERIES_RT
    bool
    default y

config MCUX_HW_SOC_SINGLECORE_DEVICE
    bool
    default y

# device related
config MCUX_HW_DEVICE_ID_MIMXRT1011xxxxx
    bool

choice
    prompt "Device MIMXRT1011 Part"
    config MCUX_HW_DEVICE_PART_MIMXRT1011DAE5A
        bool "Device part MIMXRT1011DAE5A"
        select MCUX_HW_DEVICE_ID_MIMXRT1011xxxxx
    config MCUX_HW_DEVICE_PART_MIMXRT1011CAE4A
        bool "Device part MIMXRT1011CAE4A"
        select MCUX_HW_DEVICE_ID_MIMXRT1011xxxxx
endchoice

config MCUX_HW_DEVICE_ID
    string
    default "MIMXRT1011xxxxx" if MCUX_HW_DEVICE_ID_MIMXRT1011xxxxx

config MCUX_HW_DEVICE_PART
    string
    default "MIMXRT1011DAE5A" if MCUX_HW_DEVICE_PART_MIMXRT1011DAE5A
    default "MIMXRT1011CAE4A" if MCUX_HW_DEVICE_PART_MIMXRT1011CAE4A

# core related
config MCUX_HW_CORE
    string
    default "cm7f"

config MCUX_HW_CORE_CM7F
    bool
    default y

config MCUX_HW_CORE_ID
    string
    default "cm7"

config MCUX_HW_CORE_ID_CM7
    bool
    default y

config MCUX_HW_DEVICE_CORE
    string
    default "MIMXRT1011"

config MCUX_HW_FPU
    string
    default "SP_FPU"

config MCUX_HW_FPU_TYPE
    string
    default "fpv5_sp"

config MCUX_HW_FPV5_SP
    bool
    default y

config MCUX_HW_INT_PRIO_BITS
    int
    default 4

config MCUX_TOOLCHAIN_MCUX_STARTUP
    string
    default "mimxrt1011"

config MCUX_TOOLCHAIN_LINKER_DEVICE_PREFIX
    string
    default "MIMXRT1011xxxxx"

config MCUX_TOOLCHAIN_IAR_CPU_IDENTIFIER
    string
    default "MIMXRT1011xxx5A"

config MCUX_TOOLCHAIN_MDK_CPU_IDENTIFIER
    string
    default "MIMXRT1011DAE5A" if MCUX_HW_DEVICE_PART_MIMXRT1011DAE5A
    default "MIMXRT1011CAE4A" if MCUX_HW_DEVICE_PART_MIMXRT1011CAE4A

config MCUX_TOOLCHAIN_JLINK_CPU_IDENTIFIER
    string
    default "MIMXRT1011DAE5A"

# ip information
config MCUX_HW_IP_DriverType_ADC
    bool
    default y
    depends on MCUX_HW_DEVICE_ID_MIMXRT1011xxxxx

config MCUX_HW_IP_DriverType_ADC_ETC
    bool
    default y
    depends on MCUX_HW_DEVICE_ID_MIMXRT1011xxxxx

config MCUX_HW_IP_DriverType_AIPSTZ
    bool
    default y
    depends on MCUX_HW_DEVICE_ID_MIMXRT1011xxxxx

config MCUX_HW_IP_DriverType_AOI
    bool
    default y
    depends on MCUX_HW_DEVICE_ID_MIMXRT1011xxxxx

config MCUX_HW_IP_DriverType_CCM
    bool
    default y
    depends on MCUX_HW_DEVICE_ID_MIMXRT1011xxxxx

config MCUX_HW_IP_DriverType_CCM_ANALOG
    bool
    default y
    depends on MCUX_HW_DEVICE_ID_MIMXRT1011xxxxx

config MCUX_HW_IP_DriverType_CSU
    bool
    default y
    depends on MCUX_HW_DEVICE_ID_MIMXRT1011xxxxx

config MCUX_HW_IP_DriverType_DCDC_1
    bool
    default y
    depends on MCUX_HW_DEVICE_ID_MIMXRT1011xxxxx

config MCUX_HW_IP_DriverType_DCP
    bool
    default y
    depends on MCUX_HW_DEVICE_ID_MIMXRT1011xxxxx

config MCUX_HW_IP_DriverType_DMAMUX32
    bool
    default y
    depends on MCUX_HW_DEVICE_ID_MIMXRT1011xxxxx

config MCUX_HW_IP_DriverType_EDMA
    bool
    default y
    depends on MCUX_HW_DEVICE_ID_MIMXRT1011xxxxx

config MCUX_HW_IP_DriverType_EWM
    bool
    default y
    depends on MCUX_HW_DEVICE_ID_MIMXRT1011xxxxx

config MCUX_HW_IP_DriverType_FLEXIO
    bool
    default y
    depends on MCUX_HW_DEVICE_ID_MIMXRT1011xxxxx

config MCUX_HW_IP_DriverType_FLEXRAM
    bool
    default y
    depends on MCUX_HW_DEVICE_ID_MIMXRT1011xxxxx

config MCUX_HW_IP_DriverType_FLEXSPI
    bool
    default y
    depends on MCUX_HW_DEVICE_ID_MIMXRT1011xxxxx

config MCUX_HW_IP_DriverType_GPC_1
    bool
    default y
    depends on MCUX_HW_DEVICE_ID_MIMXRT1011xxxxx

config MCUX_HW_IP_DriverType_GPT
    bool
    default y
    depends on MCUX_HW_DEVICE_ID_MIMXRT1011xxxxx

config MCUX_HW_IP_DriverType_IGPIO
    bool
    default y
    depends on MCUX_HW_DEVICE_ID_MIMXRT1011xxxxx

config MCUX_HW_IP_DriverType_IOMUXC
    bool
    default y
    depends on MCUX_HW_DEVICE_ID_MIMXRT1011xxxxx

config MCUX_HW_IP_DriverType_IOMUXC_GPR
    bool
    default y
    depends on MCUX_HW_DEVICE_ID_MIMXRT1011xxxxx

config MCUX_HW_IP_DriverType_IOMUXC_SNVS
    bool
    default y
    depends on MCUX_HW_DEVICE_ID_MIMXRT1011xxxxx

config MCUX_HW_IP_DriverType_IOMUXC_SNVS_GPR
    bool
    default y
    depends on MCUX_HW_DEVICE_ID_MIMXRT1011xxxxx

config MCUX_HW_IP_DriverType_KPP
    bool
    default y
    depends on MCUX_HW_DEVICE_ID_MIMXRT1011xxxxx

config MCUX_HW_IP_DriverType_LPI2C
    bool
    default y
    depends on MCUX_HW_DEVICE_ID_MIMXRT1011xxxxx

config MCUX_HW_IP_DriverType_LPSPI
    bool
    default y
    depends on MCUX_HW_DEVICE_ID_MIMXRT1011xxxxx

config MCUX_HW_IP_DriverType_LPUART
    bool
    default y
    depends on MCUX_HW_DEVICE_ID_MIMXRT1011xxxxx

config MCUX_HW_IP_DriverType_OCOTP
    bool
    default y
    depends on MCUX_HW_DEVICE_ID_MIMXRT1011xxxxx

config MCUX_HW_IP_DriverType_OTFAD
    bool
    default y
    depends on MCUX_HW_DEVICE_ID_MIMXRT1011xxxxx

config MCUX_HW_IP_DriverType_PGC
    bool
    default y
    depends on MCUX_HW_DEVICE_ID_MIMXRT1011xxxxx

config MCUX_HW_IP_DriverType_PIT
    bool
    default y
    depends on MCUX_HW_DEVICE_ID_MIMXRT1011xxxxx

config MCUX_HW_IP_DriverType_PMU
    bool
    default y
    depends on MCUX_HW_DEVICE_ID_MIMXRT1011xxxxx

config MCUX_HW_IP_DriverType_PWM
    bool
    default y
    depends on MCUX_HW_DEVICE_ID_MIMXRT1011xxxxx

config MCUX_HW_IP_DriverType_RTWDOG
    bool
    default y
    depends on MCUX_HW_DEVICE_ID_MIMXRT1011xxxxx

config MCUX_HW_IP_DriverType_SAI
    bool
    default y
    depends on MCUX_HW_DEVICE_ID_MIMXRT1011xxxxx

config MCUX_HW_IP_DriverType_SCB
    bool
    default y
    depends on MCUX_HW_DEVICE_ID_MIMXRT1011xxxxx

config MCUX_HW_IP_DriverType_SNVS
    bool
    default y
    depends on MCUX_HW_DEVICE_ID_MIMXRT1011xxxxx

config MCUX_HW_IP_DriverType_SPDIF
    bool
    default y
    depends on MCUX_HW_DEVICE_ID_MIMXRT1011xxxxx

config MCUX_HW_IP_DriverType_SRC
    bool
    default y
    depends on MCUX_HW_DEVICE_ID_MIMXRT1011xxxxx

config MCUX_HW_IP_DriverType_TEMPMON
    bool
    default y
    depends on MCUX_HW_DEVICE_ID_MIMXRT1011xxxxx

config MCUX_HW_IP_DriverType_TRNG
    bool
    default y
    depends on MCUX_HW_DEVICE_ID_MIMXRT1011xxxxx

config MCUX_HW_IP_DriverType_USBNC
    bool
    default y
    depends on MCUX_HW_DEVICE_ID_MIMXRT1011xxxxx

config MCUX_HW_IP_DriverType_USB_HOST_DEVICE_EHCI
    bool
    default y
    depends on MCUX_HW_DEVICE_ID_MIMXRT1011xxxxx

config MCUX_HW_IP_DriverType_USB_PHY
    bool
    default y
    depends on MCUX_HW_DEVICE_ID_MIMXRT1011xxxxx

config MCUX_HW_IP_DriverType_USB_PHYDCD
    bool
    default y
    depends on MCUX_HW_DEVICE_ID_MIMXRT1011xxxxx

config MCUX_HW_IP_DriverType_WDOG01
    bool
    default y
    depends on MCUX_HW_DEVICE_ID_MIMXRT1011xxxxx

config MCUX_HW_IP_DriverType_XBARA
    bool
    default y
    depends on MCUX_HW_DEVICE_ID_MIMXRT1011xxxxx

config MCUX_HW_IP_DriverType_XTALOSC24M
    bool
    default y
    depends on MCUX_HW_DEVICE_ID_MIMXRT1011xxxxx
```

## mcux/mcux-sdk-ng/devices/RT/RT1020/MIMXRT1021/xip/Kconfig
```kconfig
# Copyright 2024 NXP
#
# SPDX-License-Identifier: BSD-3-Clause

rsource "../../../RT1050/MIMXRT1052/xip/Kconfig"
```

## mcux/mcux-sdk-ng/devices/RT/RT1020/MIMXRT1024/drivers/Kconfig
```kconfig
# Copyright 2024 NXP
#
# SPDX-License-Identifier: BSD-3-Clause

menu "Device specific drivers"
    config MCUX_COMPONENT_driver.clock
        bool "Use driver clock"
        # select MCUX_COMPONENT_driver.common

        if MCUX_COMPONENT_driver.clock

        endif

    config MCUX_COMPONENT_driver.iomuxc
        bool "Use driver iomuxc"
        select MCUX_COMPONENT_driver.common

        if MCUX_COMPONENT_driver.iomuxc

        endif

    rsource "../../../RT1050/MIMXRT1052/drivers/flexram/Kconfig"
    rsource "../../../RT1020/MIMXRT1021/drivers/nic301/Kconfig"
    rsource "../../../RT1020/MIMXRT1021/drivers/romapi/Kconfig"
endmenu
```

## mcux/mcux-sdk-ng/devices/RT/RT1040/MIMXRT1041/drivers/Kconfig
```kconfig
# Copyright 2024 NXP
#
# SPDX-License-Identifier: BSD-3-Clause

rsource "../../../RT1040/MIMXRT1042/drivers/Kconfig"
```

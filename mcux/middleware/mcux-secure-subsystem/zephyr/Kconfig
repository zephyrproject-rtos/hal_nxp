## nxp_crypto_hal/psa_crypto_driver/ele_hseb/Kconfig.ele_hseb
```kconfig
#
# Copyright 2026 NXP
#
# SPDX-License-Identifier: BSD-3-Clause

#########################################
####   PUBLIC SYMBOLS WITH PROMPTS   ####
#########################################

config MCUX_COMPONENT_component.psa_crypto_driver.ele_hseb
    bool "ELE HSEB"
    select MCUX_COMPONENT_component.psa_crypto_driver
    select MCUX_COMPONENT_component.ele_hseb
    select MCUX_COMPONENT_component.psa_crypto_driver.util.wrapcheck_static_inline
    imply MCUX_COMPONENT_component.psa_crypto_driver.ele_hseb.feature.autoformat_key_catalogs

config MCUX_COMPONENT_component.psa_crypto_driver.ele_hseb.feature.autoformat_key_catalogs
    bool "Automatically Format Key Catalogs"
    depends on MCUX_COMPONENT_component.psa_crypto_driver.ele_hseb
    default y
    help
        ELE HSEB requires the internal key catalogs to be formatted before
        using any cryptographic operations. This option enables automatic
        formatting of key catalogs during initialization via psa_crypto_init().
        Disabling this option requires manual key catalog formatting before use.

config MCUX_COMPONENT_component.psa_crypto_driver.ele_hseb.feature.use_custom_config_header
    bool "Custom Configuration Header"
    depends on MCUX_COMPONENT_component.psa_crypto_driver.ele_hseb
    default n
    help
        Allows custom configuration of ELE HSEB internals via a user-provided
        header file. When enabled, the application is responsible for providing
        custom key catalog definitions and other configurations.
        This is only for advanced users who need to customize key storage
        and management for their specific use case.
        The provided PSA feature set may not be fully supported with
        custom configurations.
        See ele_hseb_readme.md for more information.

config ELE_HSEB_CUSTOM_CONFIG_HEADER
    string "Header file with custom ELE HSEB key catalog definitions"
    depends on MCUX_COMPONENT_component.psa_crypto_driver.ele_hseb.feature.use_custom_config_header

#########################################
#### PRIVATE SYMBOLS WITHOUT PROMPTS ####
#########################################

config ELE_HSEB_AUTOFORMAT_KEY_CATALOGS
    bool
    default y if MCUX_COMPONENT_component.psa_crypto_driver.ele_hseb.feature.autoformat_key_catalogs
```

## nxp_crypto_hal/psa_crypto_driver/zephyr/Kconfig
```kconfig
# psa-crypto-driver configuration options

# Copyright 2024-2026 NXP
#
# SPDX-License-Identifier: BSD-3-Clause

#
# HW Acceleration Configs psa-crypto-driver
#

config MCUX_PSA_CRYPTO_DRIVER_ELS_PKC
	bool "Build psa_crypto_driver for els_pkc"
	depends on MCUX_ELS_PKC
	default n
	help
	    Include the psa_crypto_driver component from the NXP MCU SDK in the build.
	    This provides an abstraction on top of the els_pkc component in order to be
	    able to access the hardware acceleration offered by els_pkc from mbedtls
	    via the mbedtls psa_crypto_driver_wrapper.

config MCUX_PSA_CRYPTO_DRIVER_ELS_PKC_THREAD
	bool "Enables threading support in psa-crypto-driver"
	depends on MCUX_ELS_PKC && MCUX_PSA_CRYPTO_DRIVER_ELS_PKC
	default n if BUILD_WITH_TFM
	help
	    Enables threading support in psa-crypto-driver component.

config MCUX_PSA_CRYPTO_DRIVER_USE_ELS_PKC_SHA1
	bool "Enables use of SHA1 from els-pkc via psa-crypto-driver"
	depends on MCUX_ELS_PKC && MCUX_PSA_CRYPTO_DRIVER_ELS_PKC
	help
	    Enables use of SHA1 from els-pkc via psa-crypto-driver component

config PSA_CRYPTO_DRIVER_CAAM
	bool "Build psa_crypto_driver for caam"
	depends on MBEDTLS_PSA_CRYPTO_C
	default n
	help
		Enables CAAM support in psa-crypto-driver component

config PSA_CRYPTO_DRIVER_DCP
	bool "Enables DCP support in psa-crypto-driver"
	depends on MBEDTLS_PSA_CRYPTO_C
	default n
	help
	    Enables DCP support in psa-crypto-driver component.

config PSA_CRYPTO_DRIVER_ELE_S2XX
	bool "Enables ELE S2XX support in psa-crypto-driver"
	depends on MBEDTLS_PSA_CRYPTO_C && MCUX_DEVICE_HAS_ELE_S200
	default n
	help
	    Enables ELE S2XX support in psa-crypto-driver component.

config PSA_CRYPTO_DRIVER_ELE_S4xx
	bool "Enables ELE S4xx support in psa-crypto-driver"
	depends on MBEDTLS_PSA_CRYPTO_C && SOC_SERIES_IMXRT118X
	select MBEDTLS_ASN1_WRITE_C
	select MBEDTLS_BIGNUM_C
	select ARM_MPU_SRAM_WRITE_THROUGH
	select MBEDTLS_DECLARE_PRIVATE_IDENTIFIERS
	default n
	help
	    Enables ELE S4xx support in psa-crypto-driver component.

config PSA_CRYPTO_DRIVER_THREAD_EN
	bool "Enables PSA Crypto Thread"
	depends on MBEDTLS_PSA_CRYPTO_C
	default n
	help
	    Enables PSA_CRYPTO_THREAD

config USING_MBEDTLS_3X
	bool
	depends on MBEDTLS_PSA_CRYPTO_C
	default y
	help
	    Tells the PSA crypto driver layer that it's caller is
	    MbedTLS 3.x for backward compatibility.
```
